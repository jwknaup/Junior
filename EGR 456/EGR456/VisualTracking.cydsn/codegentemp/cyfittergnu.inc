/*******************************************************************************
* File Name: cyfittergnu.inc
* 
* PSoC Creator  4.1 Update 1
*
* Description:
* 
* This file is automatically generated by PSoC Creator.
*
********************************************************************************
* Copyright (c) 2007-2017 Cypress Semiconductor.  All rights reserved.
* You may use this file only in accordance with the license, terms, conditions, 
* disclaimers, and limitations in the end user license agreement accompanying 
* the software package with which this file was provided.
********************************************************************************/

.ifndef INCLUDED_CYFITTERGNU_INC
.set INCLUDED_CYFITTERGNU_INC, 1
.include "cydevicegnu.inc"
.include "cydevicegnu_trm.inc"

/* A */
.set A__0__INTTYPE, CYREG_PICU0_INTTYPE0
.set A__0__MASK, 0x01
.set A__0__PC, CYREG_PRT0_PC0
.set A__0__PORT, 0
.set A__0__SHIFT, 0
.set A__AG, CYREG_PRT0_AG
.set A__AMUX, CYREG_PRT0_AMUX
.set A__BIE, CYREG_PRT0_BIE
.set A__BIT_MASK, CYREG_PRT0_BIT_MASK
.set A__BYP, CYREG_PRT0_BYP
.set A__CTL, CYREG_PRT0_CTL
.set A__DM0, CYREG_PRT0_DM0
.set A__DM1, CYREG_PRT0_DM1
.set A__DM2, CYREG_PRT0_DM2
.set A__DR, CYREG_PRT0_DR
.set A__INP_DIS, CYREG_PRT0_INP_DIS
.set A__INTTYPE_BASE, CYDEV_PICU_INTTYPE_PICU0_BASE
.set A__LCD_COM_SEG, CYREG_PRT0_LCD_COM_SEG
.set A__LCD_EN, CYREG_PRT0_LCD_EN
.set A__MASK, 0x01
.set A__PORT, 0
.set A__PRT, CYREG_PRT0_PRT
.set A__PRTDSI__CAPS_SEL, CYREG_PRT0_CAPS_SEL
.set A__PRTDSI__DBL_SYNC_IN, CYREG_PRT0_DBL_SYNC_IN
.set A__PRTDSI__OE_SEL0, CYREG_PRT0_OE_SEL0
.set A__PRTDSI__OE_SEL1, CYREG_PRT0_OE_SEL1
.set A__PRTDSI__OUT_SEL0, CYREG_PRT0_OUT_SEL0
.set A__PRTDSI__OUT_SEL1, CYREG_PRT0_OUT_SEL1
.set A__PRTDSI__SYNC_OUT, CYREG_PRT0_SYNC_OUT
.set A__PS, CYREG_PRT0_PS
.set A__SHIFT, 0
.set A__SLW, CYREG_PRT0_SLW

/* B */
.set B__0__INTTYPE, CYREG_PICU0_INTTYPE1
.set B__0__MASK, 0x02
.set B__0__PC, CYREG_PRT0_PC1
.set B__0__PORT, 0
.set B__0__SHIFT, 1
.set B__AG, CYREG_PRT0_AG
.set B__AMUX, CYREG_PRT0_AMUX
.set B__BIE, CYREG_PRT0_BIE
.set B__BIT_MASK, CYREG_PRT0_BIT_MASK
.set B__BYP, CYREG_PRT0_BYP
.set B__CTL, CYREG_PRT0_CTL
.set B__DM0, CYREG_PRT0_DM0
.set B__DM1, CYREG_PRT0_DM1
.set B__DM2, CYREG_PRT0_DM2
.set B__DR, CYREG_PRT0_DR
.set B__INP_DIS, CYREG_PRT0_INP_DIS
.set B__INTTYPE_BASE, CYDEV_PICU_INTTYPE_PICU0_BASE
.set B__LCD_COM_SEG, CYREG_PRT0_LCD_COM_SEG
.set B__LCD_EN, CYREG_PRT0_LCD_EN
.set B__MASK, 0x02
.set B__PORT, 0
.set B__PRT, CYREG_PRT0_PRT
.set B__PRTDSI__CAPS_SEL, CYREG_PRT0_CAPS_SEL
.set B__PRTDSI__DBL_SYNC_IN, CYREG_PRT0_DBL_SYNC_IN
.set B__PRTDSI__OE_SEL0, CYREG_PRT0_OE_SEL0
.set B__PRTDSI__OE_SEL1, CYREG_PRT0_OE_SEL1
.set B__PRTDSI__OUT_SEL0, CYREG_PRT0_OUT_SEL0
.set B__PRTDSI__OUT_SEL1, CYREG_PRT0_OUT_SEL1
.set B__PRTDSI__SYNC_OUT, CYREG_PRT0_SYNC_OUT
.set B__PS, CYREG_PRT0_PS
.set B__SHIFT, 1
.set B__SLW, CYREG_PRT0_SLW

/* C */
.set C__0__INTTYPE, CYREG_PICU0_INTTYPE2
.set C__0__MASK, 0x04
.set C__0__PC, CYREG_PRT0_PC2
.set C__0__PORT, 0
.set C__0__SHIFT, 2
.set C__AG, CYREG_PRT0_AG
.set C__AMUX, CYREG_PRT0_AMUX
.set C__BIE, CYREG_PRT0_BIE
.set C__BIT_MASK, CYREG_PRT0_BIT_MASK
.set C__BYP, CYREG_PRT0_BYP
.set C__CTL, CYREG_PRT0_CTL
.set C__DM0, CYREG_PRT0_DM0
.set C__DM1, CYREG_PRT0_DM1
.set C__DM2, CYREG_PRT0_DM2
.set C__DR, CYREG_PRT0_DR
.set C__INP_DIS, CYREG_PRT0_INP_DIS
.set C__INTTYPE_BASE, CYDEV_PICU_INTTYPE_PICU0_BASE
.set C__LCD_COM_SEG, CYREG_PRT0_LCD_COM_SEG
.set C__LCD_EN, CYREG_PRT0_LCD_EN
.set C__MASK, 0x04
.set C__PORT, 0
.set C__PRT, CYREG_PRT0_PRT
.set C__PRTDSI__CAPS_SEL, CYREG_PRT0_CAPS_SEL
.set C__PRTDSI__DBL_SYNC_IN, CYREG_PRT0_DBL_SYNC_IN
.set C__PRTDSI__OE_SEL0, CYREG_PRT0_OE_SEL0
.set C__PRTDSI__OE_SEL1, CYREG_PRT0_OE_SEL1
.set C__PRTDSI__OUT_SEL0, CYREG_PRT0_OUT_SEL0
.set C__PRTDSI__OUT_SEL1, CYREG_PRT0_OUT_SEL1
.set C__PRTDSI__SYNC_OUT, CYREG_PRT0_SYNC_OUT
.set C__PS, CYREG_PRT0_PS
.set C__SHIFT, 2
.set C__SLW, CYREG_PRT0_SLW
.set Clock_1__CFG0, CYREG_CLKDIST_DCFG1_CFG0
.set Clock_1__CFG1, CYREG_CLKDIST_DCFG1_CFG1
.set Clock_1__CFG2, CYREG_CLKDIST_DCFG1_CFG2
.set Clock_1__CFG2_SRC_SEL_MASK, 0x07
.set Clock_1__INDEX, 0x01
.set Clock_1__PM_ACT_CFG, CYREG_PM_ACT_CFG2
.set Clock_1__PM_ACT_MSK, 0x02
.set Clock_1__PM_STBY_CFG, CYREG_PM_STBY_CFG2
.set Clock_1__PM_STBY_MSK, 0x02
.set Col1__0__INTTYPE, CYREG_PICU2_INTTYPE4
.set Col1__0__MASK, 0x10
.set Col1__0__PC, CYREG_PRT2_PC4
.set Col1__0__PORT, 2
.set Col1__0__SHIFT, 4
.set Col1__AG, CYREG_PRT2_AG
.set Col1__AMUX, CYREG_PRT2_AMUX
.set Col1__BIE, CYREG_PRT2_BIE
.set Col1__BIT_MASK, CYREG_PRT2_BIT_MASK
.set Col1__BYP, CYREG_PRT2_BYP
.set Col1__CTL, CYREG_PRT2_CTL
.set Col1__DM0, CYREG_PRT2_DM0
.set Col1__DM1, CYREG_PRT2_DM1
.set Col1__DM2, CYREG_PRT2_DM2
.set Col1__DR, CYREG_PRT2_DR
.set Col1__INP_DIS, CYREG_PRT2_INP_DIS
.set Col1__INTTYPE_BASE, CYDEV_PICU_INTTYPE_PICU2_BASE
.set Col1__LCD_COM_SEG, CYREG_PRT2_LCD_COM_SEG
.set Col1__LCD_EN, CYREG_PRT2_LCD_EN
.set Col1__MASK, 0x10
.set Col1__PORT, 2
.set Col1__PRT, CYREG_PRT2_PRT
.set Col1__PRTDSI__CAPS_SEL, CYREG_PRT2_CAPS_SEL
.set Col1__PRTDSI__DBL_SYNC_IN, CYREG_PRT2_DBL_SYNC_IN
.set Col1__PRTDSI__OE_SEL0, CYREG_PRT2_OE_SEL0
.set Col1__PRTDSI__OE_SEL1, CYREG_PRT2_OE_SEL1
.set Col1__PRTDSI__OUT_SEL0, CYREG_PRT2_OUT_SEL0
.set Col1__PRTDSI__OUT_SEL1, CYREG_PRT2_OUT_SEL1
.set Col1__PRTDSI__SYNC_OUT, CYREG_PRT2_SYNC_OUT
.set Col1__PS, CYREG_PRT2_PS
.set Col1__SHIFT, 4
.set Col1__SLW, CYREG_PRT2_SLW
.set Col2__0__INTTYPE, CYREG_PICU2_INTTYPE5
.set Col2__0__MASK, 0x20
.set Col2__0__PC, CYREG_PRT2_PC5
.set Col2__0__PORT, 2
.set Col2__0__SHIFT, 5
.set Col2__AG, CYREG_PRT2_AG
.set Col2__AMUX, CYREG_PRT2_AMUX
.set Col2__BIE, CYREG_PRT2_BIE
.set Col2__BIT_MASK, CYREG_PRT2_BIT_MASK
.set Col2__BYP, CYREG_PRT2_BYP
.set Col2__CTL, CYREG_PRT2_CTL
.set Col2__DM0, CYREG_PRT2_DM0
.set Col2__DM1, CYREG_PRT2_DM1
.set Col2__DM2, CYREG_PRT2_DM2
.set Col2__DR, CYREG_PRT2_DR
.set Col2__INP_DIS, CYREG_PRT2_INP_DIS
.set Col2__INTTYPE_BASE, CYDEV_PICU_INTTYPE_PICU2_BASE
.set Col2__LCD_COM_SEG, CYREG_PRT2_LCD_COM_SEG
.set Col2__LCD_EN, CYREG_PRT2_LCD_EN
.set Col2__MASK, 0x20
.set Col2__PORT, 2
.set Col2__PRT, CYREG_PRT2_PRT
.set Col2__PRTDSI__CAPS_SEL, CYREG_PRT2_CAPS_SEL
.set Col2__PRTDSI__DBL_SYNC_IN, CYREG_PRT2_DBL_SYNC_IN
.set Col2__PRTDSI__OE_SEL0, CYREG_PRT2_OE_SEL0
.set Col2__PRTDSI__OE_SEL1, CYREG_PRT2_OE_SEL1
.set Col2__PRTDSI__OUT_SEL0, CYREG_PRT2_OUT_SEL0
.set Col2__PRTDSI__OUT_SEL1, CYREG_PRT2_OUT_SEL1
.set Col2__PRTDSI__SYNC_OUT, CYREG_PRT2_SYNC_OUT
.set Col2__PS, CYREG_PRT2_PS
.set Col2__SHIFT, 5
.set Col2__SLW, CYREG_PRT2_SLW
.set Col3__0__INTTYPE, CYREG_PICU2_INTTYPE6
.set Col3__0__MASK, 0x40
.set Col3__0__PC, CYREG_PRT2_PC6
.set Col3__0__PORT, 2
.set Col3__0__SHIFT, 6
.set Col3__AG, CYREG_PRT2_AG
.set Col3__AMUX, CYREG_PRT2_AMUX
.set Col3__BIE, CYREG_PRT2_BIE
.set Col3__BIT_MASK, CYREG_PRT2_BIT_MASK
.set Col3__BYP, CYREG_PRT2_BYP
.set Col3__CTL, CYREG_PRT2_CTL
.set Col3__DM0, CYREG_PRT2_DM0
.set Col3__DM1, CYREG_PRT2_DM1
.set Col3__DM2, CYREG_PRT2_DM2
.set Col3__DR, CYREG_PRT2_DR
.set Col3__INP_DIS, CYREG_PRT2_INP_DIS
.set Col3__INTTYPE_BASE, CYDEV_PICU_INTTYPE_PICU2_BASE
.set Col3__LCD_COM_SEG, CYREG_PRT2_LCD_COM_SEG
.set Col3__LCD_EN, CYREG_PRT2_LCD_EN
.set Col3__MASK, 0x40
.set Col3__PORT, 2
.set Col3__PRT, CYREG_PRT2_PRT
.set Col3__PRTDSI__CAPS_SEL, CYREG_PRT2_CAPS_SEL
.set Col3__PRTDSI__DBL_SYNC_IN, CYREG_PRT2_DBL_SYNC_IN
.set Col3__PRTDSI__OE_SEL0, CYREG_PRT2_OE_SEL0
.set Col3__PRTDSI__OE_SEL1, CYREG_PRT2_OE_SEL1
.set Col3__PRTDSI__OUT_SEL0, CYREG_PRT2_OUT_SEL0
.set Col3__PRTDSI__OUT_SEL1, CYREG_PRT2_OUT_SEL1
.set Col3__PRTDSI__SYNC_OUT, CYREG_PRT2_SYNC_OUT
.set Col3__PS, CYREG_PRT2_PS
.set Col3__SHIFT, 6
.set Col3__SLW, CYREG_PRT2_SLW
.set Col4__0__INTTYPE, CYREG_PICU2_INTTYPE7
.set Col4__0__MASK, 0x80
.set Col4__0__PC, CYREG_PRT2_PC7
.set Col4__0__PORT, 2
.set Col4__0__SHIFT, 7
.set Col4__AG, CYREG_PRT2_AG
.set Col4__AMUX, CYREG_PRT2_AMUX
.set Col4__BIE, CYREG_PRT2_BIE
.set Col4__BIT_MASK, CYREG_PRT2_BIT_MASK
.set Col4__BYP, CYREG_PRT2_BYP
.set Col4__CTL, CYREG_PRT2_CTL
.set Col4__DM0, CYREG_PRT2_DM0
.set Col4__DM1, CYREG_PRT2_DM1
.set Col4__DM2, CYREG_PRT2_DM2
.set Col4__DR, CYREG_PRT2_DR
.set Col4__INP_DIS, CYREG_PRT2_INP_DIS
.set Col4__INTTYPE_BASE, CYDEV_PICU_INTTYPE_PICU2_BASE
.set Col4__LCD_COM_SEG, CYREG_PRT2_LCD_COM_SEG
.set Col4__LCD_EN, CYREG_PRT2_LCD_EN
.set Col4__MASK, 0x80
.set Col4__PORT, 2
.set Col4__PRT, CYREG_PRT2_PRT
.set Col4__PRTDSI__CAPS_SEL, CYREG_PRT2_CAPS_SEL
.set Col4__PRTDSI__DBL_SYNC_IN, CYREG_PRT2_DBL_SYNC_IN
.set Col4__PRTDSI__OE_SEL0, CYREG_PRT2_OE_SEL0
.set Col4__PRTDSI__OE_SEL1, CYREG_PRT2_OE_SEL1
.set Col4__PRTDSI__OUT_SEL0, CYREG_PRT2_OUT_SEL0
.set Col4__PRTDSI__OUT_SEL1, CYREG_PRT2_OUT_SEL1
.set Col4__PRTDSI__SYNC_OUT, CYREG_PRT2_SYNC_OUT
.set Col4__PS, CYREG_PRT2_PS
.set Col4__SHIFT, 7
.set Col4__SLW, CYREG_PRT2_SLW

/* D */
.set D__0__INTTYPE, CYREG_PICU0_INTTYPE3
.set D__0__MASK, 0x08
.set D__0__PC, CYREG_PRT0_PC3
.set D__0__PORT, 0
.set D__0__SHIFT, 3
.set D__AG, CYREG_PRT0_AG
.set D__AMUX, CYREG_PRT0_AMUX
.set D__BIE, CYREG_PRT0_BIE
.set D__BIT_MASK, CYREG_PRT0_BIT_MASK
.set D__BYP, CYREG_PRT0_BYP
.set D__CTL, CYREG_PRT0_CTL
.set D__DM0, CYREG_PRT0_DM0
.set D__DM1, CYREG_PRT0_DM1
.set D__DM2, CYREG_PRT0_DM2
.set D__DR, CYREG_PRT0_DR
.set D__INP_DIS, CYREG_PRT0_INP_DIS
.set D__INTTYPE_BASE, CYDEV_PICU_INTTYPE_PICU0_BASE
.set D__LCD_COM_SEG, CYREG_PRT0_LCD_COM_SEG
.set D__LCD_EN, CYREG_PRT0_LCD_EN
.set D__MASK, 0x08
.set D__PORT, 0
.set D__PRT, CYREG_PRT0_PRT
.set D__PRTDSI__CAPS_SEL, CYREG_PRT0_CAPS_SEL
.set D__PRTDSI__DBL_SYNC_IN, CYREG_PRT0_DBL_SYNC_IN
.set D__PRTDSI__OE_SEL0, CYREG_PRT0_OE_SEL0
.set D__PRTDSI__OE_SEL1, CYREG_PRT0_OE_SEL1
.set D__PRTDSI__OUT_SEL0, CYREG_PRT0_OUT_SEL0
.set D__PRTDSI__OUT_SEL1, CYREG_PRT0_OUT_SEL1
.set D__PRTDSI__SYNC_OUT, CYREG_PRT0_SYNC_OUT
.set D__PS, CYREG_PRT0_PS
.set D__SHIFT, 3
.set D__SLW, CYREG_PRT0_SLW

/* PWM_1 */
.set PWM_1_PWMUDB_genblk1_ctrlreg__0__MASK, 0x01
.set PWM_1_PWMUDB_genblk1_ctrlreg__0__POS, 0
.set PWM_1_PWMUDB_genblk1_ctrlreg__1__MASK, 0x02
.set PWM_1_PWMUDB_genblk1_ctrlreg__1__POS, 1
.set PWM_1_PWMUDB_genblk1_ctrlreg__16BIT_CONTROL_AUX_CTL_REG, CYREG_B0_UDB05_06_ACTL
.set PWM_1_PWMUDB_genblk1_ctrlreg__16BIT_CONTROL_CONTROL_REG, CYREG_B0_UDB05_06_CTL
.set PWM_1_PWMUDB_genblk1_ctrlreg__16BIT_CONTROL_COUNT_REG, CYREG_B0_UDB05_06_CTL
.set PWM_1_PWMUDB_genblk1_ctrlreg__16BIT_COUNT_CONTROL_REG, CYREG_B0_UDB05_06_CTL
.set PWM_1_PWMUDB_genblk1_ctrlreg__16BIT_COUNT_COUNT_REG, CYREG_B0_UDB05_06_CTL
.set PWM_1_PWMUDB_genblk1_ctrlreg__16BIT_MASK_MASK_REG, CYREG_B0_UDB05_06_MSK
.set PWM_1_PWMUDB_genblk1_ctrlreg__16BIT_MASK_PERIOD_REG, CYREG_B0_UDB05_06_MSK
.set PWM_1_PWMUDB_genblk1_ctrlreg__16BIT_PERIOD_MASK_REG, CYREG_B0_UDB05_06_MSK
.set PWM_1_PWMUDB_genblk1_ctrlreg__16BIT_PERIOD_PERIOD_REG, CYREG_B0_UDB05_06_MSK
.set PWM_1_PWMUDB_genblk1_ctrlreg__2__MASK, 0x04
.set PWM_1_PWMUDB_genblk1_ctrlreg__2__POS, 2
.set PWM_1_PWMUDB_genblk1_ctrlreg__7__MASK, 0x80
.set PWM_1_PWMUDB_genblk1_ctrlreg__7__POS, 7
.set PWM_1_PWMUDB_genblk1_ctrlreg__CONTROL_AUX_CTL_REG, CYREG_B0_UDB05_ACTL
.set PWM_1_PWMUDB_genblk1_ctrlreg__CONTROL_REG, CYREG_B0_UDB05_CTL
.set PWM_1_PWMUDB_genblk1_ctrlreg__CONTROL_ST_REG, CYREG_B0_UDB05_ST_CTL
.set PWM_1_PWMUDB_genblk1_ctrlreg__COUNT_REG, CYREG_B0_UDB05_CTL
.set PWM_1_PWMUDB_genblk1_ctrlreg__COUNT_ST_REG, CYREG_B0_UDB05_ST_CTL
.set PWM_1_PWMUDB_genblk1_ctrlreg__MASK, 0x87
.set PWM_1_PWMUDB_genblk1_ctrlreg__MASK_CTL_AUX_CTL_REG, CYREG_B0_UDB05_MSK_ACTL
.set PWM_1_PWMUDB_genblk1_ctrlreg__PER_CTL_AUX_CTL_REG, CYREG_B0_UDB05_MSK_ACTL
.set PWM_1_PWMUDB_genblk1_ctrlreg__PERIOD_REG, CYREG_B0_UDB05_MSK
.set PWM_1_PWMUDB_genblk8_stsreg__0__MASK, 0x01
.set PWM_1_PWMUDB_genblk8_stsreg__0__POS, 0
.set PWM_1_PWMUDB_genblk8_stsreg__16BIT_STATUS_AUX_CTL_REG, CYREG_B0_UDB05_06_ACTL
.set PWM_1_PWMUDB_genblk8_stsreg__16BIT_STATUS_REG, CYREG_B0_UDB05_06_ST
.set PWM_1_PWMUDB_genblk8_stsreg__2__MASK, 0x04
.set PWM_1_PWMUDB_genblk8_stsreg__2__POS, 2
.set PWM_1_PWMUDB_genblk8_stsreg__3__MASK, 0x08
.set PWM_1_PWMUDB_genblk8_stsreg__3__POS, 3
.set PWM_1_PWMUDB_genblk8_stsreg__MASK, 0x0D
.set PWM_1_PWMUDB_genblk8_stsreg__MASK_REG, CYREG_B0_UDB05_MSK
.set PWM_1_PWMUDB_genblk8_stsreg__MASK_ST_AUX_CTL_REG, CYREG_B0_UDB05_MSK_ACTL
.set PWM_1_PWMUDB_genblk8_stsreg__PER_ST_AUX_CTL_REG, CYREG_B0_UDB05_MSK_ACTL
.set PWM_1_PWMUDB_genblk8_stsreg__STATUS_AUX_CTL_REG, CYREG_B0_UDB05_ACTL
.set PWM_1_PWMUDB_genblk8_stsreg__STATUS_CNT_REG, CYREG_B0_UDB05_ST_CTL
.set PWM_1_PWMUDB_genblk8_stsreg__STATUS_CONTROL_REG, CYREG_B0_UDB05_ST_CTL
.set PWM_1_PWMUDB_genblk8_stsreg__STATUS_REG, CYREG_B0_UDB05_ST
.set PWM_1_PWMUDB_sP16_pwmdp_u0__16BIT_A0_REG, CYREG_B0_UDB04_05_A0
.set PWM_1_PWMUDB_sP16_pwmdp_u0__16BIT_A1_REG, CYREG_B0_UDB04_05_A1
.set PWM_1_PWMUDB_sP16_pwmdp_u0__16BIT_D0_REG, CYREG_B0_UDB04_05_D0
.set PWM_1_PWMUDB_sP16_pwmdp_u0__16BIT_D1_REG, CYREG_B0_UDB04_05_D1
.set PWM_1_PWMUDB_sP16_pwmdp_u0__16BIT_DP_AUX_CTL_REG, CYREG_B0_UDB04_05_ACTL
.set PWM_1_PWMUDB_sP16_pwmdp_u0__16BIT_F0_REG, CYREG_B0_UDB04_05_F0
.set PWM_1_PWMUDB_sP16_pwmdp_u0__16BIT_F1_REG, CYREG_B0_UDB04_05_F1
.set PWM_1_PWMUDB_sP16_pwmdp_u0__A0_A1_REG, CYREG_B0_UDB04_A0_A1
.set PWM_1_PWMUDB_sP16_pwmdp_u0__A0_REG, CYREG_B0_UDB04_A0
.set PWM_1_PWMUDB_sP16_pwmdp_u0__A1_REG, CYREG_B0_UDB04_A1
.set PWM_1_PWMUDB_sP16_pwmdp_u0__D0_D1_REG, CYREG_B0_UDB04_D0_D1
.set PWM_1_PWMUDB_sP16_pwmdp_u0__D0_REG, CYREG_B0_UDB04_D0
.set PWM_1_PWMUDB_sP16_pwmdp_u0__D1_REG, CYREG_B0_UDB04_D1
.set PWM_1_PWMUDB_sP16_pwmdp_u0__DP_AUX_CTL_REG, CYREG_B0_UDB04_ACTL
.set PWM_1_PWMUDB_sP16_pwmdp_u0__F0_F1_REG, CYREG_B0_UDB04_F0_F1
.set PWM_1_PWMUDB_sP16_pwmdp_u0__F0_REG, CYREG_B0_UDB04_F0
.set PWM_1_PWMUDB_sP16_pwmdp_u0__F1_REG, CYREG_B0_UDB04_F1
.set PWM_1_PWMUDB_sP16_pwmdp_u1__16BIT_A0_REG, CYREG_B0_UDB05_06_A0
.set PWM_1_PWMUDB_sP16_pwmdp_u1__16BIT_A1_REG, CYREG_B0_UDB05_06_A1
.set PWM_1_PWMUDB_sP16_pwmdp_u1__16BIT_D0_REG, CYREG_B0_UDB05_06_D0
.set PWM_1_PWMUDB_sP16_pwmdp_u1__16BIT_D1_REG, CYREG_B0_UDB05_06_D1
.set PWM_1_PWMUDB_sP16_pwmdp_u1__16BIT_DP_AUX_CTL_REG, CYREG_B0_UDB05_06_ACTL
.set PWM_1_PWMUDB_sP16_pwmdp_u1__16BIT_F0_REG, CYREG_B0_UDB05_06_F0
.set PWM_1_PWMUDB_sP16_pwmdp_u1__16BIT_F1_REG, CYREG_B0_UDB05_06_F1
.set PWM_1_PWMUDB_sP16_pwmdp_u1__A0_A1_REG, CYREG_B0_UDB05_A0_A1
.set PWM_1_PWMUDB_sP16_pwmdp_u1__A0_REG, CYREG_B0_UDB05_A0
.set PWM_1_PWMUDB_sP16_pwmdp_u1__A1_REG, CYREG_B0_UDB05_A1
.set PWM_1_PWMUDB_sP16_pwmdp_u1__D0_D1_REG, CYREG_B0_UDB05_D0_D1
.set PWM_1_PWMUDB_sP16_pwmdp_u1__D0_REG, CYREG_B0_UDB05_D0
.set PWM_1_PWMUDB_sP16_pwmdp_u1__D1_REG, CYREG_B0_UDB05_D1
.set PWM_1_PWMUDB_sP16_pwmdp_u1__DP_AUX_CTL_REG, CYREG_B0_UDB05_ACTL
.set PWM_1_PWMUDB_sP16_pwmdp_u1__F0_F1_REG, CYREG_B0_UDB05_F0_F1
.set PWM_1_PWMUDB_sP16_pwmdp_u1__F0_REG, CYREG_B0_UDB05_F0
.set PWM_1_PWMUDB_sP16_pwmdp_u1__F1_REG, CYREG_B0_UDB05_F1
.set PWM_1_PWMUDB_sP16_pwmdp_u1__MSK_DP_AUX_CTL_REG, CYREG_B0_UDB05_MSK_ACTL
.set PWM_1_PWMUDB_sP16_pwmdp_u1__PER_DP_AUX_CTL_REG, CYREG_B0_UDB05_MSK_ACTL

/* PWM_2 */
.set PWM_2_PWMUDB_genblk1_ctrlreg__0__MASK, 0x01
.set PWM_2_PWMUDB_genblk1_ctrlreg__0__POS, 0
.set PWM_2_PWMUDB_genblk1_ctrlreg__1__MASK, 0x02
.set PWM_2_PWMUDB_genblk1_ctrlreg__1__POS, 1
.set PWM_2_PWMUDB_genblk1_ctrlreg__16BIT_CONTROL_AUX_CTL_REG, CYREG_B0_UDB07_08_ACTL
.set PWM_2_PWMUDB_genblk1_ctrlreg__16BIT_CONTROL_CONTROL_REG, CYREG_B0_UDB07_08_CTL
.set PWM_2_PWMUDB_genblk1_ctrlreg__16BIT_CONTROL_COUNT_REG, CYREG_B0_UDB07_08_CTL
.set PWM_2_PWMUDB_genblk1_ctrlreg__16BIT_COUNT_CONTROL_REG, CYREG_B0_UDB07_08_CTL
.set PWM_2_PWMUDB_genblk1_ctrlreg__16BIT_COUNT_COUNT_REG, CYREG_B0_UDB07_08_CTL
.set PWM_2_PWMUDB_genblk1_ctrlreg__16BIT_MASK_MASK_REG, CYREG_B0_UDB07_08_MSK
.set PWM_2_PWMUDB_genblk1_ctrlreg__16BIT_MASK_PERIOD_REG, CYREG_B0_UDB07_08_MSK
.set PWM_2_PWMUDB_genblk1_ctrlreg__16BIT_PERIOD_MASK_REG, CYREG_B0_UDB07_08_MSK
.set PWM_2_PWMUDB_genblk1_ctrlreg__16BIT_PERIOD_PERIOD_REG, CYREG_B0_UDB07_08_MSK
.set PWM_2_PWMUDB_genblk1_ctrlreg__2__MASK, 0x04
.set PWM_2_PWMUDB_genblk1_ctrlreg__2__POS, 2
.set PWM_2_PWMUDB_genblk1_ctrlreg__7__MASK, 0x80
.set PWM_2_PWMUDB_genblk1_ctrlreg__7__POS, 7
.set PWM_2_PWMUDB_genblk1_ctrlreg__CONTROL_AUX_CTL_REG, CYREG_B0_UDB07_ACTL
.set PWM_2_PWMUDB_genblk1_ctrlreg__CONTROL_REG, CYREG_B0_UDB07_CTL
.set PWM_2_PWMUDB_genblk1_ctrlreg__CONTROL_ST_REG, CYREG_B0_UDB07_ST_CTL
.set PWM_2_PWMUDB_genblk1_ctrlreg__COUNT_REG, CYREG_B0_UDB07_CTL
.set PWM_2_PWMUDB_genblk1_ctrlreg__COUNT_ST_REG, CYREG_B0_UDB07_ST_CTL
.set PWM_2_PWMUDB_genblk1_ctrlreg__MASK, 0x87
.set PWM_2_PWMUDB_genblk1_ctrlreg__MASK_CTL_AUX_CTL_REG, CYREG_B0_UDB07_MSK_ACTL
.set PWM_2_PWMUDB_genblk1_ctrlreg__PER_CTL_AUX_CTL_REG, CYREG_B0_UDB07_MSK_ACTL
.set PWM_2_PWMUDB_genblk1_ctrlreg__PERIOD_REG, CYREG_B0_UDB07_MSK
.set PWM_2_PWMUDB_genblk8_stsreg__0__MASK, 0x01
.set PWM_2_PWMUDB_genblk8_stsreg__0__POS, 0
.set PWM_2_PWMUDB_genblk8_stsreg__1__MASK, 0x02
.set PWM_2_PWMUDB_genblk8_stsreg__1__POS, 1
.set PWM_2_PWMUDB_genblk8_stsreg__16BIT_STATUS_AUX_CTL_REG, CYREG_B0_UDB07_08_ACTL
.set PWM_2_PWMUDB_genblk8_stsreg__16BIT_STATUS_REG, CYREG_B0_UDB07_08_ST
.set PWM_2_PWMUDB_genblk8_stsreg__2__MASK, 0x04
.set PWM_2_PWMUDB_genblk8_stsreg__2__POS, 2
.set PWM_2_PWMUDB_genblk8_stsreg__3__MASK, 0x08
.set PWM_2_PWMUDB_genblk8_stsreg__3__POS, 3
.set PWM_2_PWMUDB_genblk8_stsreg__MASK, 0x0F
.set PWM_2_PWMUDB_genblk8_stsreg__MASK_REG, CYREG_B0_UDB07_MSK
.set PWM_2_PWMUDB_genblk8_stsreg__MASK_ST_AUX_CTL_REG, CYREG_B0_UDB07_MSK_ACTL
.set PWM_2_PWMUDB_genblk8_stsreg__PER_ST_AUX_CTL_REG, CYREG_B0_UDB07_MSK_ACTL
.set PWM_2_PWMUDB_genblk8_stsreg__STATUS_AUX_CTL_REG, CYREG_B0_UDB07_ACTL
.set PWM_2_PWMUDB_genblk8_stsreg__STATUS_CNT_REG, CYREG_B0_UDB07_ST_CTL
.set PWM_2_PWMUDB_genblk8_stsreg__STATUS_CONTROL_REG, CYREG_B0_UDB07_ST_CTL
.set PWM_2_PWMUDB_genblk8_stsreg__STATUS_REG, CYREG_B0_UDB07_ST
.set PWM_2_PWMUDB_sP16_pwmdp_u0__16BIT_A0_REG, CYREG_B0_UDB06_07_A0
.set PWM_2_PWMUDB_sP16_pwmdp_u0__16BIT_A1_REG, CYREG_B0_UDB06_07_A1
.set PWM_2_PWMUDB_sP16_pwmdp_u0__16BIT_D0_REG, CYREG_B0_UDB06_07_D0
.set PWM_2_PWMUDB_sP16_pwmdp_u0__16BIT_D1_REG, CYREG_B0_UDB06_07_D1
.set PWM_2_PWMUDB_sP16_pwmdp_u0__16BIT_DP_AUX_CTL_REG, CYREG_B0_UDB06_07_ACTL
.set PWM_2_PWMUDB_sP16_pwmdp_u0__16BIT_F0_REG, CYREG_B0_UDB06_07_F0
.set PWM_2_PWMUDB_sP16_pwmdp_u0__16BIT_F1_REG, CYREG_B0_UDB06_07_F1
.set PWM_2_PWMUDB_sP16_pwmdp_u0__A0_A1_REG, CYREG_B0_UDB06_A0_A1
.set PWM_2_PWMUDB_sP16_pwmdp_u0__A0_REG, CYREG_B0_UDB06_A0
.set PWM_2_PWMUDB_sP16_pwmdp_u0__A1_REG, CYREG_B0_UDB06_A1
.set PWM_2_PWMUDB_sP16_pwmdp_u0__D0_D1_REG, CYREG_B0_UDB06_D0_D1
.set PWM_2_PWMUDB_sP16_pwmdp_u0__D0_REG, CYREG_B0_UDB06_D0
.set PWM_2_PWMUDB_sP16_pwmdp_u0__D1_REG, CYREG_B0_UDB06_D1
.set PWM_2_PWMUDB_sP16_pwmdp_u0__DP_AUX_CTL_REG, CYREG_B0_UDB06_ACTL
.set PWM_2_PWMUDB_sP16_pwmdp_u0__F0_F1_REG, CYREG_B0_UDB06_F0_F1
.set PWM_2_PWMUDB_sP16_pwmdp_u0__F0_REG, CYREG_B0_UDB06_F0
.set PWM_2_PWMUDB_sP16_pwmdp_u0__F1_REG, CYREG_B0_UDB06_F1
.set PWM_2_PWMUDB_sP16_pwmdp_u1__16BIT_A0_REG, CYREG_B0_UDB07_08_A0
.set PWM_2_PWMUDB_sP16_pwmdp_u1__16BIT_A1_REG, CYREG_B0_UDB07_08_A1
.set PWM_2_PWMUDB_sP16_pwmdp_u1__16BIT_D0_REG, CYREG_B0_UDB07_08_D0
.set PWM_2_PWMUDB_sP16_pwmdp_u1__16BIT_D1_REG, CYREG_B0_UDB07_08_D1
.set PWM_2_PWMUDB_sP16_pwmdp_u1__16BIT_DP_AUX_CTL_REG, CYREG_B0_UDB07_08_ACTL
.set PWM_2_PWMUDB_sP16_pwmdp_u1__16BIT_F0_REG, CYREG_B0_UDB07_08_F0
.set PWM_2_PWMUDB_sP16_pwmdp_u1__16BIT_F1_REG, CYREG_B0_UDB07_08_F1
.set PWM_2_PWMUDB_sP16_pwmdp_u1__A0_A1_REG, CYREG_B0_UDB07_A0_A1
.set PWM_2_PWMUDB_sP16_pwmdp_u1__A0_REG, CYREG_B0_UDB07_A0
.set PWM_2_PWMUDB_sP16_pwmdp_u1__A1_REG, CYREG_B0_UDB07_A1
.set PWM_2_PWMUDB_sP16_pwmdp_u1__D0_D1_REG, CYREG_B0_UDB07_D0_D1
.set PWM_2_PWMUDB_sP16_pwmdp_u1__D0_REG, CYREG_B0_UDB07_D0
.set PWM_2_PWMUDB_sP16_pwmdp_u1__D1_REG, CYREG_B0_UDB07_D1
.set PWM_2_PWMUDB_sP16_pwmdp_u1__DP_AUX_CTL_REG, CYREG_B0_UDB07_ACTL
.set PWM_2_PWMUDB_sP16_pwmdp_u1__F0_F1_REG, CYREG_B0_UDB07_F0_F1
.set PWM_2_PWMUDB_sP16_pwmdp_u1__F0_REG, CYREG_B0_UDB07_F0
.set PWM_2_PWMUDB_sP16_pwmdp_u1__F1_REG, CYREG_B0_UDB07_F1
.set PWM_2_PWMUDB_sP16_pwmdp_u1__MSK_DP_AUX_CTL_REG, CYREG_B0_UDB07_MSK_ACTL
.set PWM_2_PWMUDB_sP16_pwmdp_u1__PER_DP_AUX_CTL_REG, CYREG_B0_UDB07_MSK_ACTL

/* Row1 */
.set Row1__0__INTTYPE, CYREG_PICU2_INTTYPE0
.set Row1__0__MASK, 0x01
.set Row1__0__PC, CYREG_PRT2_PC0
.set Row1__0__PORT, 2
.set Row1__0__SHIFT, 0
.set Row1__AG, CYREG_PRT2_AG
.set Row1__AMUX, CYREG_PRT2_AMUX
.set Row1__BIE, CYREG_PRT2_BIE
.set Row1__BIT_MASK, CYREG_PRT2_BIT_MASK
.set Row1__BYP, CYREG_PRT2_BYP
.set Row1__CTL, CYREG_PRT2_CTL
.set Row1__DM0, CYREG_PRT2_DM0
.set Row1__DM1, CYREG_PRT2_DM1
.set Row1__DM2, CYREG_PRT2_DM2
.set Row1__DR, CYREG_PRT2_DR
.set Row1__INP_DIS, CYREG_PRT2_INP_DIS
.set Row1__INTTYPE_BASE, CYDEV_PICU_INTTYPE_PICU2_BASE
.set Row1__LCD_COM_SEG, CYREG_PRT2_LCD_COM_SEG
.set Row1__LCD_EN, CYREG_PRT2_LCD_EN
.set Row1__MASK, 0x01
.set Row1__PORT, 2
.set Row1__PRT, CYREG_PRT2_PRT
.set Row1__PRTDSI__CAPS_SEL, CYREG_PRT2_CAPS_SEL
.set Row1__PRTDSI__DBL_SYNC_IN, CYREG_PRT2_DBL_SYNC_IN
.set Row1__PRTDSI__OE_SEL0, CYREG_PRT2_OE_SEL0
.set Row1__PRTDSI__OE_SEL1, CYREG_PRT2_OE_SEL1
.set Row1__PRTDSI__OUT_SEL0, CYREG_PRT2_OUT_SEL0
.set Row1__PRTDSI__OUT_SEL1, CYREG_PRT2_OUT_SEL1
.set Row1__PRTDSI__SYNC_OUT, CYREG_PRT2_SYNC_OUT
.set Row1__PS, CYREG_PRT2_PS
.set Row1__SHIFT, 0
.set Row1__SLW, CYREG_PRT2_SLW

/* Row2 */
.set Row2__0__INTTYPE, CYREG_PICU2_INTTYPE1
.set Row2__0__MASK, 0x02
.set Row2__0__PC, CYREG_PRT2_PC1
.set Row2__0__PORT, 2
.set Row2__0__SHIFT, 1
.set Row2__AG, CYREG_PRT2_AG
.set Row2__AMUX, CYREG_PRT2_AMUX
.set Row2__BIE, CYREG_PRT2_BIE
.set Row2__BIT_MASK, CYREG_PRT2_BIT_MASK
.set Row2__BYP, CYREG_PRT2_BYP
.set Row2__CTL, CYREG_PRT2_CTL
.set Row2__DM0, CYREG_PRT2_DM0
.set Row2__DM1, CYREG_PRT2_DM1
.set Row2__DM2, CYREG_PRT2_DM2
.set Row2__DR, CYREG_PRT2_DR
.set Row2__INP_DIS, CYREG_PRT2_INP_DIS
.set Row2__INTTYPE_BASE, CYDEV_PICU_INTTYPE_PICU2_BASE
.set Row2__LCD_COM_SEG, CYREG_PRT2_LCD_COM_SEG
.set Row2__LCD_EN, CYREG_PRT2_LCD_EN
.set Row2__MASK, 0x02
.set Row2__PORT, 2
.set Row2__PRT, CYREG_PRT2_PRT
.set Row2__PRTDSI__CAPS_SEL, CYREG_PRT2_CAPS_SEL
.set Row2__PRTDSI__DBL_SYNC_IN, CYREG_PRT2_DBL_SYNC_IN
.set Row2__PRTDSI__OE_SEL0, CYREG_PRT2_OE_SEL0
.set Row2__PRTDSI__OE_SEL1, CYREG_PRT2_OE_SEL1
.set Row2__PRTDSI__OUT_SEL0, CYREG_PRT2_OUT_SEL0
.set Row2__PRTDSI__OUT_SEL1, CYREG_PRT2_OUT_SEL1
.set Row2__PRTDSI__SYNC_OUT, CYREG_PRT2_SYNC_OUT
.set Row2__PS, CYREG_PRT2_PS
.set Row2__SHIFT, 1
.set Row2__SLW, CYREG_PRT2_SLW

/* Row3 */
.set Row3__0__INTTYPE, CYREG_PICU2_INTTYPE2
.set Row3__0__MASK, 0x04
.set Row3__0__PC, CYREG_PRT2_PC2
.set Row3__0__PORT, 2
.set Row3__0__SHIFT, 2
.set Row3__AG, CYREG_PRT2_AG
.set Row3__AMUX, CYREG_PRT2_AMUX
.set Row3__BIE, CYREG_PRT2_BIE
.set Row3__BIT_MASK, CYREG_PRT2_BIT_MASK
.set Row3__BYP, CYREG_PRT2_BYP
.set Row3__CTL, CYREG_PRT2_CTL
.set Row3__DM0, CYREG_PRT2_DM0
.set Row3__DM1, CYREG_PRT2_DM1
.set Row3__DM2, CYREG_PRT2_DM2
.set Row3__DR, CYREG_PRT2_DR
.set Row3__INP_DIS, CYREG_PRT2_INP_DIS
.set Row3__INTTYPE_BASE, CYDEV_PICU_INTTYPE_PICU2_BASE
.set Row3__LCD_COM_SEG, CYREG_PRT2_LCD_COM_SEG
.set Row3__LCD_EN, CYREG_PRT2_LCD_EN
.set Row3__MASK, 0x04
.set Row3__PORT, 2
.set Row3__PRT, CYREG_PRT2_PRT
.set Row3__PRTDSI__CAPS_SEL, CYREG_PRT2_CAPS_SEL
.set Row3__PRTDSI__DBL_SYNC_IN, CYREG_PRT2_DBL_SYNC_IN
.set Row3__PRTDSI__OE_SEL0, CYREG_PRT2_OE_SEL0
.set Row3__PRTDSI__OE_SEL1, CYREG_PRT2_OE_SEL1
.set Row3__PRTDSI__OUT_SEL0, CYREG_PRT2_OUT_SEL0
.set Row3__PRTDSI__OUT_SEL1, CYREG_PRT2_OUT_SEL1
.set Row3__PRTDSI__SYNC_OUT, CYREG_PRT2_SYNC_OUT
.set Row3__PS, CYREG_PRT2_PS
.set Row3__SHIFT, 2
.set Row3__SLW, CYREG_PRT2_SLW

/* Row4 */
.set Row4__0__INTTYPE, CYREG_PICU2_INTTYPE3
.set Row4__0__MASK, 0x08
.set Row4__0__PC, CYREG_PRT2_PC3
.set Row4__0__PORT, 2
.set Row4__0__SHIFT, 3
.set Row4__AG, CYREG_PRT2_AG
.set Row4__AMUX, CYREG_PRT2_AMUX
.set Row4__BIE, CYREG_PRT2_BIE
.set Row4__BIT_MASK, CYREG_PRT2_BIT_MASK
.set Row4__BYP, CYREG_PRT2_BYP
.set Row4__CTL, CYREG_PRT2_CTL
.set Row4__DM0, CYREG_PRT2_DM0
.set Row4__DM1, CYREG_PRT2_DM1
.set Row4__DM2, CYREG_PRT2_DM2
.set Row4__DR, CYREG_PRT2_DR
.set Row4__INP_DIS, CYREG_PRT2_INP_DIS
.set Row4__INTTYPE_BASE, CYDEV_PICU_INTTYPE_PICU2_BASE
.set Row4__LCD_COM_SEG, CYREG_PRT2_LCD_COM_SEG
.set Row4__LCD_EN, CYREG_PRT2_LCD_EN
.set Row4__MASK, 0x08
.set Row4__PORT, 2
.set Row4__PRT, CYREG_PRT2_PRT
.set Row4__PRTDSI__CAPS_SEL, CYREG_PRT2_CAPS_SEL
.set Row4__PRTDSI__DBL_SYNC_IN, CYREG_PRT2_DBL_SYNC_IN
.set Row4__PRTDSI__OE_SEL0, CYREG_PRT2_OE_SEL0
.set Row4__PRTDSI__OE_SEL1, CYREG_PRT2_OE_SEL1
.set Row4__PRTDSI__OUT_SEL0, CYREG_PRT2_OUT_SEL0
.set Row4__PRTDSI__OUT_SEL1, CYREG_PRT2_OUT_SEL1
.set Row4__PRTDSI__SYNC_OUT, CYREG_PRT2_SYNC_OUT
.set Row4__PS, CYREG_PRT2_PS
.set Row4__SHIFT, 3
.set Row4__SLW, CYREG_PRT2_SLW

/* Rx_1 */
.set Rx_1__0__INTTYPE, CYREG_PICU12_INTTYPE6
.set Rx_1__0__MASK, 0x40
.set Rx_1__0__PC, CYREG_PRT12_PC6
.set Rx_1__0__PORT, 12
.set Rx_1__0__SHIFT, 6
.set Rx_1__AG, CYREG_PRT12_AG
.set Rx_1__BIE, CYREG_PRT12_BIE
.set Rx_1__BIT_MASK, CYREG_PRT12_BIT_MASK
.set Rx_1__BYP, CYREG_PRT12_BYP
.set Rx_1__DM0, CYREG_PRT12_DM0
.set Rx_1__DM1, CYREG_PRT12_DM1
.set Rx_1__DM2, CYREG_PRT12_DM2
.set Rx_1__DR, CYREG_PRT12_DR
.set Rx_1__INP_DIS, CYREG_PRT12_INP_DIS
.set Rx_1__INTTYPE_BASE, CYDEV_PICU_INTTYPE_PICU12_BASE
.set Rx_1__MASK, 0x40
.set Rx_1__PORT, 12
.set Rx_1__PRT, CYREG_PRT12_PRT
.set Rx_1__PRTDSI__DBL_SYNC_IN, CYREG_PRT12_DBL_SYNC_IN
.set Rx_1__PRTDSI__OE_SEL0, CYREG_PRT12_OE_SEL0
.set Rx_1__PRTDSI__OE_SEL1, CYREG_PRT12_OE_SEL1
.set Rx_1__PRTDSI__OUT_SEL0, CYREG_PRT12_OUT_SEL0
.set Rx_1__PRTDSI__OUT_SEL1, CYREG_PRT12_OUT_SEL1
.set Rx_1__PRTDSI__SYNC_OUT, CYREG_PRT12_SYNC_OUT
.set Rx_1__PS, CYREG_PRT12_PS
.set Rx_1__SHIFT, 6
.set Rx_1__SIO_CFG, CYREG_PRT12_SIO_CFG
.set Rx_1__SIO_DIFF, CYREG_PRT12_SIO_DIFF
.set Rx_1__SIO_HYST_EN, CYREG_PRT12_SIO_HYST_EN
.set Rx_1__SIO_REG_HIFREQ, CYREG_PRT12_SIO_REG_HIFREQ
.set Rx_1__SLW, CYREG_PRT12_SLW

/* Tx_1 */
.set Tx_1__0__INTTYPE, CYREG_PICU12_INTTYPE7
.set Tx_1__0__MASK, 0x80
.set Tx_1__0__PC, CYREG_PRT12_PC7
.set Tx_1__0__PORT, 12
.set Tx_1__0__SHIFT, 7
.set Tx_1__AG, CYREG_PRT12_AG
.set Tx_1__BIE, CYREG_PRT12_BIE
.set Tx_1__BIT_MASK, CYREG_PRT12_BIT_MASK
.set Tx_1__BYP, CYREG_PRT12_BYP
.set Tx_1__DM0, CYREG_PRT12_DM0
.set Tx_1__DM1, CYREG_PRT12_DM1
.set Tx_1__DM2, CYREG_PRT12_DM2
.set Tx_1__DR, CYREG_PRT12_DR
.set Tx_1__INP_DIS, CYREG_PRT12_INP_DIS
.set Tx_1__INTTYPE_BASE, CYDEV_PICU_INTTYPE_PICU12_BASE
.set Tx_1__MASK, 0x80
.set Tx_1__PORT, 12
.set Tx_1__PRT, CYREG_PRT12_PRT
.set Tx_1__PRTDSI__DBL_SYNC_IN, CYREG_PRT12_DBL_SYNC_IN
.set Tx_1__PRTDSI__OE_SEL0, CYREG_PRT12_OE_SEL0
.set Tx_1__PRTDSI__OE_SEL1, CYREG_PRT12_OE_SEL1
.set Tx_1__PRTDSI__OUT_SEL0, CYREG_PRT12_OUT_SEL0
.set Tx_1__PRTDSI__OUT_SEL1, CYREG_PRT12_OUT_SEL1
.set Tx_1__PRTDSI__SYNC_OUT, CYREG_PRT12_SYNC_OUT
.set Tx_1__PS, CYREG_PRT12_PS
.set Tx_1__SHIFT, 7
.set Tx_1__SIO_CFG, CYREG_PRT12_SIO_CFG
.set Tx_1__SIO_DIFF, CYREG_PRT12_SIO_DIFF
.set Tx_1__SIO_HYST_EN, CYREG_PRT12_SIO_HYST_EN
.set Tx_1__SIO_REG_HIFREQ, CYREG_PRT12_SIO_REG_HIFREQ
.set Tx_1__SLW, CYREG_PRT12_SLW

/* UART_BUART */
.set UART_BUART_sRX_RxBitCounter__16BIT_CONTROL_AUX_CTL_REG, CYREG_B1_UDB10_11_ACTL
.set UART_BUART_sRX_RxBitCounter__16BIT_CONTROL_CONTROL_REG, CYREG_B1_UDB10_11_CTL
.set UART_BUART_sRX_RxBitCounter__16BIT_CONTROL_COUNT_REG, CYREG_B1_UDB10_11_CTL
.set UART_BUART_sRX_RxBitCounter__16BIT_COUNT_CONTROL_REG, CYREG_B1_UDB10_11_CTL
.set UART_BUART_sRX_RxBitCounter__16BIT_COUNT_COUNT_REG, CYREG_B1_UDB10_11_CTL
.set UART_BUART_sRX_RxBitCounter__16BIT_MASK_MASK_REG, CYREG_B1_UDB10_11_MSK
.set UART_BUART_sRX_RxBitCounter__16BIT_MASK_PERIOD_REG, CYREG_B1_UDB10_11_MSK
.set UART_BUART_sRX_RxBitCounter__16BIT_PERIOD_MASK_REG, CYREG_B1_UDB10_11_MSK
.set UART_BUART_sRX_RxBitCounter__16BIT_PERIOD_PERIOD_REG, CYREG_B1_UDB10_11_MSK
.set UART_BUART_sRX_RxBitCounter__CONTROL_AUX_CTL_REG, CYREG_B1_UDB10_ACTL
.set UART_BUART_sRX_RxBitCounter__CONTROL_REG, CYREG_B1_UDB10_CTL
.set UART_BUART_sRX_RxBitCounter__CONTROL_ST_REG, CYREG_B1_UDB10_ST_CTL
.set UART_BUART_sRX_RxBitCounter__COUNT_REG, CYREG_B1_UDB10_CTL
.set UART_BUART_sRX_RxBitCounter__COUNT_ST_REG, CYREG_B1_UDB10_ST_CTL
.set UART_BUART_sRX_RxBitCounter__MASK_CTL_AUX_CTL_REG, CYREG_B1_UDB10_MSK_ACTL
.set UART_BUART_sRX_RxBitCounter__PER_CTL_AUX_CTL_REG, CYREG_B1_UDB10_MSK_ACTL
.set UART_BUART_sRX_RxBitCounter__PERIOD_REG, CYREG_B1_UDB10_MSK
.set UART_BUART_sRX_RxBitCounter_ST__16BIT_STATUS_AUX_CTL_REG, CYREG_B1_UDB10_11_ACTL
.set UART_BUART_sRX_RxBitCounter_ST__16BIT_STATUS_REG, CYREG_B1_UDB10_11_ST
.set UART_BUART_sRX_RxBitCounter_ST__MASK_REG, CYREG_B1_UDB10_MSK
.set UART_BUART_sRX_RxBitCounter_ST__MASK_ST_AUX_CTL_REG, CYREG_B1_UDB10_MSK_ACTL
.set UART_BUART_sRX_RxBitCounter_ST__PER_ST_AUX_CTL_REG, CYREG_B1_UDB10_MSK_ACTL
.set UART_BUART_sRX_RxBitCounter_ST__STATUS_AUX_CTL_REG, CYREG_B1_UDB10_ACTL
.set UART_BUART_sRX_RxBitCounter_ST__STATUS_CNT_REG, CYREG_B1_UDB10_ST_CTL
.set UART_BUART_sRX_RxBitCounter_ST__STATUS_CONTROL_REG, CYREG_B1_UDB10_ST_CTL
.set UART_BUART_sRX_RxBitCounter_ST__STATUS_REG, CYREG_B1_UDB10_ST
.set UART_BUART_sRX_RxShifter_u0__16BIT_A0_REG, CYREG_B1_UDB09_10_A0
.set UART_BUART_sRX_RxShifter_u0__16BIT_A1_REG, CYREG_B1_UDB09_10_A1
.set UART_BUART_sRX_RxShifter_u0__16BIT_D0_REG, CYREG_B1_UDB09_10_D0
.set UART_BUART_sRX_RxShifter_u0__16BIT_D1_REG, CYREG_B1_UDB09_10_D1
.set UART_BUART_sRX_RxShifter_u0__16BIT_DP_AUX_CTL_REG, CYREG_B1_UDB09_10_ACTL
.set UART_BUART_sRX_RxShifter_u0__16BIT_F0_REG, CYREG_B1_UDB09_10_F0
.set UART_BUART_sRX_RxShifter_u0__16BIT_F1_REG, CYREG_B1_UDB09_10_F1
.set UART_BUART_sRX_RxShifter_u0__A0_A1_REG, CYREG_B1_UDB09_A0_A1
.set UART_BUART_sRX_RxShifter_u0__A0_REG, CYREG_B1_UDB09_A0
.set UART_BUART_sRX_RxShifter_u0__A1_REG, CYREG_B1_UDB09_A1
.set UART_BUART_sRX_RxShifter_u0__D0_D1_REG, CYREG_B1_UDB09_D0_D1
.set UART_BUART_sRX_RxShifter_u0__D0_REG, CYREG_B1_UDB09_D0
.set UART_BUART_sRX_RxShifter_u0__D1_REG, CYREG_B1_UDB09_D1
.set UART_BUART_sRX_RxShifter_u0__DP_AUX_CTL_REG, CYREG_B1_UDB09_ACTL
.set UART_BUART_sRX_RxShifter_u0__F0_F1_REG, CYREG_B1_UDB09_F0_F1
.set UART_BUART_sRX_RxShifter_u0__F0_REG, CYREG_B1_UDB09_F0
.set UART_BUART_sRX_RxShifter_u0__F1_REG, CYREG_B1_UDB09_F1
.set UART_BUART_sRX_RxSts__16BIT_STATUS_AUX_CTL_REG, CYREG_B0_UDB09_10_ACTL
.set UART_BUART_sRX_RxSts__16BIT_STATUS_REG, CYREG_B0_UDB09_10_ST
.set UART_BUART_sRX_RxSts__3__MASK, 0x08
.set UART_BUART_sRX_RxSts__3__POS, 3
.set UART_BUART_sRX_RxSts__4__MASK, 0x10
.set UART_BUART_sRX_RxSts__4__POS, 4
.set UART_BUART_sRX_RxSts__5__MASK, 0x20
.set UART_BUART_sRX_RxSts__5__POS, 5
.set UART_BUART_sRX_RxSts__MASK, 0x38
.set UART_BUART_sRX_RxSts__MASK_REG, CYREG_B0_UDB09_MSK
.set UART_BUART_sRX_RxSts__STATUS_AUX_CTL_REG, CYREG_B0_UDB09_ACTL
.set UART_BUART_sRX_RxSts__STATUS_REG, CYREG_B0_UDB09_ST
.set UART_BUART_sTX_sCLOCK_TxBitClkGen__16BIT_A0_REG, CYREG_B0_UDB08_09_A0
.set UART_BUART_sTX_sCLOCK_TxBitClkGen__16BIT_A1_REG, CYREG_B0_UDB08_09_A1
.set UART_BUART_sTX_sCLOCK_TxBitClkGen__16BIT_D0_REG, CYREG_B0_UDB08_09_D0
.set UART_BUART_sTX_sCLOCK_TxBitClkGen__16BIT_D1_REG, CYREG_B0_UDB08_09_D1
.set UART_BUART_sTX_sCLOCK_TxBitClkGen__16BIT_DP_AUX_CTL_REG, CYREG_B0_UDB08_09_ACTL
.set UART_BUART_sTX_sCLOCK_TxBitClkGen__16BIT_F0_REG, CYREG_B0_UDB08_09_F0
.set UART_BUART_sTX_sCLOCK_TxBitClkGen__16BIT_F1_REG, CYREG_B0_UDB08_09_F1
.set UART_BUART_sTX_sCLOCK_TxBitClkGen__A0_A1_REG, CYREG_B0_UDB08_A0_A1
.set UART_BUART_sTX_sCLOCK_TxBitClkGen__A0_REG, CYREG_B0_UDB08_A0
.set UART_BUART_sTX_sCLOCK_TxBitClkGen__A1_REG, CYREG_B0_UDB08_A1
.set UART_BUART_sTX_sCLOCK_TxBitClkGen__D0_D1_REG, CYREG_B0_UDB08_D0_D1
.set UART_BUART_sTX_sCLOCK_TxBitClkGen__D0_REG, CYREG_B0_UDB08_D0
.set UART_BUART_sTX_sCLOCK_TxBitClkGen__D1_REG, CYREG_B0_UDB08_D1
.set UART_BUART_sTX_sCLOCK_TxBitClkGen__DP_AUX_CTL_REG, CYREG_B0_UDB08_ACTL
.set UART_BUART_sTX_sCLOCK_TxBitClkGen__F0_F1_REG, CYREG_B0_UDB08_F0_F1
.set UART_BUART_sTX_sCLOCK_TxBitClkGen__F0_REG, CYREG_B0_UDB08_F0
.set UART_BUART_sTX_sCLOCK_TxBitClkGen__F1_REG, CYREG_B0_UDB08_F1
.set UART_BUART_sTX_TxShifter_u0__A0_A1_REG, CYREG_B1_UDB11_A0_A1
.set UART_BUART_sTX_TxShifter_u0__A0_REG, CYREG_B1_UDB11_A0
.set UART_BUART_sTX_TxShifter_u0__A1_REG, CYREG_B1_UDB11_A1
.set UART_BUART_sTX_TxShifter_u0__D0_D1_REG, CYREG_B1_UDB11_D0_D1
.set UART_BUART_sTX_TxShifter_u0__D0_REG, CYREG_B1_UDB11_D0
.set UART_BUART_sTX_TxShifter_u0__D1_REG, CYREG_B1_UDB11_D1
.set UART_BUART_sTX_TxShifter_u0__DP_AUX_CTL_REG, CYREG_B1_UDB11_ACTL
.set UART_BUART_sTX_TxShifter_u0__F0_F1_REG, CYREG_B1_UDB11_F0_F1
.set UART_BUART_sTX_TxShifter_u0__F0_REG, CYREG_B1_UDB11_F0
.set UART_BUART_sTX_TxShifter_u0__F1_REG, CYREG_B1_UDB11_F1
.set UART_BUART_sTX_TxSts__0__MASK, 0x01
.set UART_BUART_sTX_TxSts__0__POS, 0
.set UART_BUART_sTX_TxSts__1__MASK, 0x02
.set UART_BUART_sTX_TxSts__1__POS, 1
.set UART_BUART_sTX_TxSts__16BIT_STATUS_AUX_CTL_REG, CYREG_B1_UDB08_09_ACTL
.set UART_BUART_sTX_TxSts__16BIT_STATUS_REG, CYREG_B1_UDB08_09_ST
.set UART_BUART_sTX_TxSts__2__MASK, 0x04
.set UART_BUART_sTX_TxSts__2__POS, 2
.set UART_BUART_sTX_TxSts__3__MASK, 0x08
.set UART_BUART_sTX_TxSts__3__POS, 3
.set UART_BUART_sTX_TxSts__MASK, 0x0F
.set UART_BUART_sTX_TxSts__MASK_REG, CYREG_B1_UDB08_MSK
.set UART_BUART_sTX_TxSts__STATUS_AUX_CTL_REG, CYREG_B1_UDB08_ACTL
.set UART_BUART_sTX_TxSts__STATUS_REG, CYREG_B1_UDB08_ST

/* UART_IntClock */
.set UART_IntClock__CFG0, CYREG_CLKDIST_DCFG0_CFG0
.set UART_IntClock__CFG1, CYREG_CLKDIST_DCFG0_CFG1
.set UART_IntClock__CFG2, CYREG_CLKDIST_DCFG0_CFG2
.set UART_IntClock__CFG2_SRC_SEL_MASK, 0x07
.set UART_IntClock__INDEX, 0x00
.set UART_IntClock__PM_ACT_CFG, CYREG_PM_ACT_CFG2
.set UART_IntClock__PM_ACT_MSK, 0x01
.set UART_IntClock__PM_STBY_CFG, CYREG_PM_STBY_CFG2
.set UART_IntClock__PM_STBY_MSK, 0x01

/* Miscellaneous */
.set BCLK__BUS_CLK__HZ, 24000000
.set BCLK__BUS_CLK__KHZ, 24000
.set BCLK__BUS_CLK__MHZ, 24
.set CYDEV_CHIP_DIE_LEOPARD, 1
.set CYDEV_CHIP_DIE_PSOC4A, 16
.set CYDEV_CHIP_DIE_PSOC5LP, 2
.set CYDEV_CHIP_DIE_PSOC5TM, 3
.set CYDEV_CHIP_DIE_TMA4, 4
.set CYDEV_CHIP_DIE_UNKNOWN, 0
.set CYDEV_CHIP_FAMILY_FM0P, 5
.set CYDEV_CHIP_FAMILY_FM3, 6
.set CYDEV_CHIP_FAMILY_FM4, 7
.set CYDEV_CHIP_FAMILY_PSOC3, 1
.set CYDEV_CHIP_FAMILY_PSOC4, 2
.set CYDEV_CHIP_FAMILY_PSOC5, 3
.set CYDEV_CHIP_FAMILY_PSOC6, 4
.set CYDEV_CHIP_FAMILY_UNKNOWN, 0
.set CYDEV_CHIP_FAMILY_USED, CYDEV_CHIP_FAMILY_PSOC5
.set CYDEV_CHIP_JTAG_ID, 0x2E161069
.set CYDEV_CHIP_MEMBER_3A, 1
.set CYDEV_CHIP_MEMBER_4A, 16
.set CYDEV_CHIP_MEMBER_4D, 12
.set CYDEV_CHIP_MEMBER_4E, 6
.set CYDEV_CHIP_MEMBER_4F, 17
.set CYDEV_CHIP_MEMBER_4G, 4
.set CYDEV_CHIP_MEMBER_4H, 15
.set CYDEV_CHIP_MEMBER_4I, 21
.set CYDEV_CHIP_MEMBER_4J, 13
.set CYDEV_CHIP_MEMBER_4K, 14
.set CYDEV_CHIP_MEMBER_4L, 20
.set CYDEV_CHIP_MEMBER_4M, 19
.set CYDEV_CHIP_MEMBER_4N, 9
.set CYDEV_CHIP_MEMBER_4O, 7
.set CYDEV_CHIP_MEMBER_4P, 18
.set CYDEV_CHIP_MEMBER_4Q, 11
.set CYDEV_CHIP_MEMBER_4R, 8
.set CYDEV_CHIP_MEMBER_4S, 10
.set CYDEV_CHIP_MEMBER_4U, 5
.set CYDEV_CHIP_MEMBER_5A, 3
.set CYDEV_CHIP_MEMBER_5B, 2
.set CYDEV_CHIP_MEMBER_6A, 22
.set CYDEV_CHIP_MEMBER_FM3, 26
.set CYDEV_CHIP_MEMBER_FM4, 27
.set CYDEV_CHIP_MEMBER_PDL_FM0P_TYPE1, 23
.set CYDEV_CHIP_MEMBER_PDL_FM0P_TYPE2, 24
.set CYDEV_CHIP_MEMBER_PDL_FM0P_TYPE3, 25
.set CYDEV_CHIP_MEMBER_UNKNOWN, 0
.set CYDEV_CHIP_MEMBER_USED, CYDEV_CHIP_MEMBER_5B
.set CYDEV_CHIP_DIE_EXPECT, CYDEV_CHIP_MEMBER_USED
.set CYDEV_CHIP_DIE_ACTUAL, CYDEV_CHIP_DIE_EXPECT
.set CYDEV_CHIP_REV_LEOPARD_ES1, 0
.set CYDEV_CHIP_REV_LEOPARD_ES2, 1
.set CYDEV_CHIP_REV_LEOPARD_ES3, 3
.set CYDEV_CHIP_REV_LEOPARD_PRODUCTION, 3
.set CYDEV_CHIP_REV_PSOC4A_ES0, 17
.set CYDEV_CHIP_REV_PSOC4A_PRODUCTION, 17
.set CYDEV_CHIP_REV_PSOC5LP_ES0, 0
.set CYDEV_CHIP_REV_PSOC5LP_PRODUCTION, 0
.set CYDEV_CHIP_REV_PSOC5TM_ES0, 0
.set CYDEV_CHIP_REV_PSOC5TM_ES1, 1
.set CYDEV_CHIP_REV_PSOC5TM_PRODUCTION, 1
.set CYDEV_CHIP_REV_TMA4_ES, 17
.set CYDEV_CHIP_REV_TMA4_ES2, 33
.set CYDEV_CHIP_REV_TMA4_PRODUCTION, 17
.set CYDEV_CHIP_REVISION_3A_ES1, 0
.set CYDEV_CHIP_REVISION_3A_ES2, 1
.set CYDEV_CHIP_REVISION_3A_ES3, 3
.set CYDEV_CHIP_REVISION_3A_PRODUCTION, 3
.set CYDEV_CHIP_REVISION_4A_ES0, 17
.set CYDEV_CHIP_REVISION_4A_PRODUCTION, 17
.set CYDEV_CHIP_REVISION_4D_PRODUCTION, 0
.set CYDEV_CHIP_REVISION_4E_PRODUCTION, 0
.set CYDEV_CHIP_REVISION_4F_PRODUCTION, 0
.set CYDEV_CHIP_REVISION_4F_PRODUCTION_256DMA, 0
.set CYDEV_CHIP_REVISION_4F_PRODUCTION_256K, 0
.set CYDEV_CHIP_REVISION_4G_ES, 17
.set CYDEV_CHIP_REVISION_4G_ES2, 33
.set CYDEV_CHIP_REVISION_4G_PRODUCTION, 17
.set CYDEV_CHIP_REVISION_4H_PRODUCTION, 0
.set CYDEV_CHIP_REVISION_4I_PRODUCTION, 0
.set CYDEV_CHIP_REVISION_4J_PRODUCTION, 0
.set CYDEV_CHIP_REVISION_4K_PRODUCTION, 0
.set CYDEV_CHIP_REVISION_4L_PRODUCTION, 0
.set CYDEV_CHIP_REVISION_4M_PRODUCTION, 0
.set CYDEV_CHIP_REVISION_4N_PRODUCTION, 0
.set CYDEV_CHIP_REVISION_4O_PRODUCTION, 0
.set CYDEV_CHIP_REVISION_4P_PRODUCTION, 0
.set CYDEV_CHIP_REVISION_4Q_PRODUCTION, 0
.set CYDEV_CHIP_REVISION_4R_PRODUCTION, 0
.set CYDEV_CHIP_REVISION_4S_PRODUCTION, 0
.set CYDEV_CHIP_REVISION_4U_PRODUCTION, 0
.set CYDEV_CHIP_REVISION_5A_ES0, 0
.set CYDEV_CHIP_REVISION_5A_ES1, 1
.set CYDEV_CHIP_REVISION_5A_PRODUCTION, 1
.set CYDEV_CHIP_REVISION_5B_ES0, 0
.set CYDEV_CHIP_REVISION_5B_PRODUCTION, 0
.set CYDEV_CHIP_REVISION_6A_NO_UDB, 0
.set CYDEV_CHIP_REVISION_6A_PRODUCTION, 0
.set CYDEV_CHIP_REVISION_FM3_PRODUCTION, 0
.set CYDEV_CHIP_REVISION_FM4_PRODUCTION, 0
.set CYDEV_CHIP_REVISION_PDL_FM0P_TYPE1_PRODUCTION, 0
.set CYDEV_CHIP_REVISION_PDL_FM0P_TYPE2_PRODUCTION, 0
.set CYDEV_CHIP_REVISION_PDL_FM0P_TYPE3_PRODUCTION, 0
.set CYDEV_CHIP_REVISION_USED, CYDEV_CHIP_REVISION_5B_PRODUCTION
.set CYDEV_CHIP_REV_EXPECT, CYDEV_CHIP_REVISION_USED
.set CYDEV_CONFIG_FASTBOOT_ENABLED, 1
.set CYDEV_CONFIG_UNUSED_IO_AllowButWarn, 0
.set CYDEV_CONFIG_UNUSED_IO, CYDEV_CONFIG_UNUSED_IO_AllowButWarn
.set CYDEV_CONFIG_UNUSED_IO_AllowWithInfo, 1
.set CYDEV_CONFIG_UNUSED_IO_Disallowed, 2
.set CYDEV_CONFIGURATION_COMPRESSED, 1
.set CYDEV_CONFIGURATION_DMA, 0
.set CYDEV_CONFIGURATION_ECC, 1
.set CYDEV_CONFIGURATION_IMOENABLED, CYDEV_CONFIG_FASTBOOT_ENABLED
.set CYDEV_CONFIGURATION_MODE_COMPRESSED, 0
.set CYDEV_CONFIGURATION_MODE, CYDEV_CONFIGURATION_MODE_COMPRESSED
.set CYDEV_CONFIGURATION_MODE_DMA, 2
.set CYDEV_CONFIGURATION_MODE_UNCOMPRESSED, 1
.set CYDEV_DEBUG_ENABLE_MASK, 0x20
.set CYDEV_DEBUG_ENABLE_REGISTER, CYREG_MLOGIC_DEBUG
.set CYDEV_DEBUGGING_DPS_Disable, 3
.set CYDEV_DEBUGGING_DPS_JTAG_4, 1
.set CYDEV_DEBUGGING_DPS_JTAG_5, 0
.set CYDEV_DEBUGGING_DPS_SWD, 2
.set CYDEV_DEBUGGING_DPS_SWD_SWV, 6
.set CYDEV_DEBUGGING_DPS, CYDEV_DEBUGGING_DPS_SWD_SWV
.set CYDEV_DEBUGGING_ENABLE, 1
.set CYDEV_DEBUGGING_XRES, 0
.set CYDEV_DMA_CHANNELS_AVAILABLE, 24
.set CYDEV_ECC_ENABLE, 0
.set CYDEV_HEAP_SIZE, 0x80
.set CYDEV_INSTRUCT_CACHE_ENABLED, 1
.set CYDEV_INTR_RISING, 0x00000000
.set CYDEV_IS_EXPORTING_CODE, 0
.set CYDEV_IS_IMPORTING_CODE, 0
.set CYDEV_PROJ_TYPE, 0
.set CYDEV_PROJ_TYPE_BOOTLOADER, 1
.set CYDEV_PROJ_TYPE_LAUNCHER, 5
.set CYDEV_PROJ_TYPE_LOADABLE, 2
.set CYDEV_PROJ_TYPE_LOADABLEANDBOOTLOADER, 4
.set CYDEV_PROJ_TYPE_MULTIAPPBOOTLOADER, 3
.set CYDEV_PROJ_TYPE_STANDARD, 0
.set CYDEV_PROTECTION_ENABLE, 0
.set CYDEV_STACK_SIZE, 0x0800
.set CYDEV_USE_BUNDLED_CMSIS, 1
.set CYDEV_VARIABLE_VDDA, 0
.set CYDEV_VDDA_MV, 5000
.set CYDEV_VDDD_MV, 5000
.set CYDEV_VDDIO0_MV, 5000
.set CYDEV_VDDIO1_MV, 5000
.set CYDEV_VDDIO2_MV, 5000
.set CYDEV_VDDIO3_MV, 5000
.set CYDEV_VIO0_MV, 5000
.set CYDEV_VIO1_MV, 5000
.set CYDEV_VIO2_MV, 5000
.set CYDEV_VIO3_MV, 5000
.set CYIPBLOCK_ARM_CM3_VERSION, 0
.set CYIPBLOCK_P3_ANAIF_VERSION, 0
.set CYIPBLOCK_P3_CAN_VERSION, 0
.set CYIPBLOCK_P3_CAPSENSE_VERSION, 0
.set CYIPBLOCK_P3_COMP_VERSION, 0
.set CYIPBLOCK_P3_DECIMATOR_VERSION, 0
.set CYIPBLOCK_P3_DFB_VERSION, 0
.set CYIPBLOCK_P3_DMA_VERSION, 0
.set CYIPBLOCK_P3_DRQ_VERSION, 0
.set CYIPBLOCK_P3_DSM_VERSION, 0
.set CYIPBLOCK_P3_EMIF_VERSION, 0
.set CYIPBLOCK_P3_I2C_VERSION, 0
.set CYIPBLOCK_P3_LCD_VERSION, 0
.set CYIPBLOCK_P3_LPF_VERSION, 0
.set CYIPBLOCK_P3_OPAMP_VERSION, 0
.set CYIPBLOCK_P3_PM_VERSION, 0
.set CYIPBLOCK_P3_SCCT_VERSION, 0
.set CYIPBLOCK_P3_TIMER_VERSION, 0
.set CYIPBLOCK_P3_USB_VERSION, 0
.set CYIPBLOCK_P3_VIDAC_VERSION, 0
.set CYIPBLOCK_P3_VREF_VERSION, 0
.set CYIPBLOCK_S8_GPIO_VERSION, 0
.set CYIPBLOCK_S8_IRQ_VERSION, 0
.set CYIPBLOCK_S8_SAR_VERSION, 0
.set CYIPBLOCK_S8_SIO_VERSION, 0
.set CYIPBLOCK_S8_UDB_VERSION, 0
.set DMA_CHANNELS_USED__MASK0, 0x00000000
.set CYDEV_BOOTLOADER_ENABLE, 0
.endif
