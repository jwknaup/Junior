;
; File Name: cyfitteriar.inc
; 
; PSoC Creator  4.1 Update 1
;
; Description:
; 
;
;-------------------------------------------------------------------------------
; Copyright (c) 2007-2017 Cypress Semiconductor.  All rights reserved.
; You may use this file only in accordance with the license, terms, conditions, 
; disclaimers, and limitations in the end user license agreement accompanying 
; the software package with which this file was provided.
;-------------------------------------------------------------------------------

#ifndef INCLUDED_CYFITTERIAR_INC
#define INCLUDED_CYFITTERIAR_INC
    INCLUDE cydeviceiar.inc
    INCLUDE cydeviceiar_trm.inc

/* A */
A__0__INTTYPE EQU CYREG_PICU0_INTTYPE0
A__0__MASK EQU 0x01
A__0__PC EQU CYREG_PRT0_PC0
A__0__PORT EQU 0
A__0__SHIFT EQU 0
A__AG EQU CYREG_PRT0_AG
A__AMUX EQU CYREG_PRT0_AMUX
A__BIE EQU CYREG_PRT0_BIE
A__BIT_MASK EQU CYREG_PRT0_BIT_MASK
A__BYP EQU CYREG_PRT0_BYP
A__CTL EQU CYREG_PRT0_CTL
A__DM0 EQU CYREG_PRT0_DM0
A__DM1 EQU CYREG_PRT0_DM1
A__DM2 EQU CYREG_PRT0_DM2
A__DR EQU CYREG_PRT0_DR
A__INP_DIS EQU CYREG_PRT0_INP_DIS
A__INTTYPE_BASE EQU CYDEV_PICU_INTTYPE_PICU0_BASE
A__LCD_COM_SEG EQU CYREG_PRT0_LCD_COM_SEG
A__LCD_EN EQU CYREG_PRT0_LCD_EN
A__MASK EQU 0x01
A__PORT EQU 0
A__PRT EQU CYREG_PRT0_PRT
A__PRTDSI__CAPS_SEL EQU CYREG_PRT0_CAPS_SEL
A__PRTDSI__DBL_SYNC_IN EQU CYREG_PRT0_DBL_SYNC_IN
A__PRTDSI__OE_SEL0 EQU CYREG_PRT0_OE_SEL0
A__PRTDSI__OE_SEL1 EQU CYREG_PRT0_OE_SEL1
A__PRTDSI__OUT_SEL0 EQU CYREG_PRT0_OUT_SEL0
A__PRTDSI__OUT_SEL1 EQU CYREG_PRT0_OUT_SEL1
A__PRTDSI__SYNC_OUT EQU CYREG_PRT0_SYNC_OUT
A__PS EQU CYREG_PRT0_PS
A__SHIFT EQU 0
A__SLW EQU CYREG_PRT0_SLW

/* B */
B__0__INTTYPE EQU CYREG_PICU0_INTTYPE1
B__0__MASK EQU 0x02
B__0__PC EQU CYREG_PRT0_PC1
B__0__PORT EQU 0
B__0__SHIFT EQU 1
B__AG EQU CYREG_PRT0_AG
B__AMUX EQU CYREG_PRT0_AMUX
B__BIE EQU CYREG_PRT0_BIE
B__BIT_MASK EQU CYREG_PRT0_BIT_MASK
B__BYP EQU CYREG_PRT0_BYP
B__CTL EQU CYREG_PRT0_CTL
B__DM0 EQU CYREG_PRT0_DM0
B__DM1 EQU CYREG_PRT0_DM1
B__DM2 EQU CYREG_PRT0_DM2
B__DR EQU CYREG_PRT0_DR
B__INP_DIS EQU CYREG_PRT0_INP_DIS
B__INTTYPE_BASE EQU CYDEV_PICU_INTTYPE_PICU0_BASE
B__LCD_COM_SEG EQU CYREG_PRT0_LCD_COM_SEG
B__LCD_EN EQU CYREG_PRT0_LCD_EN
B__MASK EQU 0x02
B__PORT EQU 0
B__PRT EQU CYREG_PRT0_PRT
B__PRTDSI__CAPS_SEL EQU CYREG_PRT0_CAPS_SEL
B__PRTDSI__DBL_SYNC_IN EQU CYREG_PRT0_DBL_SYNC_IN
B__PRTDSI__OE_SEL0 EQU CYREG_PRT0_OE_SEL0
B__PRTDSI__OE_SEL1 EQU CYREG_PRT0_OE_SEL1
B__PRTDSI__OUT_SEL0 EQU CYREG_PRT0_OUT_SEL0
B__PRTDSI__OUT_SEL1 EQU CYREG_PRT0_OUT_SEL1
B__PRTDSI__SYNC_OUT EQU CYREG_PRT0_SYNC_OUT
B__PS EQU CYREG_PRT0_PS
B__SHIFT EQU 1
B__SLW EQU CYREG_PRT0_SLW

/* C */
C__0__INTTYPE EQU CYREG_PICU0_INTTYPE2
C__0__MASK EQU 0x04
C__0__PC EQU CYREG_PRT0_PC2
C__0__PORT EQU 0
C__0__SHIFT EQU 2
C__AG EQU CYREG_PRT0_AG
C__AMUX EQU CYREG_PRT0_AMUX
C__BIE EQU CYREG_PRT0_BIE
C__BIT_MASK EQU CYREG_PRT0_BIT_MASK
C__BYP EQU CYREG_PRT0_BYP
C__CTL EQU CYREG_PRT0_CTL
C__DM0 EQU CYREG_PRT0_DM0
C__DM1 EQU CYREG_PRT0_DM1
C__DM2 EQU CYREG_PRT0_DM2
C__DR EQU CYREG_PRT0_DR
C__INP_DIS EQU CYREG_PRT0_INP_DIS
C__INTTYPE_BASE EQU CYDEV_PICU_INTTYPE_PICU0_BASE
C__LCD_COM_SEG EQU CYREG_PRT0_LCD_COM_SEG
C__LCD_EN EQU CYREG_PRT0_LCD_EN
C__MASK EQU 0x04
C__PORT EQU 0
C__PRT EQU CYREG_PRT0_PRT
C__PRTDSI__CAPS_SEL EQU CYREG_PRT0_CAPS_SEL
C__PRTDSI__DBL_SYNC_IN EQU CYREG_PRT0_DBL_SYNC_IN
C__PRTDSI__OE_SEL0 EQU CYREG_PRT0_OE_SEL0
C__PRTDSI__OE_SEL1 EQU CYREG_PRT0_OE_SEL1
C__PRTDSI__OUT_SEL0 EQU CYREG_PRT0_OUT_SEL0
C__PRTDSI__OUT_SEL1 EQU CYREG_PRT0_OUT_SEL1
C__PRTDSI__SYNC_OUT EQU CYREG_PRT0_SYNC_OUT
C__PS EQU CYREG_PRT0_PS
C__SHIFT EQU 2
C__SLW EQU CYREG_PRT0_SLW
Col1__0__INTTYPE EQU CYREG_PICU2_INTTYPE4
Col1__0__MASK EQU 0x10
Col1__0__PC EQU CYREG_PRT2_PC4
Col1__0__PORT EQU 2
Col1__0__SHIFT EQU 4
Col1__AG EQU CYREG_PRT2_AG
Col1__AMUX EQU CYREG_PRT2_AMUX
Col1__BIE EQU CYREG_PRT2_BIE
Col1__BIT_MASK EQU CYREG_PRT2_BIT_MASK
Col1__BYP EQU CYREG_PRT2_BYP
Col1__CTL EQU CYREG_PRT2_CTL
Col1__DM0 EQU CYREG_PRT2_DM0
Col1__DM1 EQU CYREG_PRT2_DM1
Col1__DM2 EQU CYREG_PRT2_DM2
Col1__DR EQU CYREG_PRT2_DR
Col1__INP_DIS EQU CYREG_PRT2_INP_DIS
Col1__INTTYPE_BASE EQU CYDEV_PICU_INTTYPE_PICU2_BASE
Col1__LCD_COM_SEG EQU CYREG_PRT2_LCD_COM_SEG
Col1__LCD_EN EQU CYREG_PRT2_LCD_EN
Col1__MASK EQU 0x10
Col1__PORT EQU 2
Col1__PRT EQU CYREG_PRT2_PRT
Col1__PRTDSI__CAPS_SEL EQU CYREG_PRT2_CAPS_SEL
Col1__PRTDSI__DBL_SYNC_IN EQU CYREG_PRT2_DBL_SYNC_IN
Col1__PRTDSI__OE_SEL0 EQU CYREG_PRT2_OE_SEL0
Col1__PRTDSI__OE_SEL1 EQU CYREG_PRT2_OE_SEL1
Col1__PRTDSI__OUT_SEL0 EQU CYREG_PRT2_OUT_SEL0
Col1__PRTDSI__OUT_SEL1 EQU CYREG_PRT2_OUT_SEL1
Col1__PRTDSI__SYNC_OUT EQU CYREG_PRT2_SYNC_OUT
Col1__PS EQU CYREG_PRT2_PS
Col1__SHIFT EQU 4
Col1__SLW EQU CYREG_PRT2_SLW
Col2__0__INTTYPE EQU CYREG_PICU2_INTTYPE5
Col2__0__MASK EQU 0x20
Col2__0__PC EQU CYREG_PRT2_PC5
Col2__0__PORT EQU 2
Col2__0__SHIFT EQU 5
Col2__AG EQU CYREG_PRT2_AG
Col2__AMUX EQU CYREG_PRT2_AMUX
Col2__BIE EQU CYREG_PRT2_BIE
Col2__BIT_MASK EQU CYREG_PRT2_BIT_MASK
Col2__BYP EQU CYREG_PRT2_BYP
Col2__CTL EQU CYREG_PRT2_CTL
Col2__DM0 EQU CYREG_PRT2_DM0
Col2__DM1 EQU CYREG_PRT2_DM1
Col2__DM2 EQU CYREG_PRT2_DM2
Col2__DR EQU CYREG_PRT2_DR
Col2__INP_DIS EQU CYREG_PRT2_INP_DIS
Col2__INTTYPE_BASE EQU CYDEV_PICU_INTTYPE_PICU2_BASE
Col2__LCD_COM_SEG EQU CYREG_PRT2_LCD_COM_SEG
Col2__LCD_EN EQU CYREG_PRT2_LCD_EN
Col2__MASK EQU 0x20
Col2__PORT EQU 2
Col2__PRT EQU CYREG_PRT2_PRT
Col2__PRTDSI__CAPS_SEL EQU CYREG_PRT2_CAPS_SEL
Col2__PRTDSI__DBL_SYNC_IN EQU CYREG_PRT2_DBL_SYNC_IN
Col2__PRTDSI__OE_SEL0 EQU CYREG_PRT2_OE_SEL0
Col2__PRTDSI__OE_SEL1 EQU CYREG_PRT2_OE_SEL1
Col2__PRTDSI__OUT_SEL0 EQU CYREG_PRT2_OUT_SEL0
Col2__PRTDSI__OUT_SEL1 EQU CYREG_PRT2_OUT_SEL1
Col2__PRTDSI__SYNC_OUT EQU CYREG_PRT2_SYNC_OUT
Col2__PS EQU CYREG_PRT2_PS
Col2__SHIFT EQU 5
Col2__SLW EQU CYREG_PRT2_SLW
Col3__0__INTTYPE EQU CYREG_PICU2_INTTYPE6
Col3__0__MASK EQU 0x40
Col3__0__PC EQU CYREG_PRT2_PC6
Col3__0__PORT EQU 2
Col3__0__SHIFT EQU 6
Col3__AG EQU CYREG_PRT2_AG
Col3__AMUX EQU CYREG_PRT2_AMUX
Col3__BIE EQU CYREG_PRT2_BIE
Col3__BIT_MASK EQU CYREG_PRT2_BIT_MASK
Col3__BYP EQU CYREG_PRT2_BYP
Col3__CTL EQU CYREG_PRT2_CTL
Col3__DM0 EQU CYREG_PRT2_DM0
Col3__DM1 EQU CYREG_PRT2_DM1
Col3__DM2 EQU CYREG_PRT2_DM2
Col3__DR EQU CYREG_PRT2_DR
Col3__INP_DIS EQU CYREG_PRT2_INP_DIS
Col3__INTTYPE_BASE EQU CYDEV_PICU_INTTYPE_PICU2_BASE
Col3__LCD_COM_SEG EQU CYREG_PRT2_LCD_COM_SEG
Col3__LCD_EN EQU CYREG_PRT2_LCD_EN
Col3__MASK EQU 0x40
Col3__PORT EQU 2
Col3__PRT EQU CYREG_PRT2_PRT
Col3__PRTDSI__CAPS_SEL EQU CYREG_PRT2_CAPS_SEL
Col3__PRTDSI__DBL_SYNC_IN EQU CYREG_PRT2_DBL_SYNC_IN
Col3__PRTDSI__OE_SEL0 EQU CYREG_PRT2_OE_SEL0
Col3__PRTDSI__OE_SEL1 EQU CYREG_PRT2_OE_SEL1
Col3__PRTDSI__OUT_SEL0 EQU CYREG_PRT2_OUT_SEL0
Col3__PRTDSI__OUT_SEL1 EQU CYREG_PRT2_OUT_SEL1
Col3__PRTDSI__SYNC_OUT EQU CYREG_PRT2_SYNC_OUT
Col3__PS EQU CYREG_PRT2_PS
Col3__SHIFT EQU 6
Col3__SLW EQU CYREG_PRT2_SLW
Col4__0__INTTYPE EQU CYREG_PICU2_INTTYPE7
Col4__0__MASK EQU 0x80
Col4__0__PC EQU CYREG_PRT2_PC7
Col4__0__PORT EQU 2
Col4__0__SHIFT EQU 7
Col4__AG EQU CYREG_PRT2_AG
Col4__AMUX EQU CYREG_PRT2_AMUX
Col4__BIE EQU CYREG_PRT2_BIE
Col4__BIT_MASK EQU CYREG_PRT2_BIT_MASK
Col4__BYP EQU CYREG_PRT2_BYP
Col4__CTL EQU CYREG_PRT2_CTL
Col4__DM0 EQU CYREG_PRT2_DM0
Col4__DM1 EQU CYREG_PRT2_DM1
Col4__DM2 EQU CYREG_PRT2_DM2
Col4__DR EQU CYREG_PRT2_DR
Col4__INP_DIS EQU CYREG_PRT2_INP_DIS
Col4__INTTYPE_BASE EQU CYDEV_PICU_INTTYPE_PICU2_BASE
Col4__LCD_COM_SEG EQU CYREG_PRT2_LCD_COM_SEG
Col4__LCD_EN EQU CYREG_PRT2_LCD_EN
Col4__MASK EQU 0x80
Col4__PORT EQU 2
Col4__PRT EQU CYREG_PRT2_PRT
Col4__PRTDSI__CAPS_SEL EQU CYREG_PRT2_CAPS_SEL
Col4__PRTDSI__DBL_SYNC_IN EQU CYREG_PRT2_DBL_SYNC_IN
Col4__PRTDSI__OE_SEL0 EQU CYREG_PRT2_OE_SEL0
Col4__PRTDSI__OE_SEL1 EQU CYREG_PRT2_OE_SEL1
Col4__PRTDSI__OUT_SEL0 EQU CYREG_PRT2_OUT_SEL0
Col4__PRTDSI__OUT_SEL1 EQU CYREG_PRT2_OUT_SEL1
Col4__PRTDSI__SYNC_OUT EQU CYREG_PRT2_SYNC_OUT
Col4__PS EQU CYREG_PRT2_PS
Col4__SHIFT EQU 7
Col4__SLW EQU CYREG_PRT2_SLW

/* D */
D__0__INTTYPE EQU CYREG_PICU0_INTTYPE3
D__0__MASK EQU 0x08
D__0__PC EQU CYREG_PRT0_PC3
D__0__PORT EQU 0
D__0__SHIFT EQU 3
D__AG EQU CYREG_PRT0_AG
D__AMUX EQU CYREG_PRT0_AMUX
D__BIE EQU CYREG_PRT0_BIE
D__BIT_MASK EQU CYREG_PRT0_BIT_MASK
D__BYP EQU CYREG_PRT0_BYP
D__CTL EQU CYREG_PRT0_CTL
D__DM0 EQU CYREG_PRT0_DM0
D__DM1 EQU CYREG_PRT0_DM1
D__DM2 EQU CYREG_PRT0_DM2
D__DR EQU CYREG_PRT0_DR
D__INP_DIS EQU CYREG_PRT0_INP_DIS
D__INTTYPE_BASE EQU CYDEV_PICU_INTTYPE_PICU0_BASE
D__LCD_COM_SEG EQU CYREG_PRT0_LCD_COM_SEG
D__LCD_EN EQU CYREG_PRT0_LCD_EN
D__MASK EQU 0x08
D__PORT EQU 0
D__PRT EQU CYREG_PRT0_PRT
D__PRTDSI__CAPS_SEL EQU CYREG_PRT0_CAPS_SEL
D__PRTDSI__DBL_SYNC_IN EQU CYREG_PRT0_DBL_SYNC_IN
D__PRTDSI__OE_SEL0 EQU CYREG_PRT0_OE_SEL0
D__PRTDSI__OE_SEL1 EQU CYREG_PRT0_OE_SEL1
D__PRTDSI__OUT_SEL0 EQU CYREG_PRT0_OUT_SEL0
D__PRTDSI__OUT_SEL1 EQU CYREG_PRT0_OUT_SEL1
D__PRTDSI__SYNC_OUT EQU CYREG_PRT0_SYNC_OUT
D__PS EQU CYREG_PRT0_PS
D__SHIFT EQU 3
D__SLW EQU CYREG_PRT0_SLW

/* Row1 */
Row1__0__INTTYPE EQU CYREG_PICU2_INTTYPE0
Row1__0__MASK EQU 0x01
Row1__0__PC EQU CYREG_PRT2_PC0
Row1__0__PORT EQU 2
Row1__0__SHIFT EQU 0
Row1__AG EQU CYREG_PRT2_AG
Row1__AMUX EQU CYREG_PRT2_AMUX
Row1__BIE EQU CYREG_PRT2_BIE
Row1__BIT_MASK EQU CYREG_PRT2_BIT_MASK
Row1__BYP EQU CYREG_PRT2_BYP
Row1__CTL EQU CYREG_PRT2_CTL
Row1__DM0 EQU CYREG_PRT2_DM0
Row1__DM1 EQU CYREG_PRT2_DM1
Row1__DM2 EQU CYREG_PRT2_DM2
Row1__DR EQU CYREG_PRT2_DR
Row1__INP_DIS EQU CYREG_PRT2_INP_DIS
Row1__INTTYPE_BASE EQU CYDEV_PICU_INTTYPE_PICU2_BASE
Row1__LCD_COM_SEG EQU CYREG_PRT2_LCD_COM_SEG
Row1__LCD_EN EQU CYREG_PRT2_LCD_EN
Row1__MASK EQU 0x01
Row1__PORT EQU 2
Row1__PRT EQU CYREG_PRT2_PRT
Row1__PRTDSI__CAPS_SEL EQU CYREG_PRT2_CAPS_SEL
Row1__PRTDSI__DBL_SYNC_IN EQU CYREG_PRT2_DBL_SYNC_IN
Row1__PRTDSI__OE_SEL0 EQU CYREG_PRT2_OE_SEL0
Row1__PRTDSI__OE_SEL1 EQU CYREG_PRT2_OE_SEL1
Row1__PRTDSI__OUT_SEL0 EQU CYREG_PRT2_OUT_SEL0
Row1__PRTDSI__OUT_SEL1 EQU CYREG_PRT2_OUT_SEL1
Row1__PRTDSI__SYNC_OUT EQU CYREG_PRT2_SYNC_OUT
Row1__PS EQU CYREG_PRT2_PS
Row1__SHIFT EQU 0
Row1__SLW EQU CYREG_PRT2_SLW

/* Row2 */
Row2__0__INTTYPE EQU CYREG_PICU2_INTTYPE1
Row2__0__MASK EQU 0x02
Row2__0__PC EQU CYREG_PRT2_PC1
Row2__0__PORT EQU 2
Row2__0__SHIFT EQU 1
Row2__AG EQU CYREG_PRT2_AG
Row2__AMUX EQU CYREG_PRT2_AMUX
Row2__BIE EQU CYREG_PRT2_BIE
Row2__BIT_MASK EQU CYREG_PRT2_BIT_MASK
Row2__BYP EQU CYREG_PRT2_BYP
Row2__CTL EQU CYREG_PRT2_CTL
Row2__DM0 EQU CYREG_PRT2_DM0
Row2__DM1 EQU CYREG_PRT2_DM1
Row2__DM2 EQU CYREG_PRT2_DM2
Row2__DR EQU CYREG_PRT2_DR
Row2__INP_DIS EQU CYREG_PRT2_INP_DIS
Row2__INTTYPE_BASE EQU CYDEV_PICU_INTTYPE_PICU2_BASE
Row2__LCD_COM_SEG EQU CYREG_PRT2_LCD_COM_SEG
Row2__LCD_EN EQU CYREG_PRT2_LCD_EN
Row2__MASK EQU 0x02
Row2__PORT EQU 2
Row2__PRT EQU CYREG_PRT2_PRT
Row2__PRTDSI__CAPS_SEL EQU CYREG_PRT2_CAPS_SEL
Row2__PRTDSI__DBL_SYNC_IN EQU CYREG_PRT2_DBL_SYNC_IN
Row2__PRTDSI__OE_SEL0 EQU CYREG_PRT2_OE_SEL0
Row2__PRTDSI__OE_SEL1 EQU CYREG_PRT2_OE_SEL1
Row2__PRTDSI__OUT_SEL0 EQU CYREG_PRT2_OUT_SEL0
Row2__PRTDSI__OUT_SEL1 EQU CYREG_PRT2_OUT_SEL1
Row2__PRTDSI__SYNC_OUT EQU CYREG_PRT2_SYNC_OUT
Row2__PS EQU CYREG_PRT2_PS
Row2__SHIFT EQU 1
Row2__SLW EQU CYREG_PRT2_SLW

/* Row3 */
Row3__0__INTTYPE EQU CYREG_PICU2_INTTYPE2
Row3__0__MASK EQU 0x04
Row3__0__PC EQU CYREG_PRT2_PC2
Row3__0__PORT EQU 2
Row3__0__SHIFT EQU 2
Row3__AG EQU CYREG_PRT2_AG
Row3__AMUX EQU CYREG_PRT2_AMUX
Row3__BIE EQU CYREG_PRT2_BIE
Row3__BIT_MASK EQU CYREG_PRT2_BIT_MASK
Row3__BYP EQU CYREG_PRT2_BYP
Row3__CTL EQU CYREG_PRT2_CTL
Row3__DM0 EQU CYREG_PRT2_DM0
Row3__DM1 EQU CYREG_PRT2_DM1
Row3__DM2 EQU CYREG_PRT2_DM2
Row3__DR EQU CYREG_PRT2_DR
Row3__INP_DIS EQU CYREG_PRT2_INP_DIS
Row3__INTTYPE_BASE EQU CYDEV_PICU_INTTYPE_PICU2_BASE
Row3__LCD_COM_SEG EQU CYREG_PRT2_LCD_COM_SEG
Row3__LCD_EN EQU CYREG_PRT2_LCD_EN
Row3__MASK EQU 0x04
Row3__PORT EQU 2
Row3__PRT EQU CYREG_PRT2_PRT
Row3__PRTDSI__CAPS_SEL EQU CYREG_PRT2_CAPS_SEL
Row3__PRTDSI__DBL_SYNC_IN EQU CYREG_PRT2_DBL_SYNC_IN
Row3__PRTDSI__OE_SEL0 EQU CYREG_PRT2_OE_SEL0
Row3__PRTDSI__OE_SEL1 EQU CYREG_PRT2_OE_SEL1
Row3__PRTDSI__OUT_SEL0 EQU CYREG_PRT2_OUT_SEL0
Row3__PRTDSI__OUT_SEL1 EQU CYREG_PRT2_OUT_SEL1
Row3__PRTDSI__SYNC_OUT EQU CYREG_PRT2_SYNC_OUT
Row3__PS EQU CYREG_PRT2_PS
Row3__SHIFT EQU 2
Row3__SLW EQU CYREG_PRT2_SLW

/* Row4 */
Row4__0__INTTYPE EQU CYREG_PICU2_INTTYPE3
Row4__0__MASK EQU 0x08
Row4__0__PC EQU CYREG_PRT2_PC3
Row4__0__PORT EQU 2
Row4__0__SHIFT EQU 3
Row4__AG EQU CYREG_PRT2_AG
Row4__AMUX EQU CYREG_PRT2_AMUX
Row4__BIE EQU CYREG_PRT2_BIE
Row4__BIT_MASK EQU CYREG_PRT2_BIT_MASK
Row4__BYP EQU CYREG_PRT2_BYP
Row4__CTL EQU CYREG_PRT2_CTL
Row4__DM0 EQU CYREG_PRT2_DM0
Row4__DM1 EQU CYREG_PRT2_DM1
Row4__DM2 EQU CYREG_PRT2_DM2
Row4__DR EQU CYREG_PRT2_DR
Row4__INP_DIS EQU CYREG_PRT2_INP_DIS
Row4__INTTYPE_BASE EQU CYDEV_PICU_INTTYPE_PICU2_BASE
Row4__LCD_COM_SEG EQU CYREG_PRT2_LCD_COM_SEG
Row4__LCD_EN EQU CYREG_PRT2_LCD_EN
Row4__MASK EQU 0x08
Row4__PORT EQU 2
Row4__PRT EQU CYREG_PRT2_PRT
Row4__PRTDSI__CAPS_SEL EQU CYREG_PRT2_CAPS_SEL
Row4__PRTDSI__DBL_SYNC_IN EQU CYREG_PRT2_DBL_SYNC_IN
Row4__PRTDSI__OE_SEL0 EQU CYREG_PRT2_OE_SEL0
Row4__PRTDSI__OE_SEL1 EQU CYREG_PRT2_OE_SEL1
Row4__PRTDSI__OUT_SEL0 EQU CYREG_PRT2_OUT_SEL0
Row4__PRTDSI__OUT_SEL1 EQU CYREG_PRT2_OUT_SEL1
Row4__PRTDSI__SYNC_OUT EQU CYREG_PRT2_SYNC_OUT
Row4__PS EQU CYREG_PRT2_PS
Row4__SHIFT EQU 3
Row4__SLW EQU CYREG_PRT2_SLW

/* Miscellaneous */
BCLK__BUS_CLK__HZ EQU 24000000
BCLK__BUS_CLK__KHZ EQU 24000
BCLK__BUS_CLK__MHZ EQU 24
CYDEV_CHIP_DIE_LEOPARD EQU 1
CYDEV_CHIP_DIE_PSOC4A EQU 16
CYDEV_CHIP_DIE_PSOC5LP EQU 2
CYDEV_CHIP_DIE_PSOC5TM EQU 3
CYDEV_CHIP_DIE_TMA4 EQU 4
CYDEV_CHIP_DIE_UNKNOWN EQU 0
CYDEV_CHIP_FAMILY_FM0P EQU 5
CYDEV_CHIP_FAMILY_FM3 EQU 6
CYDEV_CHIP_FAMILY_FM4 EQU 7
CYDEV_CHIP_FAMILY_PSOC3 EQU 1
CYDEV_CHIP_FAMILY_PSOC4 EQU 2
CYDEV_CHIP_FAMILY_PSOC5 EQU 3
CYDEV_CHIP_FAMILY_PSOC6 EQU 4
CYDEV_CHIP_FAMILY_UNKNOWN EQU 0
CYDEV_CHIP_FAMILY_USED EQU CYDEV_CHIP_FAMILY_PSOC5
CYDEV_CHIP_JTAG_ID EQU 0x2E161069
CYDEV_CHIP_MEMBER_3A EQU 1
CYDEV_CHIP_MEMBER_4A EQU 16
CYDEV_CHIP_MEMBER_4D EQU 12
CYDEV_CHIP_MEMBER_4E EQU 6
CYDEV_CHIP_MEMBER_4F EQU 17
CYDEV_CHIP_MEMBER_4G EQU 4
CYDEV_CHIP_MEMBER_4H EQU 15
CYDEV_CHIP_MEMBER_4I EQU 21
CYDEV_CHIP_MEMBER_4J EQU 13
CYDEV_CHIP_MEMBER_4K EQU 14
CYDEV_CHIP_MEMBER_4L EQU 20
CYDEV_CHIP_MEMBER_4M EQU 19
CYDEV_CHIP_MEMBER_4N EQU 9
CYDEV_CHIP_MEMBER_4O EQU 7
CYDEV_CHIP_MEMBER_4P EQU 18
CYDEV_CHIP_MEMBER_4Q EQU 11
CYDEV_CHIP_MEMBER_4R EQU 8
CYDEV_CHIP_MEMBER_4S EQU 10
CYDEV_CHIP_MEMBER_4U EQU 5
CYDEV_CHIP_MEMBER_5A EQU 3
CYDEV_CHIP_MEMBER_5B EQU 2
CYDEV_CHIP_MEMBER_6A EQU 22
CYDEV_CHIP_MEMBER_FM3 EQU 26
CYDEV_CHIP_MEMBER_FM4 EQU 27
CYDEV_CHIP_MEMBER_PDL_FM0P_TYPE1 EQU 23
CYDEV_CHIP_MEMBER_PDL_FM0P_TYPE2 EQU 24
CYDEV_CHIP_MEMBER_PDL_FM0P_TYPE3 EQU 25
CYDEV_CHIP_MEMBER_UNKNOWN EQU 0
CYDEV_CHIP_MEMBER_USED EQU CYDEV_CHIP_MEMBER_5B
CYDEV_CHIP_DIE_EXPECT EQU CYDEV_CHIP_MEMBER_USED
CYDEV_CHIP_DIE_ACTUAL EQU CYDEV_CHIP_DIE_EXPECT
CYDEV_CHIP_REV_LEOPARD_ES1 EQU 0
CYDEV_CHIP_REV_LEOPARD_ES2 EQU 1
CYDEV_CHIP_REV_LEOPARD_ES3 EQU 3
CYDEV_CHIP_REV_LEOPARD_PRODUCTION EQU 3
CYDEV_CHIP_REV_PSOC4A_ES0 EQU 17
CYDEV_CHIP_REV_PSOC4A_PRODUCTION EQU 17
CYDEV_CHIP_REV_PSOC5LP_ES0 EQU 0
CYDEV_CHIP_REV_PSOC5LP_PRODUCTION EQU 0
CYDEV_CHIP_REV_PSOC5TM_ES0 EQU 0
CYDEV_CHIP_REV_PSOC5TM_ES1 EQU 1
CYDEV_CHIP_REV_PSOC5TM_PRODUCTION EQU 1
CYDEV_CHIP_REV_TMA4_ES EQU 17
CYDEV_CHIP_REV_TMA4_ES2 EQU 33
CYDEV_CHIP_REV_TMA4_PRODUCTION EQU 17
CYDEV_CHIP_REVISION_3A_ES1 EQU 0
CYDEV_CHIP_REVISION_3A_ES2 EQU 1
CYDEV_CHIP_REVISION_3A_ES3 EQU 3
CYDEV_CHIP_REVISION_3A_PRODUCTION EQU 3
CYDEV_CHIP_REVISION_4A_ES0 EQU 17
CYDEV_CHIP_REVISION_4A_PRODUCTION EQU 17
CYDEV_CHIP_REVISION_4D_PRODUCTION EQU 0
CYDEV_CHIP_REVISION_4E_PRODUCTION EQU 0
CYDEV_CHIP_REVISION_4F_PRODUCTION EQU 0
CYDEV_CHIP_REVISION_4F_PRODUCTION_256DMA EQU 0
CYDEV_CHIP_REVISION_4F_PRODUCTION_256K EQU 0
CYDEV_CHIP_REVISION_4G_ES EQU 17
CYDEV_CHIP_REVISION_4G_ES2 EQU 33
CYDEV_CHIP_REVISION_4G_PRODUCTION EQU 17
CYDEV_CHIP_REVISION_4H_PRODUCTION EQU 0
CYDEV_CHIP_REVISION_4I_PRODUCTION EQU 0
CYDEV_CHIP_REVISION_4J_PRODUCTION EQU 0
CYDEV_CHIP_REVISION_4K_PRODUCTION EQU 0
CYDEV_CHIP_REVISION_4L_PRODUCTION EQU 0
CYDEV_CHIP_REVISION_4M_PRODUCTION EQU 0
CYDEV_CHIP_REVISION_4N_PRODUCTION EQU 0
CYDEV_CHIP_REVISION_4O_PRODUCTION EQU 0
CYDEV_CHIP_REVISION_4P_PRODUCTION EQU 0
CYDEV_CHIP_REVISION_4Q_PRODUCTION EQU 0
CYDEV_CHIP_REVISION_4R_PRODUCTION EQU 0
CYDEV_CHIP_REVISION_4S_PRODUCTION EQU 0
CYDEV_CHIP_REVISION_4U_PRODUCTION EQU 0
CYDEV_CHIP_REVISION_5A_ES0 EQU 0
CYDEV_CHIP_REVISION_5A_ES1 EQU 1
CYDEV_CHIP_REVISION_5A_PRODUCTION EQU 1
CYDEV_CHIP_REVISION_5B_ES0 EQU 0
CYDEV_CHIP_REVISION_5B_PRODUCTION EQU 0
CYDEV_CHIP_REVISION_6A_NO_UDB EQU 0
CYDEV_CHIP_REVISION_6A_PRODUCTION EQU 0
CYDEV_CHIP_REVISION_FM3_PRODUCTION EQU 0
CYDEV_CHIP_REVISION_FM4_PRODUCTION EQU 0
CYDEV_CHIP_REVISION_PDL_FM0P_TYPE1_PRODUCTION EQU 0
CYDEV_CHIP_REVISION_PDL_FM0P_TYPE2_PRODUCTION EQU 0
CYDEV_CHIP_REVISION_PDL_FM0P_TYPE3_PRODUCTION EQU 0
CYDEV_CHIP_REVISION_USED EQU CYDEV_CHIP_REVISION_5B_PRODUCTION
CYDEV_CHIP_REV_EXPECT EQU CYDEV_CHIP_REVISION_USED
CYDEV_CONFIG_FASTBOOT_ENABLED EQU 1
CYDEV_CONFIG_UNUSED_IO_AllowButWarn EQU 0
CYDEV_CONFIG_UNUSED_IO EQU CYDEV_CONFIG_UNUSED_IO_AllowButWarn
CYDEV_CONFIG_UNUSED_IO_AllowWithInfo EQU 1
CYDEV_CONFIG_UNUSED_IO_Disallowed EQU 2
CYDEV_CONFIGURATION_COMPRESSED EQU 1
CYDEV_CONFIGURATION_DMA EQU 0
CYDEV_CONFIGURATION_ECC EQU 1
CYDEV_CONFIGURATION_IMOENABLED EQU CYDEV_CONFIG_FASTBOOT_ENABLED
CYDEV_CONFIGURATION_MODE_COMPRESSED EQU 0
CYDEV_CONFIGURATION_MODE EQU CYDEV_CONFIGURATION_MODE_COMPRESSED
CYDEV_CONFIGURATION_MODE_DMA EQU 2
CYDEV_CONFIGURATION_MODE_UNCOMPRESSED EQU 1
CYDEV_DEBUG_ENABLE_MASK EQU 0x20
CYDEV_DEBUG_ENABLE_REGISTER EQU CYREG_MLOGIC_DEBUG
CYDEV_DEBUGGING_DPS_Disable EQU 3
CYDEV_DEBUGGING_DPS_JTAG_4 EQU 1
CYDEV_DEBUGGING_DPS_JTAG_5 EQU 0
CYDEV_DEBUGGING_DPS_SWD EQU 2
CYDEV_DEBUGGING_DPS_SWD_SWV EQU 6
CYDEV_DEBUGGING_DPS EQU CYDEV_DEBUGGING_DPS_SWD_SWV
CYDEV_DEBUGGING_ENABLE EQU 1
CYDEV_DEBUGGING_XRES EQU 0
CYDEV_DMA_CHANNELS_AVAILABLE EQU 24
CYDEV_ECC_ENABLE EQU 0
CYDEV_HEAP_SIZE EQU 0x80
CYDEV_INSTRUCT_CACHE_ENABLED EQU 1
CYDEV_INTR_RISING EQU 0x00000000
CYDEV_IS_EXPORTING_CODE EQU 0
CYDEV_IS_IMPORTING_CODE EQU 0
CYDEV_PROJ_TYPE EQU 0
CYDEV_PROJ_TYPE_BOOTLOADER EQU 1
CYDEV_PROJ_TYPE_LAUNCHER EQU 5
CYDEV_PROJ_TYPE_LOADABLE EQU 2
CYDEV_PROJ_TYPE_LOADABLEANDBOOTLOADER EQU 4
CYDEV_PROJ_TYPE_MULTIAPPBOOTLOADER EQU 3
CYDEV_PROJ_TYPE_STANDARD EQU 0
CYDEV_PROTECTION_ENABLE EQU 0
CYDEV_STACK_SIZE EQU 0x0800
CYDEV_USE_BUNDLED_CMSIS EQU 1
CYDEV_VARIABLE_VDDA EQU 0
CYDEV_VDDA_MV EQU 5000
CYDEV_VDDD_MV EQU 5000
CYDEV_VDDIO0_MV EQU 5000
CYDEV_VDDIO1_MV EQU 5000
CYDEV_VDDIO2_MV EQU 5000
CYDEV_VDDIO3_MV EQU 5000
CYDEV_VIO0_MV EQU 5000
CYDEV_VIO1_MV EQU 5000
CYDEV_VIO2_MV EQU 5000
CYDEV_VIO3_MV EQU 5000
CYIPBLOCK_ARM_CM3_VERSION EQU 0
CYIPBLOCK_P3_ANAIF_VERSION EQU 0
CYIPBLOCK_P3_CAN_VERSION EQU 0
CYIPBLOCK_P3_CAPSENSE_VERSION EQU 0
CYIPBLOCK_P3_COMP_VERSION EQU 0
CYIPBLOCK_P3_DECIMATOR_VERSION EQU 0
CYIPBLOCK_P3_DFB_VERSION EQU 0
CYIPBLOCK_P3_DMA_VERSION EQU 0
CYIPBLOCK_P3_DRQ_VERSION EQU 0
CYIPBLOCK_P3_DSM_VERSION EQU 0
CYIPBLOCK_P3_EMIF_VERSION EQU 0
CYIPBLOCK_P3_I2C_VERSION EQU 0
CYIPBLOCK_P3_LCD_VERSION EQU 0
CYIPBLOCK_P3_LPF_VERSION EQU 0
CYIPBLOCK_P3_OPAMP_VERSION EQU 0
CYIPBLOCK_P3_PM_VERSION EQU 0
CYIPBLOCK_P3_SCCT_VERSION EQU 0
CYIPBLOCK_P3_TIMER_VERSION EQU 0
CYIPBLOCK_P3_USB_VERSION EQU 0
CYIPBLOCK_P3_VIDAC_VERSION EQU 0
CYIPBLOCK_P3_VREF_VERSION EQU 0
CYIPBLOCK_S8_GPIO_VERSION EQU 0
CYIPBLOCK_S8_IRQ_VERSION EQU 0
CYIPBLOCK_S8_SAR_VERSION EQU 0
CYIPBLOCK_S8_SIO_VERSION EQU 0
CYIPBLOCK_S8_UDB_VERSION EQU 0
DMA_CHANNELS_USED__MASK0 EQU 0x00000000
CYDEV_BOOTLOADER_ENABLE EQU 0

#endif /* INCLUDED_CYFITTERIAR_INC */
