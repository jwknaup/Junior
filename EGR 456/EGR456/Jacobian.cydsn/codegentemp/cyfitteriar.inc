;
; File Name: cyfitteriar.inc
; 
; PSoC Creator  4.1 Update 1
;
; Description:
; 
;
;-------------------------------------------------------------------------------
; Copyright (c) 2007-2017 Cypress Semiconductor.  All rights reserved.
; You may use this file only in accordance with the license, terms, conditions, 
; disclaimers, and limitations in the end user license agreement accompanying 
; the software package with which this file was provided.
;-------------------------------------------------------------------------------

#ifndef INCLUDED_CYFITTERIAR_INC
#define INCLUDED_CYFITTERIAR_INC
    INCLUDE cydeviceiar_trm.inc

/* Clock_1 */
Clock_1__CTRL_REGISTER EQU CYREG_PERI_PCLK_CTL11
Clock_1__DIV_ID EQU 0x00000040
Clock_1__DIV_REGISTER EQU CYREG_PERI_DIV_16_CTL0
Clock_1__PA_DIV_ID EQU 0x000000FF

/* Servo1 */
Servo1__0__DR EQU CYREG_GPIO_PRT1_DR
Servo1__0__DR_CLR EQU CYREG_GPIO_PRT1_DR_CLR
Servo1__0__DR_INV EQU CYREG_GPIO_PRT1_DR_INV
Servo1__0__DR_SET EQU CYREG_GPIO_PRT1_DR_SET
Servo1__0__HSIOM EQU CYREG_HSIOM_PORT_SEL1
Servo1__0__HSIOM_MASK EQU 0x0F000000
Servo1__0__HSIOM_SHIFT EQU 24
Servo1__0__INTCFG EQU CYREG_GPIO_PRT1_INTR_CFG
Servo1__0__INTR EQU CYREG_GPIO_PRT1_INTR
Servo1__0__INTR_CFG EQU CYREG_GPIO_PRT1_INTR_CFG
Servo1__0__INTSTAT EQU CYREG_GPIO_PRT1_INTR
Servo1__0__MASK EQU 0x40
Servo1__0__OUT_SEL EQU CYREG_UDB_PA1_CFG10
Servo1__0__OUT_SEL_SHIFT EQU 12
Servo1__0__OUT_SEL_VAL EQU 0
Servo1__0__PA__CFG0 EQU CYREG_UDB_PA1_CFG0
Servo1__0__PA__CFG1 EQU CYREG_UDB_PA1_CFG1
Servo1__0__PA__CFG10 EQU CYREG_UDB_PA1_CFG10
Servo1__0__PA__CFG11 EQU CYREG_UDB_PA1_CFG11
Servo1__0__PA__CFG12 EQU CYREG_UDB_PA1_CFG12
Servo1__0__PA__CFG13 EQU CYREG_UDB_PA1_CFG13
Servo1__0__PA__CFG14 EQU CYREG_UDB_PA1_CFG14
Servo1__0__PA__CFG2 EQU CYREG_UDB_PA1_CFG2
Servo1__0__PA__CFG3 EQU CYREG_UDB_PA1_CFG3
Servo1__0__PA__CFG4 EQU CYREG_UDB_PA1_CFG4
Servo1__0__PA__CFG5 EQU CYREG_UDB_PA1_CFG5
Servo1__0__PA__CFG6 EQU CYREG_UDB_PA1_CFG6
Servo1__0__PA__CFG7 EQU CYREG_UDB_PA1_CFG7
Servo1__0__PA__CFG8 EQU CYREG_UDB_PA1_CFG8
Servo1__0__PA__CFG9 EQU CYREG_UDB_PA1_CFG9
Servo1__0__PC EQU CYREG_GPIO_PRT1_PC
Servo1__0__PC2 EQU CYREG_GPIO_PRT1_PC2
Servo1__0__PORT EQU 1
Servo1__0__PS EQU CYREG_GPIO_PRT1_PS
Servo1__0__SHIFT EQU 6
Servo1__DR EQU CYREG_GPIO_PRT1_DR
Servo1__DR_CLR EQU CYREG_GPIO_PRT1_DR_CLR
Servo1__DR_INV EQU CYREG_GPIO_PRT1_DR_INV
Servo1__DR_SET EQU CYREG_GPIO_PRT1_DR_SET
Servo1__INTCFG EQU CYREG_GPIO_PRT1_INTR_CFG
Servo1__INTR EQU CYREG_GPIO_PRT1_INTR
Servo1__INTR_CFG EQU CYREG_GPIO_PRT1_INTR_CFG
Servo1__INTSTAT EQU CYREG_GPIO_PRT1_INTR
Servo1__MASK EQU 0x40
Servo1__PA__CFG0 EQU CYREG_UDB_PA1_CFG0
Servo1__PA__CFG1 EQU CYREG_UDB_PA1_CFG1
Servo1__PA__CFG10 EQU CYREG_UDB_PA1_CFG10
Servo1__PA__CFG11 EQU CYREG_UDB_PA1_CFG11
Servo1__PA__CFG12 EQU CYREG_UDB_PA1_CFG12
Servo1__PA__CFG13 EQU CYREG_UDB_PA1_CFG13
Servo1__PA__CFG14 EQU CYREG_UDB_PA1_CFG14
Servo1__PA__CFG2 EQU CYREG_UDB_PA1_CFG2
Servo1__PA__CFG3 EQU CYREG_UDB_PA1_CFG3
Servo1__PA__CFG4 EQU CYREG_UDB_PA1_CFG4
Servo1__PA__CFG5 EQU CYREG_UDB_PA1_CFG5
Servo1__PA__CFG6 EQU CYREG_UDB_PA1_CFG6
Servo1__PA__CFG7 EQU CYREG_UDB_PA1_CFG7
Servo1__PA__CFG8 EQU CYREG_UDB_PA1_CFG8
Servo1__PA__CFG9 EQU CYREG_UDB_PA1_CFG9
Servo1__PC EQU CYREG_GPIO_PRT1_PC
Servo1__PC2 EQU CYREG_GPIO_PRT1_PC2
Servo1__PORT EQU 1
Servo1__PS EQU CYREG_GPIO_PRT1_PS
Servo1__SHIFT EQU 6

/* Servo2 */
Servo2__0__DR EQU CYREG_GPIO_PRT1_DR
Servo2__0__DR_CLR EQU CYREG_GPIO_PRT1_DR_CLR
Servo2__0__DR_INV EQU CYREG_GPIO_PRT1_DR_INV
Servo2__0__DR_SET EQU CYREG_GPIO_PRT1_DR_SET
Servo2__0__HSIOM EQU CYREG_HSIOM_PORT_SEL1
Servo2__0__HSIOM_MASK EQU 0xF0000000
Servo2__0__HSIOM_SHIFT EQU 28
Servo2__0__INTCFG EQU CYREG_GPIO_PRT1_INTR_CFG
Servo2__0__INTR EQU CYREG_GPIO_PRT1_INTR
Servo2__0__INTR_CFG EQU CYREG_GPIO_PRT1_INTR_CFG
Servo2__0__INTSTAT EQU CYREG_GPIO_PRT1_INTR
Servo2__0__MASK EQU 0x80
Servo2__0__OUT_SEL EQU CYREG_UDB_PA1_CFG10
Servo2__0__OUT_SEL_SHIFT EQU 14
Servo2__0__OUT_SEL_VAL EQU 1
Servo2__0__PA__CFG0 EQU CYREG_UDB_PA1_CFG0
Servo2__0__PA__CFG1 EQU CYREG_UDB_PA1_CFG1
Servo2__0__PA__CFG10 EQU CYREG_UDB_PA1_CFG10
Servo2__0__PA__CFG11 EQU CYREG_UDB_PA1_CFG11
Servo2__0__PA__CFG12 EQU CYREG_UDB_PA1_CFG12
Servo2__0__PA__CFG13 EQU CYREG_UDB_PA1_CFG13
Servo2__0__PA__CFG14 EQU CYREG_UDB_PA1_CFG14
Servo2__0__PA__CFG2 EQU CYREG_UDB_PA1_CFG2
Servo2__0__PA__CFG3 EQU CYREG_UDB_PA1_CFG3
Servo2__0__PA__CFG4 EQU CYREG_UDB_PA1_CFG4
Servo2__0__PA__CFG5 EQU CYREG_UDB_PA1_CFG5
Servo2__0__PA__CFG6 EQU CYREG_UDB_PA1_CFG6
Servo2__0__PA__CFG7 EQU CYREG_UDB_PA1_CFG7
Servo2__0__PA__CFG8 EQU CYREG_UDB_PA1_CFG8
Servo2__0__PA__CFG9 EQU CYREG_UDB_PA1_CFG9
Servo2__0__PC EQU CYREG_GPIO_PRT1_PC
Servo2__0__PC2 EQU CYREG_GPIO_PRT1_PC2
Servo2__0__PORT EQU 1
Servo2__0__PS EQU CYREG_GPIO_PRT1_PS
Servo2__0__SHIFT EQU 7
Servo2__DR EQU CYREG_GPIO_PRT1_DR
Servo2__DR_CLR EQU CYREG_GPIO_PRT1_DR_CLR
Servo2__DR_INV EQU CYREG_GPIO_PRT1_DR_INV
Servo2__DR_SET EQU CYREG_GPIO_PRT1_DR_SET
Servo2__INTCFG EQU CYREG_GPIO_PRT1_INTR_CFG
Servo2__INTR EQU CYREG_GPIO_PRT1_INTR
Servo2__INTR_CFG EQU CYREG_GPIO_PRT1_INTR_CFG
Servo2__INTSTAT EQU CYREG_GPIO_PRT1_INTR
Servo2__MASK EQU 0x80
Servo2__PA__CFG0 EQU CYREG_UDB_PA1_CFG0
Servo2__PA__CFG1 EQU CYREG_UDB_PA1_CFG1
Servo2__PA__CFG10 EQU CYREG_UDB_PA1_CFG10
Servo2__PA__CFG11 EQU CYREG_UDB_PA1_CFG11
Servo2__PA__CFG12 EQU CYREG_UDB_PA1_CFG12
Servo2__PA__CFG13 EQU CYREG_UDB_PA1_CFG13
Servo2__PA__CFG14 EQU CYREG_UDB_PA1_CFG14
Servo2__PA__CFG2 EQU CYREG_UDB_PA1_CFG2
Servo2__PA__CFG3 EQU CYREG_UDB_PA1_CFG3
Servo2__PA__CFG4 EQU CYREG_UDB_PA1_CFG4
Servo2__PA__CFG5 EQU CYREG_UDB_PA1_CFG5
Servo2__PA__CFG6 EQU CYREG_UDB_PA1_CFG6
Servo2__PA__CFG7 EQU CYREG_UDB_PA1_CFG7
Servo2__PA__CFG8 EQU CYREG_UDB_PA1_CFG8
Servo2__PA__CFG9 EQU CYREG_UDB_PA1_CFG9
Servo2__PC EQU CYREG_GPIO_PRT1_PC
Servo2__PC2 EQU CYREG_GPIO_PRT1_PC2
Servo2__PORT EQU 1
Servo2__PS EQU CYREG_GPIO_PRT1_PS
Servo2__SHIFT EQU 7

/* Servos_PWMUDB */
Servos_PWMUDB_genblk1_ctrlreg__7__MASK EQU 0x80
Servos_PWMUDB_genblk1_ctrlreg__7__POS EQU 7
Servos_PWMUDB_genblk1_ctrlreg__CONTROL_AUX_CTL_REG EQU CYREG_UDB_W8_ACTL3
Servos_PWMUDB_genblk1_ctrlreg__CONTROL_REG EQU CYREG_UDB_W8_CTL3
Servos_PWMUDB_genblk1_ctrlreg__CONTROL_ST_REG EQU CYREG_UDB_CAT16_CTL_ST3
Servos_PWMUDB_genblk1_ctrlreg__COUNT_REG EQU CYREG_UDB_W8_CTL3
Servos_PWMUDB_genblk1_ctrlreg__COUNT_ST_REG EQU CYREG_UDB_CAT16_CTL_ST3
Servos_PWMUDB_genblk1_ctrlreg__MASK EQU 0x80
Servos_PWMUDB_genblk1_ctrlreg__MASK_CTL_AUX_CTL_REG EQU CYREG_UDB_CAT16_ACTL_MSK3
Servos_PWMUDB_genblk1_ctrlreg__PER_CTL_AUX_CTL_REG EQU CYREG_UDB_CAT16_ACTL_MSK3
Servos_PWMUDB_genblk1_ctrlreg__PERIOD_REG EQU CYREG_UDB_W8_MSK3
Servos_PWMUDB_genblk8_stsreg__0__MASK EQU 0x01
Servos_PWMUDB_genblk8_stsreg__0__POS EQU 0
Servos_PWMUDB_genblk8_stsreg__1__MASK EQU 0x02
Servos_PWMUDB_genblk8_stsreg__1__POS EQU 1
Servos_PWMUDB_genblk8_stsreg__2__MASK EQU 0x04
Servos_PWMUDB_genblk8_stsreg__2__POS EQU 2
Servos_PWMUDB_genblk8_stsreg__3__MASK EQU 0x08
Servos_PWMUDB_genblk8_stsreg__3__POS EQU 3
Servos_PWMUDB_genblk8_stsreg__MASK EQU 0x0F
Servos_PWMUDB_genblk8_stsreg__MASK_REG EQU CYREG_UDB_W8_MSK3
Servos_PWMUDB_genblk8_stsreg__MASK_ST_AUX_CTL_REG EQU CYREG_UDB_CAT16_ACTL_MSK3
Servos_PWMUDB_genblk8_stsreg__PER_ST_AUX_CTL_REG EQU CYREG_UDB_CAT16_ACTL_MSK3
Servos_PWMUDB_genblk8_stsreg__STATUS_AUX_CTL_REG EQU CYREG_UDB_W8_ACTL3
Servos_PWMUDB_genblk8_stsreg__STATUS_CNT_REG EQU CYREG_UDB_CAT16_CTL_ST3
Servos_PWMUDB_genblk8_stsreg__STATUS_CONTROL_REG EQU CYREG_UDB_CAT16_CTL_ST3
Servos_PWMUDB_genblk8_stsreg__STATUS_REG EQU CYREG_UDB_W8_ST3
Servos_PWMUDB_sP16_pwmdp_u0__16BIT_A0_REG EQU CYREG_UDB_W16_A02
Servos_PWMUDB_sP16_pwmdp_u0__16BIT_A1_REG EQU CYREG_UDB_W16_A12
Servos_PWMUDB_sP16_pwmdp_u0__16BIT_D0_REG EQU CYREG_UDB_W16_D02
Servos_PWMUDB_sP16_pwmdp_u0__16BIT_D1_REG EQU CYREG_UDB_W16_D12
Servos_PWMUDB_sP16_pwmdp_u0__16BIT_DP_AUX_CTL_REG EQU CYREG_UDB_W16_ACTL2
Servos_PWMUDB_sP16_pwmdp_u0__16BIT_F0_REG EQU CYREG_UDB_W16_F02
Servos_PWMUDB_sP16_pwmdp_u0__16BIT_F1_REG EQU CYREG_UDB_W16_F12
Servos_PWMUDB_sP16_pwmdp_u0__A0_A1_REG EQU CYREG_UDB_CAT16_A2
Servos_PWMUDB_sP16_pwmdp_u0__A0_REG EQU CYREG_UDB_W8_A02
Servos_PWMUDB_sP16_pwmdp_u0__A1_REG EQU CYREG_UDB_W8_A12
Servos_PWMUDB_sP16_pwmdp_u0__D0_D1_REG EQU CYREG_UDB_CAT16_D2
Servos_PWMUDB_sP16_pwmdp_u0__D0_REG EQU CYREG_UDB_W8_D02
Servos_PWMUDB_sP16_pwmdp_u0__D1_REG EQU CYREG_UDB_W8_D12
Servos_PWMUDB_sP16_pwmdp_u0__DP_AUX_CTL_REG EQU CYREG_UDB_W8_ACTL2
Servos_PWMUDB_sP16_pwmdp_u0__F0_F1_REG EQU CYREG_UDB_CAT16_F2
Servos_PWMUDB_sP16_pwmdp_u0__F0_REG EQU CYREG_UDB_W8_F02
Servos_PWMUDB_sP16_pwmdp_u0__F1_REG EQU CYREG_UDB_W8_F12
Servos_PWMUDB_sP16_pwmdp_u1__A0_A1_REG EQU CYREG_UDB_CAT16_A3
Servos_PWMUDB_sP16_pwmdp_u1__A0_REG EQU CYREG_UDB_W8_A03
Servos_PWMUDB_sP16_pwmdp_u1__A1_REG EQU CYREG_UDB_W8_A13
Servos_PWMUDB_sP16_pwmdp_u1__D0_D1_REG EQU CYREG_UDB_CAT16_D3
Servos_PWMUDB_sP16_pwmdp_u1__D0_REG EQU CYREG_UDB_W8_D03
Servos_PWMUDB_sP16_pwmdp_u1__D1_REG EQU CYREG_UDB_W8_D13
Servos_PWMUDB_sP16_pwmdp_u1__DP_AUX_CTL_REG EQU CYREG_UDB_W8_ACTL3
Servos_PWMUDB_sP16_pwmdp_u1__F0_F1_REG EQU CYREG_UDB_CAT16_F3
Servos_PWMUDB_sP16_pwmdp_u1__F0_REG EQU CYREG_UDB_W8_F03
Servos_PWMUDB_sP16_pwmdp_u1__F1_REG EQU CYREG_UDB_W8_F13
Servos_PWMUDB_sP16_pwmdp_u1__MSK_DP_AUX_CTL_REG EQU CYREG_UDB_CAT16_ACTL_MSK3
Servos_PWMUDB_sP16_pwmdp_u1__PER_DP_AUX_CTL_REG EQU CYREG_UDB_CAT16_ACTL_MSK3

/* Miscellaneous */
CYDEV_BCLK__HFCLK__HZ EQU 48000000
CYDEV_BCLK__HFCLK__KHZ EQU 48000
CYDEV_BCLK__HFCLK__MHZ EQU 48
CYDEV_BCLK__SYSCLK__HZ EQU 48000000
CYDEV_BCLK__SYSCLK__KHZ EQU 48000
CYDEV_BCLK__SYSCLK__MHZ EQU 48
CYDEV_CHIP_DIE_LEOPARD EQU 1
CYDEV_CHIP_DIE_PSOC4A EQU 16
CYDEV_CHIP_DIE_PSOC5LP EQU 2
CYDEV_CHIP_DIE_PSOC5TM EQU 3
CYDEV_CHIP_DIE_TMA4 EQU 4
CYDEV_CHIP_DIE_UNKNOWN EQU 0
CYDEV_CHIP_FAMILY_FM0P EQU 5
CYDEV_CHIP_FAMILY_FM3 EQU 6
CYDEV_CHIP_FAMILY_FM4 EQU 7
CYDEV_CHIP_FAMILY_PSOC3 EQU 1
CYDEV_CHIP_FAMILY_PSOC4 EQU 2
CYDEV_CHIP_FAMILY_PSOC5 EQU 3
CYDEV_CHIP_FAMILY_PSOC6 EQU 4
CYDEV_CHIP_FAMILY_UNKNOWN EQU 0
CYDEV_CHIP_FAMILY_USED EQU CYDEV_CHIP_FAMILY_PSOC4
CYDEV_CHIP_JTAG_ID EQU 0x1A1711AA
CYDEV_CHIP_MEMBER_3A EQU 1
CYDEV_CHIP_MEMBER_4A EQU 16
CYDEV_CHIP_MEMBER_4D EQU 12
CYDEV_CHIP_MEMBER_4E EQU 6
CYDEV_CHIP_MEMBER_4F EQU 17
CYDEV_CHIP_MEMBER_4G EQU 4
CYDEV_CHIP_MEMBER_4H EQU 15
CYDEV_CHIP_MEMBER_4I EQU 21
CYDEV_CHIP_MEMBER_4J EQU 13
CYDEV_CHIP_MEMBER_4K EQU 14
CYDEV_CHIP_MEMBER_4L EQU 20
CYDEV_CHIP_MEMBER_4M EQU 19
CYDEV_CHIP_MEMBER_4N EQU 9
CYDEV_CHIP_MEMBER_4O EQU 7
CYDEV_CHIP_MEMBER_4P EQU 18
CYDEV_CHIP_MEMBER_4Q EQU 11
CYDEV_CHIP_MEMBER_4R EQU 8
CYDEV_CHIP_MEMBER_4S EQU 10
CYDEV_CHIP_MEMBER_4U EQU 5
CYDEV_CHIP_MEMBER_5A EQU 3
CYDEV_CHIP_MEMBER_5B EQU 2
CYDEV_CHIP_MEMBER_6A EQU 22
CYDEV_CHIP_MEMBER_FM3 EQU 26
CYDEV_CHIP_MEMBER_FM4 EQU 27
CYDEV_CHIP_MEMBER_PDL_FM0P_TYPE1 EQU 23
CYDEV_CHIP_MEMBER_PDL_FM0P_TYPE2 EQU 24
CYDEV_CHIP_MEMBER_PDL_FM0P_TYPE3 EQU 25
CYDEV_CHIP_MEMBER_UNKNOWN EQU 0
CYDEV_CHIP_MEMBER_USED EQU CYDEV_CHIP_MEMBER_4F
CYDEV_CHIP_DIE_EXPECT EQU CYDEV_CHIP_MEMBER_USED
CYDEV_CHIP_DIE_ACTUAL EQU CYDEV_CHIP_DIE_EXPECT
CYDEV_CHIP_REV_LEOPARD_ES1 EQU 0
CYDEV_CHIP_REV_LEOPARD_ES2 EQU 1
CYDEV_CHIP_REV_LEOPARD_ES3 EQU 3
CYDEV_CHIP_REV_LEOPARD_PRODUCTION EQU 3
CYDEV_CHIP_REV_PSOC4A_ES0 EQU 17
CYDEV_CHIP_REV_PSOC4A_PRODUCTION EQU 17
CYDEV_CHIP_REV_PSOC5LP_ES0 EQU 0
CYDEV_CHIP_REV_PSOC5LP_PRODUCTION EQU 0
CYDEV_CHIP_REV_PSOC5TM_ES0 EQU 0
CYDEV_CHIP_REV_PSOC5TM_ES1 EQU 1
CYDEV_CHIP_REV_PSOC5TM_PRODUCTION EQU 1
CYDEV_CHIP_REV_TMA4_ES EQU 17
CYDEV_CHIP_REV_TMA4_ES2 EQU 33
CYDEV_CHIP_REV_TMA4_PRODUCTION EQU 17
CYDEV_CHIP_REVISION_3A_ES1 EQU 0
CYDEV_CHIP_REVISION_3A_ES2 EQU 1
CYDEV_CHIP_REVISION_3A_ES3 EQU 3
CYDEV_CHIP_REVISION_3A_PRODUCTION EQU 3
CYDEV_CHIP_REVISION_4A_ES0 EQU 17
CYDEV_CHIP_REVISION_4A_PRODUCTION EQU 17
CYDEV_CHIP_REVISION_4D_PRODUCTION EQU 0
CYDEV_CHIP_REVISION_4E_PRODUCTION EQU 0
CYDEV_CHIP_REVISION_4F_PRODUCTION EQU 0
CYDEV_CHIP_REVISION_4F_PRODUCTION_256DMA EQU 0
CYDEV_CHIP_REVISION_4F_PRODUCTION_256K EQU 0
CYDEV_CHIP_REVISION_4G_ES EQU 17
CYDEV_CHIP_REVISION_4G_ES2 EQU 33
CYDEV_CHIP_REVISION_4G_PRODUCTION EQU 17
CYDEV_CHIP_REVISION_4H_PRODUCTION EQU 0
CYDEV_CHIP_REVISION_4I_PRODUCTION EQU 0
CYDEV_CHIP_REVISION_4J_PRODUCTION EQU 0
CYDEV_CHIP_REVISION_4K_PRODUCTION EQU 0
CYDEV_CHIP_REVISION_4L_PRODUCTION EQU 0
CYDEV_CHIP_REVISION_4M_PRODUCTION EQU 0
CYDEV_CHIP_REVISION_4N_PRODUCTION EQU 0
CYDEV_CHIP_REVISION_4O_PRODUCTION EQU 0
CYDEV_CHIP_REVISION_4P_PRODUCTION EQU 0
CYDEV_CHIP_REVISION_4Q_PRODUCTION EQU 0
CYDEV_CHIP_REVISION_4R_PRODUCTION EQU 0
CYDEV_CHIP_REVISION_4S_PRODUCTION EQU 0
CYDEV_CHIP_REVISION_4U_PRODUCTION EQU 0
CYDEV_CHIP_REVISION_5A_ES0 EQU 0
CYDEV_CHIP_REVISION_5A_ES1 EQU 1
CYDEV_CHIP_REVISION_5A_PRODUCTION EQU 1
CYDEV_CHIP_REVISION_5B_ES0 EQU 0
CYDEV_CHIP_REVISION_5B_PRODUCTION EQU 0
CYDEV_CHIP_REVISION_6A_NO_UDB EQU 0
CYDEV_CHIP_REVISION_6A_PRODUCTION EQU 0
CYDEV_CHIP_REVISION_FM3_PRODUCTION EQU 0
CYDEV_CHIP_REVISION_FM4_PRODUCTION EQU 0
CYDEV_CHIP_REVISION_PDL_FM0P_TYPE1_PRODUCTION EQU 0
CYDEV_CHIP_REVISION_PDL_FM0P_TYPE2_PRODUCTION EQU 0
CYDEV_CHIP_REVISION_PDL_FM0P_TYPE3_PRODUCTION EQU 0
CYDEV_CHIP_REVISION_USED EQU CYDEV_CHIP_REVISION_4F_PRODUCTION_256DMA
CYDEV_CHIP_REV_EXPECT EQU CYDEV_CHIP_REVISION_USED
CYDEV_CONFIG_READ_ACCELERATOR EQU 1
CYDEV_CONFIG_UNUSED_IO_AllowButWarn EQU 0
CYDEV_CONFIG_UNUSED_IO_AllowWithInfo EQU 1
CYDEV_CONFIG_UNUSED_IO_Disallowed EQU 2
CYDEV_CONFIG_UNUSED_IO EQU CYDEV_CONFIG_UNUSED_IO_Disallowed
CYDEV_CONFIGURATION_COMPRESSED EQU 1
CYDEV_CONFIGURATION_MODE_COMPRESSED EQU 0
CYDEV_CONFIGURATION_MODE EQU CYDEV_CONFIGURATION_MODE_COMPRESSED
CYDEV_CONFIGURATION_MODE_DMA EQU 2
CYDEV_CONFIGURATION_MODE_UNCOMPRESSED EQU 1
CYDEV_DEBUG_PROTECT_KILL EQU 4
CYDEV_DEBUG_PROTECT_OPEN EQU 1
CYDEV_DEBUG_PROTECT EQU CYDEV_DEBUG_PROTECT_OPEN
CYDEV_DEBUG_PROTECT_PROTECTED EQU 2
CYDEV_DEBUGGING_DPS_Disable EQU 3
CYDEV_DEBUGGING_DPS_SWD EQU 2
CYDEV_DEBUGGING_DPS EQU CYDEV_DEBUGGING_DPS_SWD
CYDEV_DEBUGGING_ENABLE EQU 1
CYDEV_DFT_SELECT_CLK0 EQU 10
CYDEV_DFT_SELECT_CLK1 EQU 11
CYDEV_DMA_CHANNELS_AVAILABLE EQU 8
CYDEV_HEAP_SIZE EQU 0x80
CYDEV_IMO_TRIMMED_BY_USB EQU 0
CYDEV_IMO_TRIMMED_BY_WCO EQU 0
CYDEV_INTR_NUMBER_DMA EQU 21
CYDEV_IS_EXPORTING_CODE EQU 0
CYDEV_IS_IMPORTING_CODE EQU 0
CYDEV_PROJ_TYPE EQU 0
CYDEV_PROJ_TYPE_BOOTLOADER EQU 1
CYDEV_PROJ_TYPE_LAUNCHER EQU 5
CYDEV_PROJ_TYPE_LOADABLE EQU 2
CYDEV_PROJ_TYPE_LOADABLEANDBOOTLOADER EQU 4
CYDEV_PROJ_TYPE_MULTIAPPBOOTLOADER EQU 3
CYDEV_PROJ_TYPE_STANDARD EQU 0
CYDEV_STACK_SIZE EQU 0x0800
CYDEV_USE_BUNDLED_CMSIS EQU 1
CYDEV_VARIABLE_VDDA EQU 1
CYDEV_VDDA_MV EQU 3300
CYDEV_VDDD_MV EQU 3300
CYDEV_VDDR_MV EQU 3300
CYDEV_WDT_GENERATE_ISR EQU 1
CYIPBLOCK_m0s8bless_VERSION EQU 2
CYIPBLOCK_m0s8cpussv2_VERSION EQU 1
CYIPBLOCK_m0s8csd_VERSION EQU 1
CYIPBLOCK_m0s8ioss_VERSION EQU 1
CYIPBLOCK_m0s8lcd_VERSION EQU 2
CYIPBLOCK_m0s8lpcomp_VERSION EQU 2
CYIPBLOCK_m0s8peri_VERSION EQU 1
CYIPBLOCK_m0s8scb_VERSION EQU 2
CYIPBLOCK_m0s8srssv2_VERSION EQU 1
CYIPBLOCK_m0s8tcpwm_VERSION EQU 2
CYIPBLOCK_m0s8udbif_VERSION EQU 1
CYIPBLOCK_s8pass4al_VERSION EQU 1
DMA_CHANNELS_USED__MASK EQU 0
CYDEV_BOOTLOADER_ENABLE EQU 0

#endif /* INCLUDED_CYFITTERIAR_INC */
