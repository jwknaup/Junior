;
; File Name: cyfitterrv.inc
; 
; PSoC Creator  4.1 Update 1
;
; Description:
; 
;
;-------------------------------------------------------------------------------
; Copyright (c) 2007-2017 Cypress Semiconductor.  All rights reserved.
; You may use this file only in accordance with the license, terms, conditions, 
; disclaimers, and limitations in the end user license agreement accompanying 
; the software package with which this file was provided.
;-------------------------------------------------------------------------------

    IF :LNOT::DEF:INCLUDED_CYFITTERRV_INC
INCLUDED_CYFITTERRV_INC EQU 1
    GET cydevicerv.inc
    GET cydevicerv_trm.inc

; C1
C1__0__INTTYPE EQU CYREG_PICU1_INTTYPE6
C1__0__MASK EQU 0x40
C1__0__PC EQU CYREG_PRT1_PC6
C1__0__PORT EQU 1
C1__0__SHIFT EQU 6
C1__AG EQU CYREG_PRT1_AG
C1__AMUX EQU CYREG_PRT1_AMUX
C1__BIE EQU CYREG_PRT1_BIE
C1__BIT_MASK EQU CYREG_PRT1_BIT_MASK
C1__BYP EQU CYREG_PRT1_BYP
C1__CTL EQU CYREG_PRT1_CTL
C1__DM0 EQU CYREG_PRT1_DM0
C1__DM1 EQU CYREG_PRT1_DM1
C1__DM2 EQU CYREG_PRT1_DM2
C1__DR EQU CYREG_PRT1_DR
C1__INP_DIS EQU CYREG_PRT1_INP_DIS
C1__INTTYPE_BASE EQU CYDEV_PICU_INTTYPE_PICU1_BASE
C1__LCD_COM_SEG EQU CYREG_PRT1_LCD_COM_SEG
C1__LCD_EN EQU CYREG_PRT1_LCD_EN
C1__MASK EQU 0x40
C1__PORT EQU 1
C1__PRT EQU CYREG_PRT1_PRT
C1__PRTDSI__CAPS_SEL EQU CYREG_PRT1_CAPS_SEL
C1__PRTDSI__DBL_SYNC_IN EQU CYREG_PRT1_DBL_SYNC_IN
C1__PRTDSI__OE_SEL0 EQU CYREG_PRT1_OE_SEL0
C1__PRTDSI__OE_SEL1 EQU CYREG_PRT1_OE_SEL1
C1__PRTDSI__OUT_SEL0 EQU CYREG_PRT1_OUT_SEL0
C1__PRTDSI__OUT_SEL1 EQU CYREG_PRT1_OUT_SEL1
C1__PRTDSI__SYNC_OUT EQU CYREG_PRT1_SYNC_OUT
C1__PS EQU CYREG_PRT1_PS
C1__SHIFT EQU 6
C1__SLW EQU CYREG_PRT1_SLW

; C2
C2__0__INTTYPE EQU CYREG_PICU1_INTTYPE5
C2__0__MASK EQU 0x20
C2__0__PC EQU CYREG_PRT1_PC5
C2__0__PORT EQU 1
C2__0__SHIFT EQU 5
C2__AG EQU CYREG_PRT1_AG
C2__AMUX EQU CYREG_PRT1_AMUX
C2__BIE EQU CYREG_PRT1_BIE
C2__BIT_MASK EQU CYREG_PRT1_BIT_MASK
C2__BYP EQU CYREG_PRT1_BYP
C2__CTL EQU CYREG_PRT1_CTL
C2__DM0 EQU CYREG_PRT1_DM0
C2__DM1 EQU CYREG_PRT1_DM1
C2__DM2 EQU CYREG_PRT1_DM2
C2__DR EQU CYREG_PRT1_DR
C2__INP_DIS EQU CYREG_PRT1_INP_DIS
C2__INTTYPE_BASE EQU CYDEV_PICU_INTTYPE_PICU1_BASE
C2__LCD_COM_SEG EQU CYREG_PRT1_LCD_COM_SEG
C2__LCD_EN EQU CYREG_PRT1_LCD_EN
C2__MASK EQU 0x20
C2__PORT EQU 1
C2__PRT EQU CYREG_PRT1_PRT
C2__PRTDSI__CAPS_SEL EQU CYREG_PRT1_CAPS_SEL
C2__PRTDSI__DBL_SYNC_IN EQU CYREG_PRT1_DBL_SYNC_IN
C2__PRTDSI__OE_SEL0 EQU CYREG_PRT1_OE_SEL0
C2__PRTDSI__OE_SEL1 EQU CYREG_PRT1_OE_SEL1
C2__PRTDSI__OUT_SEL0 EQU CYREG_PRT1_OUT_SEL0
C2__PRTDSI__OUT_SEL1 EQU CYREG_PRT1_OUT_SEL1
C2__PRTDSI__SYNC_OUT EQU CYREG_PRT1_SYNC_OUT
C2__PS EQU CYREG_PRT1_PS
C2__SHIFT EQU 5
C2__SLW EQU CYREG_PRT1_SLW

; Clock_1
Clock_1__CFG0 EQU CYREG_CLKDIST_DCFG0_CFG0
Clock_1__CFG1 EQU CYREG_CLKDIST_DCFG0_CFG1
Clock_1__CFG2 EQU CYREG_CLKDIST_DCFG0_CFG2
Clock_1__CFG2_SRC_SEL_MASK EQU 0x07
Clock_1__INDEX EQU 0x00
Clock_1__PM_ACT_CFG EQU CYREG_PM_ACT_CFG2
Clock_1__PM_ACT_MSK EQU 0x01
Clock_1__PM_STBY_CFG EQU CYREG_PM_STBY_CFG2
Clock_1__PM_STBY_MSK EQU 0x01

; adc
adc_bSAR_SEQ_ChannelCounter__16BIT_CONTROL_AUX_CTL_REG EQU CYREG_B1_UDB08_09_ACTL
adc_bSAR_SEQ_ChannelCounter__16BIT_CONTROL_CONTROL_REG EQU CYREG_B1_UDB08_09_CTL
adc_bSAR_SEQ_ChannelCounter__16BIT_CONTROL_COUNT_REG EQU CYREG_B1_UDB08_09_CTL
adc_bSAR_SEQ_ChannelCounter__16BIT_COUNT_CONTROL_REG EQU CYREG_B1_UDB08_09_CTL
adc_bSAR_SEQ_ChannelCounter__16BIT_COUNT_COUNT_REG EQU CYREG_B1_UDB08_09_CTL
adc_bSAR_SEQ_ChannelCounter__16BIT_MASK_MASK_REG EQU CYREG_B1_UDB08_09_MSK
adc_bSAR_SEQ_ChannelCounter__16BIT_MASK_PERIOD_REG EQU CYREG_B1_UDB08_09_MSK
adc_bSAR_SEQ_ChannelCounter__16BIT_PERIOD_MASK_REG EQU CYREG_B1_UDB08_09_MSK
adc_bSAR_SEQ_ChannelCounter__16BIT_PERIOD_PERIOD_REG EQU CYREG_B1_UDB08_09_MSK
adc_bSAR_SEQ_ChannelCounter__CONTROL_AUX_CTL_REG EQU CYREG_B1_UDB08_ACTL
adc_bSAR_SEQ_ChannelCounter__CONTROL_REG EQU CYREG_B1_UDB08_CTL
adc_bSAR_SEQ_ChannelCounter__CONTROL_ST_REG EQU CYREG_B1_UDB08_ST_CTL
adc_bSAR_SEQ_ChannelCounter__COUNT_REG EQU CYREG_B1_UDB08_CTL
adc_bSAR_SEQ_ChannelCounter__COUNT_ST_REG EQU CYREG_B1_UDB08_ST_CTL
adc_bSAR_SEQ_ChannelCounter__MASK_CTL_AUX_CTL_REG EQU CYREG_B1_UDB08_MSK_ACTL
adc_bSAR_SEQ_ChannelCounter__PER_CTL_AUX_CTL_REG EQU CYREG_B1_UDB08_MSK_ACTL
adc_bSAR_SEQ_ChannelCounter__PERIOD_REG EQU CYREG_B1_UDB08_MSK
adc_bSAR_SEQ_ChannelCounter_ST__16BIT_STATUS_AUX_CTL_REG EQU CYREG_B1_UDB08_09_ACTL
adc_bSAR_SEQ_ChannelCounter_ST__16BIT_STATUS_REG EQU CYREG_B1_UDB08_09_ST
adc_bSAR_SEQ_ChannelCounter_ST__MASK_REG EQU CYREG_B1_UDB08_MSK
adc_bSAR_SEQ_ChannelCounter_ST__MASK_ST_AUX_CTL_REG EQU CYREG_B1_UDB08_MSK_ACTL
adc_bSAR_SEQ_ChannelCounter_ST__PER_ST_AUX_CTL_REG EQU CYREG_B1_UDB08_MSK_ACTL
adc_bSAR_SEQ_ChannelCounter_ST__STATUS_AUX_CTL_REG EQU CYREG_B1_UDB08_ACTL
adc_bSAR_SEQ_ChannelCounter_ST__STATUS_CNT_REG EQU CYREG_B1_UDB08_ST_CTL
adc_bSAR_SEQ_ChannelCounter_ST__STATUS_CONTROL_REG EQU CYREG_B1_UDB08_ST_CTL
adc_bSAR_SEQ_ChannelCounter_ST__STATUS_REG EQU CYREG_B1_UDB08_ST
adc_bSAR_SEQ_CtrlReg__0__MASK EQU 0x01
adc_bSAR_SEQ_CtrlReg__0__POS EQU 0
adc_bSAR_SEQ_CtrlReg__1__MASK EQU 0x02
adc_bSAR_SEQ_CtrlReg__1__POS EQU 1
adc_bSAR_SEQ_CtrlReg__16BIT_CONTROL_AUX_CTL_REG EQU CYREG_B0_UDB08_09_ACTL
adc_bSAR_SEQ_CtrlReg__16BIT_CONTROL_CONTROL_REG EQU CYREG_B0_UDB08_09_CTL
adc_bSAR_SEQ_CtrlReg__16BIT_CONTROL_COUNT_REG EQU CYREG_B0_UDB08_09_CTL
adc_bSAR_SEQ_CtrlReg__16BIT_COUNT_CONTROL_REG EQU CYREG_B0_UDB08_09_CTL
adc_bSAR_SEQ_CtrlReg__16BIT_COUNT_COUNT_REG EQU CYREG_B0_UDB08_09_CTL
adc_bSAR_SEQ_CtrlReg__16BIT_MASK_MASK_REG EQU CYREG_B0_UDB08_09_MSK
adc_bSAR_SEQ_CtrlReg__16BIT_MASK_PERIOD_REG EQU CYREG_B0_UDB08_09_MSK
adc_bSAR_SEQ_CtrlReg__16BIT_PERIOD_MASK_REG EQU CYREG_B0_UDB08_09_MSK
adc_bSAR_SEQ_CtrlReg__16BIT_PERIOD_PERIOD_REG EQU CYREG_B0_UDB08_09_MSK
adc_bSAR_SEQ_CtrlReg__CONTROL_AUX_CTL_REG EQU CYREG_B0_UDB08_ACTL
adc_bSAR_SEQ_CtrlReg__CONTROL_REG EQU CYREG_B0_UDB08_CTL
adc_bSAR_SEQ_CtrlReg__CONTROL_ST_REG EQU CYREG_B0_UDB08_ST_CTL
adc_bSAR_SEQ_CtrlReg__COUNT_REG EQU CYREG_B0_UDB08_CTL
adc_bSAR_SEQ_CtrlReg__COUNT_ST_REG EQU CYREG_B0_UDB08_ST_CTL
adc_bSAR_SEQ_CtrlReg__MASK EQU 0x03
adc_bSAR_SEQ_CtrlReg__MASK_CTL_AUX_CTL_REG EQU CYREG_B0_UDB08_MSK_ACTL
adc_bSAR_SEQ_CtrlReg__PER_CTL_AUX_CTL_REG EQU CYREG_B0_UDB08_MSK_ACTL
adc_bSAR_SEQ_CtrlReg__PERIOD_REG EQU CYREG_B0_UDB08_MSK
adc_bSAR_SEQ_EOCSts__0__MASK EQU 0x01
adc_bSAR_SEQ_EOCSts__0__POS EQU 0
adc_bSAR_SEQ_EOCSts__16BIT_STATUS_AUX_CTL_REG EQU CYREG_B0_UDB11_12_ACTL
adc_bSAR_SEQ_EOCSts__16BIT_STATUS_REG EQU CYREG_B0_UDB11_12_ST
adc_bSAR_SEQ_EOCSts__MASK EQU 0x01
adc_bSAR_SEQ_EOCSts__MASK_REG EQU CYREG_B0_UDB11_MSK
adc_bSAR_SEQ_EOCSts__STATUS_AUX_CTL_REG EQU CYREG_B0_UDB11_ACTL
adc_bSAR_SEQ_EOCSts__STATUS_REG EQU CYREG_B0_UDB11_ST
adc_FinalBuf__DRQ_CTL EQU CYREG_IDMUX_DRQ_CTL0
adc_FinalBuf__DRQ_NUMBER EQU 0
adc_FinalBuf__NUMBEROF_TDS EQU 0
adc_FinalBuf__PRIORITY EQU 2
adc_FinalBuf__TERMIN_EN EQU 0
adc_FinalBuf__TERMIN_SEL EQU 0
adc_FinalBuf__TERMOUT0_EN EQU 1
adc_FinalBuf__TERMOUT0_SEL EQU 0
adc_FinalBuf__TERMOUT1_EN EQU 0
adc_FinalBuf__TERMOUT1_SEL EQU 0
adc_IntClock__CFG0 EQU CYREG_CLKDIST_DCFG1_CFG0
adc_IntClock__CFG1 EQU CYREG_CLKDIST_DCFG1_CFG1
adc_IntClock__CFG2 EQU CYREG_CLKDIST_DCFG1_CFG2
adc_IntClock__CFG2_SRC_SEL_MASK EQU 0x07
adc_IntClock__INDEX EQU 0x01
adc_IntClock__PM_ACT_CFG EQU CYREG_PM_ACT_CFG2
adc_IntClock__PM_ACT_MSK EQU 0x02
adc_IntClock__PM_STBY_CFG EQU CYREG_PM_STBY_CFG2
adc_IntClock__PM_STBY_MSK EQU 0x02
adc_IRQ__INTC_CLR_EN_REG EQU CYREG_NVIC_CLRENA0
adc_IRQ__INTC_CLR_PD_REG EQU CYREG_NVIC_CLRPEND0
adc_IRQ__INTC_MASK EQU 0x01
adc_IRQ__INTC_NUMBER EQU 0
adc_IRQ__INTC_PRIOR_NUM EQU 7
adc_IRQ__INTC_PRIOR_REG EQU CYREG_NVIC_PRI_0
adc_IRQ__INTC_SET_EN_REG EQU CYREG_NVIC_SETENA0
adc_IRQ__INTC_SET_PD_REG EQU CYREG_NVIC_SETPEND0
adc_SAR_ADC_SAR__CLK EQU CYREG_SAR1_CLK
adc_SAR_ADC_SAR__CSR0 EQU CYREG_SAR1_CSR0
adc_SAR_ADC_SAR__CSR1 EQU CYREG_SAR1_CSR1
adc_SAR_ADC_SAR__CSR2 EQU CYREG_SAR1_CSR2
adc_SAR_ADC_SAR__CSR3 EQU CYREG_SAR1_CSR3
adc_SAR_ADC_SAR__CSR4 EQU CYREG_SAR1_CSR4
adc_SAR_ADC_SAR__CSR5 EQU CYREG_SAR1_CSR5
adc_SAR_ADC_SAR__CSR6 EQU CYREG_SAR1_CSR6
adc_SAR_ADC_SAR__PM_ACT_CFG EQU CYREG_PM_ACT_CFG11
adc_SAR_ADC_SAR__PM_ACT_MSK EQU 0x02
adc_SAR_ADC_SAR__PM_STBY_CFG EQU CYREG_PM_STBY_CFG11
adc_SAR_ADC_SAR__PM_STBY_MSK EQU 0x02
adc_SAR_ADC_SAR__SW0 EQU CYREG_SAR1_SW0
adc_SAR_ADC_SAR__SW2 EQU CYREG_SAR1_SW2
adc_SAR_ADC_SAR__SW3 EQU CYREG_SAR1_SW3
adc_SAR_ADC_SAR__SW4 EQU CYREG_SAR1_SW4
adc_SAR_ADC_SAR__SW6 EQU CYREG_SAR1_SW6
adc_SAR_ADC_SAR__TR0 EQU CYREG_SAR1_TR0
adc_SAR_ADC_SAR__WRK0 EQU CYREG_SAR1_WRK0
adc_SAR_ADC_SAR__WRK1 EQU CYREG_SAR1_WRK1
adc_TempBuf__DRQ_CTL EQU CYREG_IDMUX_DRQ_CTL0
adc_TempBuf__DRQ_NUMBER EQU 1
adc_TempBuf__NUMBEROF_TDS EQU 0
adc_TempBuf__PRIORITY EQU 2
adc_TempBuf__TERMIN_EN EQU 0
adc_TempBuf__TERMIN_SEL EQU 0
adc_TempBuf__TERMOUT0_EN EQU 1
adc_TempBuf__TERMOUT0_SEL EQU 1
adc_TempBuf__TERMOUT1_EN EQU 0
adc_TempBuf__TERMOUT1_SEL EQU 0

; enc
enc_bQuadDec_Stsreg__0__MASK EQU 0x01
enc_bQuadDec_Stsreg__0__POS EQU 0
enc_bQuadDec_Stsreg__1__MASK EQU 0x02
enc_bQuadDec_Stsreg__1__POS EQU 1
enc_bQuadDec_Stsreg__16BIT_STATUS_AUX_CTL_REG EQU CYREG_B0_UDB14_15_ACTL
enc_bQuadDec_Stsreg__16BIT_STATUS_REG EQU CYREG_B0_UDB14_15_ST
enc_bQuadDec_Stsreg__2__MASK EQU 0x04
enc_bQuadDec_Stsreg__2__POS EQU 2
enc_bQuadDec_Stsreg__3__MASK EQU 0x08
enc_bQuadDec_Stsreg__3__POS EQU 3
enc_bQuadDec_Stsreg__MASK EQU 0x0F
enc_bQuadDec_Stsreg__MASK_REG EQU CYREG_B0_UDB14_MSK
enc_bQuadDec_Stsreg__STATUS_AUX_CTL_REG EQU CYREG_B0_UDB14_ACTL
enc_bQuadDec_Stsreg__STATUS_REG EQU CYREG_B0_UDB14_ST
enc_Cnt16_CounterUDB_sC16_counterdp_u0__16BIT_A0_REG EQU CYREG_B0_UDB12_13_A0
enc_Cnt16_CounterUDB_sC16_counterdp_u0__16BIT_A1_REG EQU CYREG_B0_UDB12_13_A1
enc_Cnt16_CounterUDB_sC16_counterdp_u0__16BIT_D0_REG EQU CYREG_B0_UDB12_13_D0
enc_Cnt16_CounterUDB_sC16_counterdp_u0__16BIT_D1_REG EQU CYREG_B0_UDB12_13_D1
enc_Cnt16_CounterUDB_sC16_counterdp_u0__16BIT_DP_AUX_CTL_REG EQU CYREG_B0_UDB12_13_ACTL
enc_Cnt16_CounterUDB_sC16_counterdp_u0__16BIT_F0_REG EQU CYREG_B0_UDB12_13_F0
enc_Cnt16_CounterUDB_sC16_counterdp_u0__16BIT_F1_REG EQU CYREG_B0_UDB12_13_F1
enc_Cnt16_CounterUDB_sC16_counterdp_u0__A0_A1_REG EQU CYREG_B0_UDB12_A0_A1
enc_Cnt16_CounterUDB_sC16_counterdp_u0__A0_REG EQU CYREG_B0_UDB12_A0
enc_Cnt16_CounterUDB_sC16_counterdp_u0__A1_REG EQU CYREG_B0_UDB12_A1
enc_Cnt16_CounterUDB_sC16_counterdp_u0__D0_D1_REG EQU CYREG_B0_UDB12_D0_D1
enc_Cnt16_CounterUDB_sC16_counterdp_u0__D0_REG EQU CYREG_B0_UDB12_D0
enc_Cnt16_CounterUDB_sC16_counterdp_u0__D1_REG EQU CYREG_B0_UDB12_D1
enc_Cnt16_CounterUDB_sC16_counterdp_u0__DP_AUX_CTL_REG EQU CYREG_B0_UDB12_ACTL
enc_Cnt16_CounterUDB_sC16_counterdp_u0__F0_F1_REG EQU CYREG_B0_UDB12_F0_F1
enc_Cnt16_CounterUDB_sC16_counterdp_u0__F0_REG EQU CYREG_B0_UDB12_F0
enc_Cnt16_CounterUDB_sC16_counterdp_u0__F1_REG EQU CYREG_B0_UDB12_F1
enc_Cnt16_CounterUDB_sC16_counterdp_u1__16BIT_A0_REG EQU CYREG_B0_UDB13_14_A0
enc_Cnt16_CounterUDB_sC16_counterdp_u1__16BIT_A1_REG EQU CYREG_B0_UDB13_14_A1
enc_Cnt16_CounterUDB_sC16_counterdp_u1__16BIT_D0_REG EQU CYREG_B0_UDB13_14_D0
enc_Cnt16_CounterUDB_sC16_counterdp_u1__16BIT_D1_REG EQU CYREG_B0_UDB13_14_D1
enc_Cnt16_CounterUDB_sC16_counterdp_u1__16BIT_DP_AUX_CTL_REG EQU CYREG_B0_UDB13_14_ACTL
enc_Cnt16_CounterUDB_sC16_counterdp_u1__16BIT_F0_REG EQU CYREG_B0_UDB13_14_F0
enc_Cnt16_CounterUDB_sC16_counterdp_u1__16BIT_F1_REG EQU CYREG_B0_UDB13_14_F1
enc_Cnt16_CounterUDB_sC16_counterdp_u1__A0_A1_REG EQU CYREG_B0_UDB13_A0_A1
enc_Cnt16_CounterUDB_sC16_counterdp_u1__A0_REG EQU CYREG_B0_UDB13_A0
enc_Cnt16_CounterUDB_sC16_counterdp_u1__A1_REG EQU CYREG_B0_UDB13_A1
enc_Cnt16_CounterUDB_sC16_counterdp_u1__D0_D1_REG EQU CYREG_B0_UDB13_D0_D1
enc_Cnt16_CounterUDB_sC16_counterdp_u1__D0_REG EQU CYREG_B0_UDB13_D0
enc_Cnt16_CounterUDB_sC16_counterdp_u1__D1_REG EQU CYREG_B0_UDB13_D1
enc_Cnt16_CounterUDB_sC16_counterdp_u1__DP_AUX_CTL_REG EQU CYREG_B0_UDB13_ACTL
enc_Cnt16_CounterUDB_sC16_counterdp_u1__F0_F1_REG EQU CYREG_B0_UDB13_F0_F1
enc_Cnt16_CounterUDB_sC16_counterdp_u1__F0_REG EQU CYREG_B0_UDB13_F0
enc_Cnt16_CounterUDB_sC16_counterdp_u1__F1_REG EQU CYREG_B0_UDB13_F1
enc_Cnt16_CounterUDB_sCTRLReg_ctrlreg__7__MASK EQU 0x80
enc_Cnt16_CounterUDB_sCTRLReg_ctrlreg__7__POS EQU 7
enc_Cnt16_CounterUDB_sCTRLReg_ctrlreg__CONTROL_AUX_CTL_REG EQU CYREG_B0_UDB15_ACTL
enc_Cnt16_CounterUDB_sCTRLReg_ctrlreg__CONTROL_REG EQU CYREG_B0_UDB15_CTL
enc_Cnt16_CounterUDB_sCTRLReg_ctrlreg__CONTROL_ST_REG EQU CYREG_B0_UDB15_ST_CTL
enc_Cnt16_CounterUDB_sCTRLReg_ctrlreg__COUNT_REG EQU CYREG_B0_UDB15_CTL
enc_Cnt16_CounterUDB_sCTRLReg_ctrlreg__COUNT_ST_REG EQU CYREG_B0_UDB15_ST_CTL
enc_Cnt16_CounterUDB_sCTRLReg_ctrlreg__MASK EQU 0x80
enc_Cnt16_CounterUDB_sCTRLReg_ctrlreg__MASK_CTL_AUX_CTL_REG EQU CYREG_B0_UDB15_MSK_ACTL
enc_Cnt16_CounterUDB_sCTRLReg_ctrlreg__PER_CTL_AUX_CTL_REG EQU CYREG_B0_UDB15_MSK_ACTL
enc_Cnt16_CounterUDB_sCTRLReg_ctrlreg__PERIOD_REG EQU CYREG_B0_UDB15_MSK
enc_Cnt16_CounterUDB_sSTSReg_stsreg__0__MASK EQU 0x01
enc_Cnt16_CounterUDB_sSTSReg_stsreg__0__POS EQU 0
enc_Cnt16_CounterUDB_sSTSReg_stsreg__1__MASK EQU 0x02
enc_Cnt16_CounterUDB_sSTSReg_stsreg__1__POS EQU 1
enc_Cnt16_CounterUDB_sSTSReg_stsreg__16BIT_STATUS_AUX_CTL_REG EQU CYREG_B0_UDB10_11_ACTL
enc_Cnt16_CounterUDB_sSTSReg_stsreg__16BIT_STATUS_REG EQU CYREG_B0_UDB10_11_ST
enc_Cnt16_CounterUDB_sSTSReg_stsreg__2__MASK EQU 0x04
enc_Cnt16_CounterUDB_sSTSReg_stsreg__2__POS EQU 2
enc_Cnt16_CounterUDB_sSTSReg_stsreg__3__MASK EQU 0x08
enc_Cnt16_CounterUDB_sSTSReg_stsreg__3__POS EQU 3
enc_Cnt16_CounterUDB_sSTSReg_stsreg__5__MASK EQU 0x20
enc_Cnt16_CounterUDB_sSTSReg_stsreg__5__POS EQU 5
enc_Cnt16_CounterUDB_sSTSReg_stsreg__6__MASK EQU 0x40
enc_Cnt16_CounterUDB_sSTSReg_stsreg__6__POS EQU 6
enc_Cnt16_CounterUDB_sSTSReg_stsreg__MASK EQU 0x6F
enc_Cnt16_CounterUDB_sSTSReg_stsreg__MASK_REG EQU CYREG_B0_UDB10_MSK
enc_Cnt16_CounterUDB_sSTSReg_stsreg__STATUS_AUX_CTL_REG EQU CYREG_B0_UDB10_ACTL
enc_Cnt16_CounterUDB_sSTSReg_stsreg__STATUS_REG EQU CYREG_B0_UDB10_ST
enc_isr__INTC_CLR_EN_REG EQU CYREG_NVIC_CLRENA0
enc_isr__INTC_CLR_PD_REG EQU CYREG_NVIC_CLRPEND0
enc_isr__INTC_MASK EQU 0x02
enc_isr__INTC_NUMBER EQU 1
enc_isr__INTC_PRIOR_NUM EQU 7
enc_isr__INTC_PRIOR_REG EQU CYREG_NVIC_PRI_1
enc_isr__INTC_SET_EN_REG EQU CYREG_NVIC_SETENA0
enc_isr__INTC_SET_PD_REG EQU CYREG_NVIC_SETPEND0

; lcd_LCDPort
lcd_LCDPort__0__INTTYPE EQU CYREG_PICU2_INTTYPE0
lcd_LCDPort__0__MASK EQU 0x01
lcd_LCDPort__0__PC EQU CYREG_PRT2_PC0
lcd_LCDPort__0__PORT EQU 2
lcd_LCDPort__0__SHIFT EQU 0
lcd_LCDPort__1__INTTYPE EQU CYREG_PICU2_INTTYPE1
lcd_LCDPort__1__MASK EQU 0x02
lcd_LCDPort__1__PC EQU CYREG_PRT2_PC1
lcd_LCDPort__1__PORT EQU 2
lcd_LCDPort__1__SHIFT EQU 1
lcd_LCDPort__2__INTTYPE EQU CYREG_PICU2_INTTYPE2
lcd_LCDPort__2__MASK EQU 0x04
lcd_LCDPort__2__PC EQU CYREG_PRT2_PC2
lcd_LCDPort__2__PORT EQU 2
lcd_LCDPort__2__SHIFT EQU 2
lcd_LCDPort__3__INTTYPE EQU CYREG_PICU2_INTTYPE3
lcd_LCDPort__3__MASK EQU 0x08
lcd_LCDPort__3__PC EQU CYREG_PRT2_PC3
lcd_LCDPort__3__PORT EQU 2
lcd_LCDPort__3__SHIFT EQU 3
lcd_LCDPort__4__INTTYPE EQU CYREG_PICU2_INTTYPE4
lcd_LCDPort__4__MASK EQU 0x10
lcd_LCDPort__4__PC EQU CYREG_PRT2_PC4
lcd_LCDPort__4__PORT EQU 2
lcd_LCDPort__4__SHIFT EQU 4
lcd_LCDPort__5__INTTYPE EQU CYREG_PICU2_INTTYPE5
lcd_LCDPort__5__MASK EQU 0x20
lcd_LCDPort__5__PC EQU CYREG_PRT2_PC5
lcd_LCDPort__5__PORT EQU 2
lcd_LCDPort__5__SHIFT EQU 5
lcd_LCDPort__6__INTTYPE EQU CYREG_PICU2_INTTYPE6
lcd_LCDPort__6__MASK EQU 0x40
lcd_LCDPort__6__PC EQU CYREG_PRT2_PC6
lcd_LCDPort__6__PORT EQU 2
lcd_LCDPort__6__SHIFT EQU 6
lcd_LCDPort__AG EQU CYREG_PRT2_AG
lcd_LCDPort__AMUX EQU CYREG_PRT2_AMUX
lcd_LCDPort__BIE EQU CYREG_PRT2_BIE
lcd_LCDPort__BIT_MASK EQU CYREG_PRT2_BIT_MASK
lcd_LCDPort__BYP EQU CYREG_PRT2_BYP
lcd_LCDPort__CTL EQU CYREG_PRT2_CTL
lcd_LCDPort__DM0 EQU CYREG_PRT2_DM0
lcd_LCDPort__DM1 EQU CYREG_PRT2_DM1
lcd_LCDPort__DM2 EQU CYREG_PRT2_DM2
lcd_LCDPort__DR EQU CYREG_PRT2_DR
lcd_LCDPort__INP_DIS EQU CYREG_PRT2_INP_DIS
lcd_LCDPort__INTTYPE_BASE EQU CYDEV_PICU_INTTYPE_PICU2_BASE
lcd_LCDPort__LCD_COM_SEG EQU CYREG_PRT2_LCD_COM_SEG
lcd_LCDPort__LCD_EN EQU CYREG_PRT2_LCD_EN
lcd_LCDPort__MASK EQU 0x7F
lcd_LCDPort__PORT EQU 2
lcd_LCDPort__PRT EQU CYREG_PRT2_PRT
lcd_LCDPort__PRTDSI__CAPS_SEL EQU CYREG_PRT2_CAPS_SEL
lcd_LCDPort__PRTDSI__DBL_SYNC_IN EQU CYREG_PRT2_DBL_SYNC_IN
lcd_LCDPort__PRTDSI__OE_SEL0 EQU CYREG_PRT2_OE_SEL0
lcd_LCDPort__PRTDSI__OE_SEL1 EQU CYREG_PRT2_OE_SEL1
lcd_LCDPort__PRTDSI__OUT_SEL0 EQU CYREG_PRT2_OUT_SEL0
lcd_LCDPort__PRTDSI__OUT_SEL1 EQU CYREG_PRT2_OUT_SEL1
lcd_LCDPort__PRTDSI__SYNC_OUT EQU CYREG_PRT2_SYNC_OUT
lcd_LCDPort__PS EQU CYREG_PRT2_PS
lcd_LCDPort__SHIFT EQU 0
lcd_LCDPort__SLW EQU CYREG_PRT2_SLW

; pot
pot__0__INTTYPE EQU CYREG_PICU1_INTTYPE4
pot__0__MASK EQU 0x10
pot__0__PC EQU CYREG_PRT1_PC4
pot__0__PORT EQU 1
pot__0__SHIFT EQU 4
pot__AG EQU CYREG_PRT1_AG
pot__AMUX EQU CYREG_PRT1_AMUX
pot__BIE EQU CYREG_PRT1_BIE
pot__BIT_MASK EQU CYREG_PRT1_BIT_MASK
pot__BYP EQU CYREG_PRT1_BYP
pot__CTL EQU CYREG_PRT1_CTL
pot__DM0 EQU CYREG_PRT1_DM0
pot__DM1 EQU CYREG_PRT1_DM1
pot__DM2 EQU CYREG_PRT1_DM2
pot__DR EQU CYREG_PRT1_DR
pot__INP_DIS EQU CYREG_PRT1_INP_DIS
pot__INTTYPE_BASE EQU CYDEV_PICU_INTTYPE_PICU1_BASE
pot__LCD_COM_SEG EQU CYREG_PRT1_LCD_COM_SEG
pot__LCD_EN EQU CYREG_PRT1_LCD_EN
pot__MASK EQU 0x10
pot__PORT EQU 1
pot__PRT EQU CYREG_PRT1_PRT
pot__PRTDSI__CAPS_SEL EQU CYREG_PRT1_CAPS_SEL
pot__PRTDSI__DBL_SYNC_IN EQU CYREG_PRT1_DBL_SYNC_IN
pot__PRTDSI__OE_SEL0 EQU CYREG_PRT1_OE_SEL0
pot__PRTDSI__OE_SEL1 EQU CYREG_PRT1_OE_SEL1
pot__PRTDSI__OUT_SEL0 EQU CYREG_PRT1_OUT_SEL0
pot__PRTDSI__OUT_SEL1 EQU CYREG_PRT1_OUT_SEL1
pot__PRTDSI__SYNC_OUT EQU CYREG_PRT1_SYNC_OUT
pot__PS EQU CYREG_PRT1_PS
pot__SHIFT EQU 4
pot__SLW EQU CYREG_PRT1_SLW

; switch1
switch1__0__INTTYPE EQU CYREG_PICU1_INTTYPE7
switch1__0__MASK EQU 0x80
switch1__0__PC EQU CYREG_PRT1_PC7
switch1__0__PORT EQU 1
switch1__0__SHIFT EQU 7
switch1__AG EQU CYREG_PRT1_AG
switch1__AMUX EQU CYREG_PRT1_AMUX
switch1__BIE EQU CYREG_PRT1_BIE
switch1__BIT_MASK EQU CYREG_PRT1_BIT_MASK
switch1__BYP EQU CYREG_PRT1_BYP
switch1__CTL EQU CYREG_PRT1_CTL
switch1__DM0 EQU CYREG_PRT1_DM0
switch1__DM1 EQU CYREG_PRT1_DM1
switch1__DM2 EQU CYREG_PRT1_DM2
switch1__DR EQU CYREG_PRT1_DR
switch1__INP_DIS EQU CYREG_PRT1_INP_DIS
switch1__INTTYPE_BASE EQU CYDEV_PICU_INTTYPE_PICU1_BASE
switch1__LCD_COM_SEG EQU CYREG_PRT1_LCD_COM_SEG
switch1__LCD_EN EQU CYREG_PRT1_LCD_EN
switch1__MASK EQU 0x80
switch1__PORT EQU 1
switch1__PRT EQU CYREG_PRT1_PRT
switch1__PRTDSI__CAPS_SEL EQU CYREG_PRT1_CAPS_SEL
switch1__PRTDSI__DBL_SYNC_IN EQU CYREG_PRT1_DBL_SYNC_IN
switch1__PRTDSI__OE_SEL0 EQU CYREG_PRT1_OE_SEL0
switch1__PRTDSI__OE_SEL1 EQU CYREG_PRT1_OE_SEL1
switch1__PRTDSI__OUT_SEL0 EQU CYREG_PRT1_OUT_SEL0
switch1__PRTDSI__OUT_SEL1 EQU CYREG_PRT1_OUT_SEL1
switch1__PRTDSI__SYNC_OUT EQU CYREG_PRT1_SYNC_OUT
switch1__PS EQU CYREG_PRT1_PS
switch1__SHIFT EQU 7
switch1__SLW EQU CYREG_PRT1_SLW

; Miscellaneous
BCLK__BUS_CLK__HZ EQU 24000000
BCLK__BUS_CLK__KHZ EQU 24000
BCLK__BUS_CLK__MHZ EQU 24
CYDEV_CHIP_DIE_LEOPARD EQU 1
CYDEV_CHIP_DIE_PSOC4A EQU 16
CYDEV_CHIP_DIE_PSOC5LP EQU 2
CYDEV_CHIP_DIE_PSOC5TM EQU 3
CYDEV_CHIP_DIE_TMA4 EQU 4
CYDEV_CHIP_DIE_UNKNOWN EQU 0
CYDEV_CHIP_FAMILY_FM0P EQU 5
CYDEV_CHIP_FAMILY_FM3 EQU 6
CYDEV_CHIP_FAMILY_FM4 EQU 7
CYDEV_CHIP_FAMILY_PSOC3 EQU 1
CYDEV_CHIP_FAMILY_PSOC4 EQU 2
CYDEV_CHIP_FAMILY_PSOC5 EQU 3
CYDEV_CHIP_FAMILY_PSOC6 EQU 4
CYDEV_CHIP_FAMILY_UNKNOWN EQU 0
CYDEV_CHIP_FAMILY_USED EQU CYDEV_CHIP_FAMILY_PSOC5
CYDEV_CHIP_JTAG_ID EQU 0x2E161069
CYDEV_CHIP_MEMBER_3A EQU 1
CYDEV_CHIP_MEMBER_4A EQU 16
CYDEV_CHIP_MEMBER_4D EQU 12
CYDEV_CHIP_MEMBER_4E EQU 6
CYDEV_CHIP_MEMBER_4F EQU 17
CYDEV_CHIP_MEMBER_4G EQU 4
CYDEV_CHIP_MEMBER_4H EQU 15
CYDEV_CHIP_MEMBER_4I EQU 21
CYDEV_CHIP_MEMBER_4J EQU 13
CYDEV_CHIP_MEMBER_4K EQU 14
CYDEV_CHIP_MEMBER_4L EQU 20
CYDEV_CHIP_MEMBER_4M EQU 19
CYDEV_CHIP_MEMBER_4N EQU 9
CYDEV_CHIP_MEMBER_4O EQU 7
CYDEV_CHIP_MEMBER_4P EQU 18
CYDEV_CHIP_MEMBER_4Q EQU 11
CYDEV_CHIP_MEMBER_4R EQU 8
CYDEV_CHIP_MEMBER_4S EQU 10
CYDEV_CHIP_MEMBER_4U EQU 5
CYDEV_CHIP_MEMBER_5A EQU 3
CYDEV_CHIP_MEMBER_5B EQU 2
CYDEV_CHIP_MEMBER_6A EQU 22
CYDEV_CHIP_MEMBER_FM3 EQU 26
CYDEV_CHIP_MEMBER_FM4 EQU 27
CYDEV_CHIP_MEMBER_PDL_FM0P_TYPE1 EQU 23
CYDEV_CHIP_MEMBER_PDL_FM0P_TYPE2 EQU 24
CYDEV_CHIP_MEMBER_PDL_FM0P_TYPE3 EQU 25
CYDEV_CHIP_MEMBER_UNKNOWN EQU 0
CYDEV_CHIP_MEMBER_USED EQU CYDEV_CHIP_MEMBER_5B
CYDEV_CHIP_DIE_EXPECT EQU CYDEV_CHIP_MEMBER_USED
CYDEV_CHIP_DIE_ACTUAL EQU CYDEV_CHIP_DIE_EXPECT
CYDEV_CHIP_REV_LEOPARD_ES1 EQU 0
CYDEV_CHIP_REV_LEOPARD_ES2 EQU 1
CYDEV_CHIP_REV_LEOPARD_ES3 EQU 3
CYDEV_CHIP_REV_LEOPARD_PRODUCTION EQU 3
CYDEV_CHIP_REV_PSOC4A_ES0 EQU 17
CYDEV_CHIP_REV_PSOC4A_PRODUCTION EQU 17
CYDEV_CHIP_REV_PSOC5LP_ES0 EQU 0
CYDEV_CHIP_REV_PSOC5LP_PRODUCTION EQU 0
CYDEV_CHIP_REV_PSOC5TM_ES0 EQU 0
CYDEV_CHIP_REV_PSOC5TM_ES1 EQU 1
CYDEV_CHIP_REV_PSOC5TM_PRODUCTION EQU 1
CYDEV_CHIP_REV_TMA4_ES EQU 17
CYDEV_CHIP_REV_TMA4_ES2 EQU 33
CYDEV_CHIP_REV_TMA4_PRODUCTION EQU 17
CYDEV_CHIP_REVISION_3A_ES1 EQU 0
CYDEV_CHIP_REVISION_3A_ES2 EQU 1
CYDEV_CHIP_REVISION_3A_ES3 EQU 3
CYDEV_CHIP_REVISION_3A_PRODUCTION EQU 3
CYDEV_CHIP_REVISION_4A_ES0 EQU 17
CYDEV_CHIP_REVISION_4A_PRODUCTION EQU 17
CYDEV_CHIP_REVISION_4D_PRODUCTION EQU 0
CYDEV_CHIP_REVISION_4E_PRODUCTION EQU 0
CYDEV_CHIP_REVISION_4F_PRODUCTION EQU 0
CYDEV_CHIP_REVISION_4F_PRODUCTION_256DMA EQU 0
CYDEV_CHIP_REVISION_4F_PRODUCTION_256K EQU 0
CYDEV_CHIP_REVISION_4G_ES EQU 17
CYDEV_CHIP_REVISION_4G_ES2 EQU 33
CYDEV_CHIP_REVISION_4G_PRODUCTION EQU 17
CYDEV_CHIP_REVISION_4H_PRODUCTION EQU 0
CYDEV_CHIP_REVISION_4I_PRODUCTION EQU 0
CYDEV_CHIP_REVISION_4J_PRODUCTION EQU 0
CYDEV_CHIP_REVISION_4K_PRODUCTION EQU 0
CYDEV_CHIP_REVISION_4L_PRODUCTION EQU 0
CYDEV_CHIP_REVISION_4M_PRODUCTION EQU 0
CYDEV_CHIP_REVISION_4N_PRODUCTION EQU 0
CYDEV_CHIP_REVISION_4O_PRODUCTION EQU 0
CYDEV_CHIP_REVISION_4P_PRODUCTION EQU 0
CYDEV_CHIP_REVISION_4Q_PRODUCTION EQU 0
CYDEV_CHIP_REVISION_4R_PRODUCTION EQU 0
CYDEV_CHIP_REVISION_4S_PRODUCTION EQU 0
CYDEV_CHIP_REVISION_4U_PRODUCTION EQU 0
CYDEV_CHIP_REVISION_5A_ES0 EQU 0
CYDEV_CHIP_REVISION_5A_ES1 EQU 1
CYDEV_CHIP_REVISION_5A_PRODUCTION EQU 1
CYDEV_CHIP_REVISION_5B_ES0 EQU 0
CYDEV_CHIP_REVISION_5B_PRODUCTION EQU 0
CYDEV_CHIP_REVISION_6A_NO_UDB EQU 0
CYDEV_CHIP_REVISION_6A_PRODUCTION EQU 0
CYDEV_CHIP_REVISION_FM3_PRODUCTION EQU 0
CYDEV_CHIP_REVISION_FM4_PRODUCTION EQU 0
CYDEV_CHIP_REVISION_PDL_FM0P_TYPE1_PRODUCTION EQU 0
CYDEV_CHIP_REVISION_PDL_FM0P_TYPE2_PRODUCTION EQU 0
CYDEV_CHIP_REVISION_PDL_FM0P_TYPE3_PRODUCTION EQU 0
CYDEV_CHIP_REVISION_USED EQU CYDEV_CHIP_REVISION_5B_PRODUCTION
CYDEV_CHIP_REV_EXPECT EQU CYDEV_CHIP_REVISION_USED
CYDEV_CONFIG_FASTBOOT_ENABLED EQU 1
CYDEV_CONFIG_UNUSED_IO_AllowButWarn EQU 0
CYDEV_CONFIG_UNUSED_IO EQU CYDEV_CONFIG_UNUSED_IO_AllowButWarn
CYDEV_CONFIG_UNUSED_IO_AllowWithInfo EQU 1
CYDEV_CONFIG_UNUSED_IO_Disallowed EQU 2
CYDEV_CONFIGURATION_COMPRESSED EQU 1
CYDEV_CONFIGURATION_DMA EQU 0
CYDEV_CONFIGURATION_ECC EQU 1
CYDEV_CONFIGURATION_IMOENABLED EQU CYDEV_CONFIG_FASTBOOT_ENABLED
CYDEV_CONFIGURATION_MODE_COMPRESSED EQU 0
CYDEV_CONFIGURATION_MODE EQU CYDEV_CONFIGURATION_MODE_COMPRESSED
CYDEV_CONFIGURATION_MODE_DMA EQU 2
CYDEV_CONFIGURATION_MODE_UNCOMPRESSED EQU 1
CYDEV_DEBUG_ENABLE_MASK EQU 0x20
CYDEV_DEBUG_ENABLE_REGISTER EQU CYREG_MLOGIC_DEBUG
CYDEV_DEBUGGING_DPS_Disable EQU 3
CYDEV_DEBUGGING_DPS_JTAG_4 EQU 1
CYDEV_DEBUGGING_DPS_JTAG_5 EQU 0
CYDEV_DEBUGGING_DPS_SWD EQU 2
CYDEV_DEBUGGING_DPS_SWD_SWV EQU 6
CYDEV_DEBUGGING_DPS EQU CYDEV_DEBUGGING_DPS_SWD_SWV
CYDEV_DEBUGGING_ENABLE EQU 1
CYDEV_DEBUGGING_XRES EQU 0
CYDEV_DMA_CHANNELS_AVAILABLE EQU 24
CYDEV_ECC_ENABLE EQU 0
CYDEV_HEAP_SIZE EQU 0x80
CYDEV_INSTRUCT_CACHE_ENABLED EQU 1
CYDEV_INTR_RISING EQU 0x00000003
CYDEV_IS_EXPORTING_CODE EQU 0
CYDEV_IS_IMPORTING_CODE EQU 0
CYDEV_PROJ_TYPE EQU 0
CYDEV_PROJ_TYPE_BOOTLOADER EQU 1
CYDEV_PROJ_TYPE_LAUNCHER EQU 5
CYDEV_PROJ_TYPE_LOADABLE EQU 2
CYDEV_PROJ_TYPE_LOADABLEANDBOOTLOADER EQU 4
CYDEV_PROJ_TYPE_MULTIAPPBOOTLOADER EQU 3
CYDEV_PROJ_TYPE_STANDARD EQU 0
CYDEV_PROTECTION_ENABLE EQU 0
CYDEV_STACK_SIZE EQU 0x0800
CYDEV_USE_BUNDLED_CMSIS EQU 1
CYDEV_VARIABLE_VDDA EQU 0
CYDEV_VDDA_MV EQU 5000
CYDEV_VDDD_MV EQU 5000
CYDEV_VDDIO0_MV EQU 5000
CYDEV_VDDIO1_MV EQU 5000
CYDEV_VDDIO2_MV EQU 5000
CYDEV_VDDIO3_MV EQU 5000
CYDEV_VIO0_MV EQU 5000
CYDEV_VIO1_MV EQU 5000
CYDEV_VIO2_MV EQU 5000
CYDEV_VIO3_MV EQU 5000
CYIPBLOCK_ARM_CM3_VERSION EQU 0
CYIPBLOCK_P3_ANAIF_VERSION EQU 0
CYIPBLOCK_P3_CAN_VERSION EQU 0
CYIPBLOCK_P3_CAPSENSE_VERSION EQU 0
CYIPBLOCK_P3_COMP_VERSION EQU 0
CYIPBLOCK_P3_DECIMATOR_VERSION EQU 0
CYIPBLOCK_P3_DFB_VERSION EQU 0
CYIPBLOCK_P3_DMA_VERSION EQU 0
CYIPBLOCK_P3_DRQ_VERSION EQU 0
CYIPBLOCK_P3_DSM_VERSION EQU 0
CYIPBLOCK_P3_EMIF_VERSION EQU 0
CYIPBLOCK_P3_I2C_VERSION EQU 0
CYIPBLOCK_P3_LCD_VERSION EQU 0
CYIPBLOCK_P3_LPF_VERSION EQU 0
CYIPBLOCK_P3_OPAMP_VERSION EQU 0
CYIPBLOCK_P3_PM_VERSION EQU 0
CYIPBLOCK_P3_SCCT_VERSION EQU 0
CYIPBLOCK_P3_TIMER_VERSION EQU 0
CYIPBLOCK_P3_USB_VERSION EQU 0
CYIPBLOCK_P3_VIDAC_VERSION EQU 0
CYIPBLOCK_P3_VREF_VERSION EQU 0
CYIPBLOCK_S8_GPIO_VERSION EQU 0
CYIPBLOCK_S8_IRQ_VERSION EQU 0
CYIPBLOCK_S8_SAR_VERSION EQU 0
CYIPBLOCK_S8_SIO_VERSION EQU 0
CYIPBLOCK_S8_UDB_VERSION EQU 0
DMA_CHANNELS_USED__MASK0 EQU 0x00000003
CYDEV_BOOTLOADER_ENABLE EQU 0
    ENDIF
    END
