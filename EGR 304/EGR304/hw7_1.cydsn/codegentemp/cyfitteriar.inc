;
; File Name: cyfitteriar.inc
; 
; PSoC Creator  4.1 Update 1
;
; Description:
; 
;
;-------------------------------------------------------------------------------
; Copyright (c) 2007-2017 Cypress Semiconductor.  All rights reserved.
; You may use this file only in accordance with the license, terms, conditions, 
; disclaimers, and limitations in the end user license agreement accompanying 
; the software package with which this file was provided.
;-------------------------------------------------------------------------------

#ifndef INCLUDED_CYFITTERIAR_INC
#define INCLUDED_CYFITTERIAR_INC
    INCLUDE cydeviceiar_trm.inc

/* Rx_1 */
Rx_1__0__DR EQU CYREG_GPIO_PRT1_DR
Rx_1__0__DR_CLR EQU CYREG_GPIO_PRT1_DR_CLR
Rx_1__0__DR_INV EQU CYREG_GPIO_PRT1_DR_INV
Rx_1__0__DR_SET EQU CYREG_GPIO_PRT1_DR_SET
Rx_1__0__HSIOM EQU CYREG_HSIOM_PORT_SEL1
Rx_1__0__HSIOM_MASK EQU 0x000F0000
Rx_1__0__HSIOM_SHIFT EQU 16
Rx_1__0__INTCFG EQU CYREG_GPIO_PRT1_INTR_CFG
Rx_1__0__INTR EQU CYREG_GPIO_PRT1_INTR
Rx_1__0__INTR_CFG EQU CYREG_GPIO_PRT1_INTR_CFG
Rx_1__0__INTSTAT EQU CYREG_GPIO_PRT1_INTR
Rx_1__0__MASK EQU 0x10
Rx_1__0__PA__CFG0 EQU CYREG_UDB_PA1_CFG0
Rx_1__0__PA__CFG1 EQU CYREG_UDB_PA1_CFG1
Rx_1__0__PA__CFG10 EQU CYREG_UDB_PA1_CFG10
Rx_1__0__PA__CFG11 EQU CYREG_UDB_PA1_CFG11
Rx_1__0__PA__CFG12 EQU CYREG_UDB_PA1_CFG12
Rx_1__0__PA__CFG13 EQU CYREG_UDB_PA1_CFG13
Rx_1__0__PA__CFG14 EQU CYREG_UDB_PA1_CFG14
Rx_1__0__PA__CFG2 EQU CYREG_UDB_PA1_CFG2
Rx_1__0__PA__CFG3 EQU CYREG_UDB_PA1_CFG3
Rx_1__0__PA__CFG4 EQU CYREG_UDB_PA1_CFG4
Rx_1__0__PA__CFG5 EQU CYREG_UDB_PA1_CFG5
Rx_1__0__PA__CFG6 EQU CYREG_UDB_PA1_CFG6
Rx_1__0__PA__CFG7 EQU CYREG_UDB_PA1_CFG7
Rx_1__0__PA__CFG8 EQU CYREG_UDB_PA1_CFG8
Rx_1__0__PA__CFG9 EQU CYREG_UDB_PA1_CFG9
Rx_1__0__PC EQU CYREG_GPIO_PRT1_PC
Rx_1__0__PC2 EQU CYREG_GPIO_PRT1_PC2
Rx_1__0__PORT EQU 1
Rx_1__0__PS EQU CYREG_GPIO_PRT1_PS
Rx_1__0__SHIFT EQU 4
Rx_1__DR EQU CYREG_GPIO_PRT1_DR
Rx_1__DR_CLR EQU CYREG_GPIO_PRT1_DR_CLR
Rx_1__DR_INV EQU CYREG_GPIO_PRT1_DR_INV
Rx_1__DR_SET EQU CYREG_GPIO_PRT1_DR_SET
Rx_1__INTCFG EQU CYREG_GPIO_PRT1_INTR_CFG
Rx_1__INTR EQU CYREG_GPIO_PRT1_INTR
Rx_1__INTR_CFG EQU CYREG_GPIO_PRT1_INTR_CFG
Rx_1__INTSTAT EQU CYREG_GPIO_PRT1_INTR
Rx_1__MASK EQU 0x10
Rx_1__PA__CFG0 EQU CYREG_UDB_PA1_CFG0
Rx_1__PA__CFG1 EQU CYREG_UDB_PA1_CFG1
Rx_1__PA__CFG10 EQU CYREG_UDB_PA1_CFG10
Rx_1__PA__CFG11 EQU CYREG_UDB_PA1_CFG11
Rx_1__PA__CFG12 EQU CYREG_UDB_PA1_CFG12
Rx_1__PA__CFG13 EQU CYREG_UDB_PA1_CFG13
Rx_1__PA__CFG14 EQU CYREG_UDB_PA1_CFG14
Rx_1__PA__CFG2 EQU CYREG_UDB_PA1_CFG2
Rx_1__PA__CFG3 EQU CYREG_UDB_PA1_CFG3
Rx_1__PA__CFG4 EQU CYREG_UDB_PA1_CFG4
Rx_1__PA__CFG5 EQU CYREG_UDB_PA1_CFG5
Rx_1__PA__CFG6 EQU CYREG_UDB_PA1_CFG6
Rx_1__PA__CFG7 EQU CYREG_UDB_PA1_CFG7
Rx_1__PA__CFG8 EQU CYREG_UDB_PA1_CFG8
Rx_1__PA__CFG9 EQU CYREG_UDB_PA1_CFG9
Rx_1__PC EQU CYREG_GPIO_PRT1_PC
Rx_1__PC2 EQU CYREG_GPIO_PRT1_PC2
Rx_1__PORT EQU 1
Rx_1__PS EQU CYREG_GPIO_PRT1_PS
Rx_1__SHIFT EQU 4

/* Tx_1 */
Tx_1__0__DR EQU CYREG_GPIO_PRT2_DR
Tx_1__0__DR_CLR EQU CYREG_GPIO_PRT2_DR_CLR
Tx_1__0__DR_INV EQU CYREG_GPIO_PRT2_DR_INV
Tx_1__0__DR_SET EQU CYREG_GPIO_PRT2_DR_SET
Tx_1__0__HSIOM EQU CYREG_HSIOM_PORT_SEL2
Tx_1__0__HSIOM_MASK EQU 0x000000F0
Tx_1__0__HSIOM_SHIFT EQU 4
Tx_1__0__INTCFG EQU CYREG_GPIO_PRT2_INTR_CFG
Tx_1__0__INTR EQU CYREG_GPIO_PRT2_INTR
Tx_1__0__INTR_CFG EQU CYREG_GPIO_PRT2_INTR_CFG
Tx_1__0__INTSTAT EQU CYREG_GPIO_PRT2_INTR
Tx_1__0__MASK EQU 0x02
Tx_1__0__OUT_SEL EQU CYREG_UDB_PA2_CFG10
Tx_1__0__OUT_SEL_SHIFT EQU 2
Tx_1__0__OUT_SEL_VAL EQU 1
Tx_1__0__PA__CFG0 EQU CYREG_UDB_PA2_CFG0
Tx_1__0__PA__CFG1 EQU CYREG_UDB_PA2_CFG1
Tx_1__0__PA__CFG10 EQU CYREG_UDB_PA2_CFG10
Tx_1__0__PA__CFG11 EQU CYREG_UDB_PA2_CFG11
Tx_1__0__PA__CFG12 EQU CYREG_UDB_PA2_CFG12
Tx_1__0__PA__CFG13 EQU CYREG_UDB_PA2_CFG13
Tx_1__0__PA__CFG14 EQU CYREG_UDB_PA2_CFG14
Tx_1__0__PA__CFG2 EQU CYREG_UDB_PA2_CFG2
Tx_1__0__PA__CFG3 EQU CYREG_UDB_PA2_CFG3
Tx_1__0__PA__CFG4 EQU CYREG_UDB_PA2_CFG4
Tx_1__0__PA__CFG5 EQU CYREG_UDB_PA2_CFG5
Tx_1__0__PA__CFG6 EQU CYREG_UDB_PA2_CFG6
Tx_1__0__PA__CFG7 EQU CYREG_UDB_PA2_CFG7
Tx_1__0__PA__CFG8 EQU CYREG_UDB_PA2_CFG8
Tx_1__0__PA__CFG9 EQU CYREG_UDB_PA2_CFG9
Tx_1__0__PC EQU CYREG_GPIO_PRT2_PC
Tx_1__0__PC2 EQU CYREG_GPIO_PRT2_PC2
Tx_1__0__PORT EQU 2
Tx_1__0__PS EQU CYREG_GPIO_PRT2_PS
Tx_1__0__SHIFT EQU 1
Tx_1__DR EQU CYREG_GPIO_PRT2_DR
Tx_1__DR_CLR EQU CYREG_GPIO_PRT2_DR_CLR
Tx_1__DR_INV EQU CYREG_GPIO_PRT2_DR_INV
Tx_1__DR_SET EQU CYREG_GPIO_PRT2_DR_SET
Tx_1__INTCFG EQU CYREG_GPIO_PRT2_INTR_CFG
Tx_1__INTR EQU CYREG_GPIO_PRT2_INTR
Tx_1__INTR_CFG EQU CYREG_GPIO_PRT2_INTR_CFG
Tx_1__INTSTAT EQU CYREG_GPIO_PRT2_INTR
Tx_1__MASK EQU 0x02
Tx_1__PA__CFG0 EQU CYREG_UDB_PA2_CFG0
Tx_1__PA__CFG1 EQU CYREG_UDB_PA2_CFG1
Tx_1__PA__CFG10 EQU CYREG_UDB_PA2_CFG10
Tx_1__PA__CFG11 EQU CYREG_UDB_PA2_CFG11
Tx_1__PA__CFG12 EQU CYREG_UDB_PA2_CFG12
Tx_1__PA__CFG13 EQU CYREG_UDB_PA2_CFG13
Tx_1__PA__CFG14 EQU CYREG_UDB_PA2_CFG14
Tx_1__PA__CFG2 EQU CYREG_UDB_PA2_CFG2
Tx_1__PA__CFG3 EQU CYREG_UDB_PA2_CFG3
Tx_1__PA__CFG4 EQU CYREG_UDB_PA2_CFG4
Tx_1__PA__CFG5 EQU CYREG_UDB_PA2_CFG5
Tx_1__PA__CFG6 EQU CYREG_UDB_PA2_CFG6
Tx_1__PA__CFG7 EQU CYREG_UDB_PA2_CFG7
Tx_1__PA__CFG8 EQU CYREG_UDB_PA2_CFG8
Tx_1__PA__CFG9 EQU CYREG_UDB_PA2_CFG9
Tx_1__PC EQU CYREG_GPIO_PRT2_PC
Tx_1__PC2 EQU CYREG_GPIO_PRT2_PC2
Tx_1__PORT EQU 2
Tx_1__PS EQU CYREG_GPIO_PRT2_PS
Tx_1__SHIFT EQU 1

/* uart_BUART */
uart_BUART_sRX_RxBitCounter__16BIT_CONTROL_AUX_CTL_REG EQU CYREG_UDB_W16_ACTL1
uart_BUART_sRX_RxBitCounter__16BIT_CONTROL_CONTROL_REG EQU CYREG_UDB_W16_CTL1
uart_BUART_sRX_RxBitCounter__16BIT_CONTROL_COUNT_REG EQU CYREG_UDB_W16_CTL1
uart_BUART_sRX_RxBitCounter__16BIT_COUNT_CONTROL_REG EQU CYREG_UDB_W16_CTL1
uart_BUART_sRX_RxBitCounter__16BIT_COUNT_COUNT_REG EQU CYREG_UDB_W16_CTL1
uart_BUART_sRX_RxBitCounter__16BIT_MASK_MASK_REG EQU CYREG_UDB_W16_MSK1
uart_BUART_sRX_RxBitCounter__16BIT_MASK_PERIOD_REG EQU CYREG_UDB_W16_MSK1
uart_BUART_sRX_RxBitCounter__16BIT_PERIOD_MASK_REG EQU CYREG_UDB_W16_MSK1
uart_BUART_sRX_RxBitCounter__16BIT_PERIOD_PERIOD_REG EQU CYREG_UDB_W16_MSK1
uart_BUART_sRX_RxBitCounter__CONTROL_AUX_CTL_REG EQU CYREG_UDB_W8_ACTL1
uart_BUART_sRX_RxBitCounter__CONTROL_REG EQU CYREG_UDB_W8_CTL1
uart_BUART_sRX_RxBitCounter__CONTROL_ST_REG EQU CYREG_UDB_CAT16_CTL_ST1
uart_BUART_sRX_RxBitCounter__COUNT_REG EQU CYREG_UDB_W8_CTL1
uart_BUART_sRX_RxBitCounter__COUNT_ST_REG EQU CYREG_UDB_CAT16_CTL_ST1
uart_BUART_sRX_RxBitCounter__MASK_CTL_AUX_CTL_REG EQU CYREG_UDB_CAT16_ACTL_MSK1
uart_BUART_sRX_RxBitCounter__PER_CTL_AUX_CTL_REG EQU CYREG_UDB_CAT16_ACTL_MSK1
uart_BUART_sRX_RxBitCounter__PERIOD_REG EQU CYREG_UDB_W8_MSK1
uart_BUART_sRX_RxBitCounter_ST__16BIT_STATUS_AUX_CTL_REG EQU CYREG_UDB_W16_ACTL1
uart_BUART_sRX_RxBitCounter_ST__16BIT_STATUS_REG EQU CYREG_UDB_W16_ST1
uart_BUART_sRX_RxBitCounter_ST__MASK_REG EQU CYREG_UDB_W8_MSK1
uart_BUART_sRX_RxBitCounter_ST__MASK_ST_AUX_CTL_REG EQU CYREG_UDB_CAT16_ACTL_MSK1
uart_BUART_sRX_RxBitCounter_ST__PER_ST_AUX_CTL_REG EQU CYREG_UDB_CAT16_ACTL_MSK1
uart_BUART_sRX_RxBitCounter_ST__STATUS_AUX_CTL_REG EQU CYREG_UDB_W8_ACTL1
uart_BUART_sRX_RxBitCounter_ST__STATUS_CNT_REG EQU CYREG_UDB_CAT16_CTL_ST1
uart_BUART_sRX_RxBitCounter_ST__STATUS_CONTROL_REG EQU CYREG_UDB_CAT16_CTL_ST1
uart_BUART_sRX_RxBitCounter_ST__STATUS_REG EQU CYREG_UDB_W8_ST1
uart_BUART_sRX_RxShifter_u0__16BIT_A0_REG EQU CYREG_UDB_W16_A01
uart_BUART_sRX_RxShifter_u0__16BIT_A1_REG EQU CYREG_UDB_W16_A11
uart_BUART_sRX_RxShifter_u0__16BIT_D0_REG EQU CYREG_UDB_W16_D01
uart_BUART_sRX_RxShifter_u0__16BIT_D1_REG EQU CYREG_UDB_W16_D11
uart_BUART_sRX_RxShifter_u0__16BIT_DP_AUX_CTL_REG EQU CYREG_UDB_W16_ACTL1
uart_BUART_sRX_RxShifter_u0__16BIT_F0_REG EQU CYREG_UDB_W16_F01
uart_BUART_sRX_RxShifter_u0__16BIT_F1_REG EQU CYREG_UDB_W16_F11
uart_BUART_sRX_RxShifter_u0__A0_A1_REG EQU CYREG_UDB_CAT16_A1
uart_BUART_sRX_RxShifter_u0__A0_REG EQU CYREG_UDB_W8_A01
uart_BUART_sRX_RxShifter_u0__A1_REG EQU CYREG_UDB_W8_A11
uart_BUART_sRX_RxShifter_u0__D0_D1_REG EQU CYREG_UDB_CAT16_D1
uart_BUART_sRX_RxShifter_u0__D0_REG EQU CYREG_UDB_W8_D01
uart_BUART_sRX_RxShifter_u0__D1_REG EQU CYREG_UDB_W8_D11
uart_BUART_sRX_RxShifter_u0__DP_AUX_CTL_REG EQU CYREG_UDB_W8_ACTL1
uart_BUART_sRX_RxShifter_u0__F0_F1_REG EQU CYREG_UDB_CAT16_F1
uart_BUART_sRX_RxShifter_u0__F0_REG EQU CYREG_UDB_W8_F01
uart_BUART_sRX_RxShifter_u0__F1_REG EQU CYREG_UDB_W8_F11
uart_BUART_sRX_RxShifter_u0__MSK_DP_AUX_CTL_REG EQU CYREG_UDB_CAT16_ACTL_MSK1
uart_BUART_sRX_RxShifter_u0__PER_DP_AUX_CTL_REG EQU CYREG_UDB_CAT16_ACTL_MSK1
uart_BUART_sRX_RxSts__16BIT_STATUS_AUX_CTL_REG EQU CYREG_UDB_W16_ACTL0
uart_BUART_sRX_RxSts__16BIT_STATUS_REG EQU CYREG_UDB_W16_ST0
uart_BUART_sRX_RxSts__3__MASK EQU 0x08
uart_BUART_sRX_RxSts__3__POS EQU 3
uart_BUART_sRX_RxSts__32BIT_MASK_REG EQU CYREG_UDB_W32_MSK
uart_BUART_sRX_RxSts__32BIT_STATUS_AUX_CTL_REG EQU CYREG_UDB_W32_ACTL
uart_BUART_sRX_RxSts__32BIT_STATUS_REG EQU CYREG_UDB_W32_ST
uart_BUART_sRX_RxSts__4__MASK EQU 0x10
uart_BUART_sRX_RxSts__4__POS EQU 4
uart_BUART_sRX_RxSts__5__MASK EQU 0x20
uart_BUART_sRX_RxSts__5__POS EQU 5
uart_BUART_sRX_RxSts__MASK EQU 0x38
uart_BUART_sRX_RxSts__MASK_REG EQU CYREG_UDB_W8_MSK0
uart_BUART_sRX_RxSts__STATUS_AUX_CTL_REG EQU CYREG_UDB_W8_ACTL0
uart_BUART_sRX_RxSts__STATUS_REG EQU CYREG_UDB_W8_ST0
uart_BUART_sTX_sCLOCK_TxBitClkGen__A0_A1_REG EQU CYREG_UDB_CAT16_A3
uart_BUART_sTX_sCLOCK_TxBitClkGen__A0_REG EQU CYREG_UDB_W8_A03
uart_BUART_sTX_sCLOCK_TxBitClkGen__A1_REG EQU CYREG_UDB_W8_A13
uart_BUART_sTX_sCLOCK_TxBitClkGen__D0_D1_REG EQU CYREG_UDB_CAT16_D3
uart_BUART_sTX_sCLOCK_TxBitClkGen__D0_REG EQU CYREG_UDB_W8_D03
uart_BUART_sTX_sCLOCK_TxBitClkGen__D1_REG EQU CYREG_UDB_W8_D13
uart_BUART_sTX_sCLOCK_TxBitClkGen__DP_AUX_CTL_REG EQU CYREG_UDB_W8_ACTL3
uart_BUART_sTX_sCLOCK_TxBitClkGen__F0_F1_REG EQU CYREG_UDB_CAT16_F3
uart_BUART_sTX_sCLOCK_TxBitClkGen__F0_REG EQU CYREG_UDB_W8_F03
uart_BUART_sTX_sCLOCK_TxBitClkGen__F1_REG EQU CYREG_UDB_W8_F13
uart_BUART_sTX_TxShifter_u0__16BIT_A0_REG EQU CYREG_UDB_W16_A02
uart_BUART_sTX_TxShifter_u0__16BIT_A1_REG EQU CYREG_UDB_W16_A12
uart_BUART_sTX_TxShifter_u0__16BIT_D0_REG EQU CYREG_UDB_W16_D02
uart_BUART_sTX_TxShifter_u0__16BIT_D1_REG EQU CYREG_UDB_W16_D12
uart_BUART_sTX_TxShifter_u0__16BIT_DP_AUX_CTL_REG EQU CYREG_UDB_W16_ACTL2
uart_BUART_sTX_TxShifter_u0__16BIT_F0_REG EQU CYREG_UDB_W16_F02
uart_BUART_sTX_TxShifter_u0__16BIT_F1_REG EQU CYREG_UDB_W16_F12
uart_BUART_sTX_TxShifter_u0__A0_A1_REG EQU CYREG_UDB_CAT16_A2
uart_BUART_sTX_TxShifter_u0__A0_REG EQU CYREG_UDB_W8_A02
uart_BUART_sTX_TxShifter_u0__A1_REG EQU CYREG_UDB_W8_A12
uart_BUART_sTX_TxShifter_u0__D0_D1_REG EQU CYREG_UDB_CAT16_D2
uart_BUART_sTX_TxShifter_u0__D0_REG EQU CYREG_UDB_W8_D02
uart_BUART_sTX_TxShifter_u0__D1_REG EQU CYREG_UDB_W8_D12
uart_BUART_sTX_TxShifter_u0__DP_AUX_CTL_REG EQU CYREG_UDB_W8_ACTL2
uart_BUART_sTX_TxShifter_u0__F0_F1_REG EQU CYREG_UDB_CAT16_F2
uart_BUART_sTX_TxShifter_u0__F0_REG EQU CYREG_UDB_W8_F02
uart_BUART_sTX_TxShifter_u0__F1_REG EQU CYREG_UDB_W8_F12
uart_BUART_sTX_TxSts__0__MASK EQU 0x01
uart_BUART_sTX_TxSts__0__POS EQU 0
uart_BUART_sTX_TxSts__1__MASK EQU 0x02
uart_BUART_sTX_TxSts__1__POS EQU 1
uart_BUART_sTX_TxSts__16BIT_STATUS_AUX_CTL_REG EQU CYREG_UDB_W16_ACTL2
uart_BUART_sTX_TxSts__16BIT_STATUS_REG EQU CYREG_UDB_W16_ST2
uart_BUART_sTX_TxSts__2__MASK EQU 0x04
uart_BUART_sTX_TxSts__2__POS EQU 2
uart_BUART_sTX_TxSts__3__MASK EQU 0x08
uart_BUART_sTX_TxSts__3__POS EQU 3
uart_BUART_sTX_TxSts__MASK EQU 0x0F
uart_BUART_sTX_TxSts__MASK_REG EQU CYREG_UDB_W8_MSK2
uart_BUART_sTX_TxSts__STATUS_AUX_CTL_REG EQU CYREG_UDB_W8_ACTL2
uart_BUART_sTX_TxSts__STATUS_REG EQU CYREG_UDB_W8_ST2

/* uart_IntClock */
uart_IntClock__CTRL_REGISTER EQU CYREG_PERI_PCLK_CTL11
uart_IntClock__DIV_ID EQU 0x00000040
uart_IntClock__DIV_REGISTER EQU CYREG_PERI_DIV_16_CTL0
uart_IntClock__PA_DIV_ID EQU 0x000000FF

/* Miscellaneous */
CYDEV_BCLK__HFCLK__HZ EQU 48000000
CYDEV_BCLK__HFCLK__KHZ EQU 48000
CYDEV_BCLK__HFCLK__MHZ EQU 48
CYDEV_BCLK__SYSCLK__HZ EQU 48000000
CYDEV_BCLK__SYSCLK__KHZ EQU 48000
CYDEV_BCLK__SYSCLK__MHZ EQU 48
CYDEV_CHIP_DIE_LEOPARD EQU 1
CYDEV_CHIP_DIE_PSOC4A EQU 16
CYDEV_CHIP_DIE_PSOC5LP EQU 2
CYDEV_CHIP_DIE_PSOC5TM EQU 3
CYDEV_CHIP_DIE_TMA4 EQU 4
CYDEV_CHIP_DIE_UNKNOWN EQU 0
CYDEV_CHIP_FAMILY_FM0P EQU 5
CYDEV_CHIP_FAMILY_FM3 EQU 6
CYDEV_CHIP_FAMILY_FM4 EQU 7
CYDEV_CHIP_FAMILY_PSOC3 EQU 1
CYDEV_CHIP_FAMILY_PSOC4 EQU 2
CYDEV_CHIP_FAMILY_PSOC5 EQU 3
CYDEV_CHIP_FAMILY_PSOC6 EQU 4
CYDEV_CHIP_FAMILY_UNKNOWN EQU 0
CYDEV_CHIP_FAMILY_USED EQU CYDEV_CHIP_FAMILY_PSOC4
CYDEV_CHIP_JTAG_ID EQU 0x1A1711AA
CYDEV_CHIP_MEMBER_3A EQU 1
CYDEV_CHIP_MEMBER_4A EQU 16
CYDEV_CHIP_MEMBER_4D EQU 12
CYDEV_CHIP_MEMBER_4E EQU 6
CYDEV_CHIP_MEMBER_4F EQU 17
CYDEV_CHIP_MEMBER_4G EQU 4
CYDEV_CHIP_MEMBER_4H EQU 15
CYDEV_CHIP_MEMBER_4I EQU 21
CYDEV_CHIP_MEMBER_4J EQU 13
CYDEV_CHIP_MEMBER_4K EQU 14
CYDEV_CHIP_MEMBER_4L EQU 20
CYDEV_CHIP_MEMBER_4M EQU 19
CYDEV_CHIP_MEMBER_4N EQU 9
CYDEV_CHIP_MEMBER_4O EQU 7
CYDEV_CHIP_MEMBER_4P EQU 18
CYDEV_CHIP_MEMBER_4Q EQU 11
CYDEV_CHIP_MEMBER_4R EQU 8
CYDEV_CHIP_MEMBER_4S EQU 10
CYDEV_CHIP_MEMBER_4U EQU 5
CYDEV_CHIP_MEMBER_5A EQU 3
CYDEV_CHIP_MEMBER_5B EQU 2
CYDEV_CHIP_MEMBER_6A EQU 22
CYDEV_CHIP_MEMBER_FM3 EQU 26
CYDEV_CHIP_MEMBER_FM4 EQU 27
CYDEV_CHIP_MEMBER_PDL_FM0P_TYPE1 EQU 23
CYDEV_CHIP_MEMBER_PDL_FM0P_TYPE2 EQU 24
CYDEV_CHIP_MEMBER_PDL_FM0P_TYPE3 EQU 25
CYDEV_CHIP_MEMBER_UNKNOWN EQU 0
CYDEV_CHIP_MEMBER_USED EQU CYDEV_CHIP_MEMBER_4F
CYDEV_CHIP_DIE_EXPECT EQU CYDEV_CHIP_MEMBER_USED
CYDEV_CHIP_DIE_ACTUAL EQU CYDEV_CHIP_DIE_EXPECT
CYDEV_CHIP_REV_LEOPARD_ES1 EQU 0
CYDEV_CHIP_REV_LEOPARD_ES2 EQU 1
CYDEV_CHIP_REV_LEOPARD_ES3 EQU 3
CYDEV_CHIP_REV_LEOPARD_PRODUCTION EQU 3
CYDEV_CHIP_REV_PSOC4A_ES0 EQU 17
CYDEV_CHIP_REV_PSOC4A_PRODUCTION EQU 17
CYDEV_CHIP_REV_PSOC5LP_ES0 EQU 0
CYDEV_CHIP_REV_PSOC5LP_PRODUCTION EQU 0
CYDEV_CHIP_REV_PSOC5TM_ES0 EQU 0
CYDEV_CHIP_REV_PSOC5TM_ES1 EQU 1
CYDEV_CHIP_REV_PSOC5TM_PRODUCTION EQU 1
CYDEV_CHIP_REV_TMA4_ES EQU 17
CYDEV_CHIP_REV_TMA4_ES2 EQU 33
CYDEV_CHIP_REV_TMA4_PRODUCTION EQU 17
CYDEV_CHIP_REVISION_3A_ES1 EQU 0
CYDEV_CHIP_REVISION_3A_ES2 EQU 1
CYDEV_CHIP_REVISION_3A_ES3 EQU 3
CYDEV_CHIP_REVISION_3A_PRODUCTION EQU 3
CYDEV_CHIP_REVISION_4A_ES0 EQU 17
CYDEV_CHIP_REVISION_4A_PRODUCTION EQU 17
CYDEV_CHIP_REVISION_4D_PRODUCTION EQU 0
CYDEV_CHIP_REVISION_4E_PRODUCTION EQU 0
CYDEV_CHIP_REVISION_4F_PRODUCTION EQU 0
CYDEV_CHIP_REVISION_4F_PRODUCTION_256DMA EQU 0
CYDEV_CHIP_REVISION_4F_PRODUCTION_256K EQU 0
CYDEV_CHIP_REVISION_4G_ES EQU 17
CYDEV_CHIP_REVISION_4G_ES2 EQU 33
CYDEV_CHIP_REVISION_4G_PRODUCTION EQU 17
CYDEV_CHIP_REVISION_4H_PRODUCTION EQU 0
CYDEV_CHIP_REVISION_4I_PRODUCTION EQU 0
CYDEV_CHIP_REVISION_4J_PRODUCTION EQU 0
CYDEV_CHIP_REVISION_4K_PRODUCTION EQU 0
CYDEV_CHIP_REVISION_4L_PRODUCTION EQU 0
CYDEV_CHIP_REVISION_4M_PRODUCTION EQU 0
CYDEV_CHIP_REVISION_4N_PRODUCTION EQU 0
CYDEV_CHIP_REVISION_4O_PRODUCTION EQU 0
CYDEV_CHIP_REVISION_4P_PRODUCTION EQU 0
CYDEV_CHIP_REVISION_4Q_PRODUCTION EQU 0
CYDEV_CHIP_REVISION_4R_PRODUCTION EQU 0
CYDEV_CHIP_REVISION_4S_PRODUCTION EQU 0
CYDEV_CHIP_REVISION_4U_PRODUCTION EQU 0
CYDEV_CHIP_REVISION_5A_ES0 EQU 0
CYDEV_CHIP_REVISION_5A_ES1 EQU 1
CYDEV_CHIP_REVISION_5A_PRODUCTION EQU 1
CYDEV_CHIP_REVISION_5B_ES0 EQU 0
CYDEV_CHIP_REVISION_5B_PRODUCTION EQU 0
CYDEV_CHIP_REVISION_6A_NO_UDB EQU 0
CYDEV_CHIP_REVISION_6A_PRODUCTION EQU 0
CYDEV_CHIP_REVISION_FM3_PRODUCTION EQU 0
CYDEV_CHIP_REVISION_FM4_PRODUCTION EQU 0
CYDEV_CHIP_REVISION_PDL_FM0P_TYPE1_PRODUCTION EQU 0
CYDEV_CHIP_REVISION_PDL_FM0P_TYPE2_PRODUCTION EQU 0
CYDEV_CHIP_REVISION_PDL_FM0P_TYPE3_PRODUCTION EQU 0
CYDEV_CHIP_REVISION_USED EQU CYDEV_CHIP_REVISION_4F_PRODUCTION_256DMA
CYDEV_CHIP_REV_EXPECT EQU CYDEV_CHIP_REVISION_USED
CYDEV_CONFIG_READ_ACCELERATOR EQU 1
CYDEV_CONFIG_UNUSED_IO_AllowButWarn EQU 0
CYDEV_CONFIG_UNUSED_IO_AllowWithInfo EQU 1
CYDEV_CONFIG_UNUSED_IO_Disallowed EQU 2
CYDEV_CONFIG_UNUSED_IO EQU CYDEV_CONFIG_UNUSED_IO_Disallowed
CYDEV_CONFIGURATION_COMPRESSED EQU 1
CYDEV_CONFIGURATION_MODE_COMPRESSED EQU 0
CYDEV_CONFIGURATION_MODE EQU CYDEV_CONFIGURATION_MODE_COMPRESSED
CYDEV_CONFIGURATION_MODE_DMA EQU 2
CYDEV_CONFIGURATION_MODE_UNCOMPRESSED EQU 1
CYDEV_DEBUG_PROTECT_KILL EQU 4
CYDEV_DEBUG_PROTECT_OPEN EQU 1
CYDEV_DEBUG_PROTECT EQU CYDEV_DEBUG_PROTECT_OPEN
CYDEV_DEBUG_PROTECT_PROTECTED EQU 2
CYDEV_DEBUGGING_DPS_Disable EQU 3
CYDEV_DEBUGGING_DPS_SWD EQU 2
CYDEV_DEBUGGING_DPS EQU CYDEV_DEBUGGING_DPS_SWD
CYDEV_DEBUGGING_ENABLE EQU 1
CYDEV_DFT_SELECT_CLK0 EQU 10
CYDEV_DFT_SELECT_CLK1 EQU 11
CYDEV_DMA_CHANNELS_AVAILABLE EQU 8
CYDEV_HEAP_SIZE EQU 0x80
CYDEV_IMO_TRIMMED_BY_USB EQU 0
CYDEV_IMO_TRIMMED_BY_WCO EQU 0
CYDEV_INTR_NUMBER_DMA EQU 21
CYDEV_IS_EXPORTING_CODE EQU 0
CYDEV_IS_IMPORTING_CODE EQU 0
CYDEV_PROJ_TYPE EQU 0
CYDEV_PROJ_TYPE_BOOTLOADER EQU 1
CYDEV_PROJ_TYPE_LAUNCHER EQU 5
CYDEV_PROJ_TYPE_LOADABLE EQU 2
CYDEV_PROJ_TYPE_LOADABLEANDBOOTLOADER EQU 4
CYDEV_PROJ_TYPE_MULTIAPPBOOTLOADER EQU 3
CYDEV_PROJ_TYPE_STANDARD EQU 0
CYDEV_STACK_SIZE EQU 0x0800
CYDEV_USE_BUNDLED_CMSIS EQU 1
CYDEV_VARIABLE_VDDA EQU 1
CYDEV_VDDA_MV EQU 3300
CYDEV_VDDD_MV EQU 3300
CYDEV_VDDR_MV EQU 3300
CYDEV_WDT_GENERATE_ISR EQU 1
CYIPBLOCK_m0s8bless_VERSION EQU 2
CYIPBLOCK_m0s8cpussv2_VERSION EQU 1
CYIPBLOCK_m0s8csd_VERSION EQU 1
CYIPBLOCK_m0s8ioss_VERSION EQU 1
CYIPBLOCK_m0s8lcd_VERSION EQU 2
CYIPBLOCK_m0s8lpcomp_VERSION EQU 2
CYIPBLOCK_m0s8peri_VERSION EQU 1
CYIPBLOCK_m0s8scb_VERSION EQU 2
CYIPBLOCK_m0s8srssv2_VERSION EQU 1
CYIPBLOCK_m0s8tcpwm_VERSION EQU 2
CYIPBLOCK_m0s8udbif_VERSION EQU 1
CYIPBLOCK_s8pass4al_VERSION EQU 1
DMA_CHANNELS_USED__MASK EQU 0
CYDEV_BOOTLOADER_ENABLE EQU 0

#endif /* INCLUDED_CYFITTERIAR_INC */
